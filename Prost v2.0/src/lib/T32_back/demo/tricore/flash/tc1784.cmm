; --------------------------------------------------------------------------------
; @Title: Generic Flash script file for TC1784 devices
; @Description:
;   Example script for flash declaration and programming of Infineon
;   TriCore TC1784 internal flash.
; @Keywords: Flash, Infineon, TriCore
; @Author: WRD
; @Chip: TC1784*
; @Copyright: (C) 1989-2014 Lauterbach GmbH, licensed for use with TRACE32(R) only
; --------------------------------------------------------------------------------
; $Rev: 2935 $
; $Id: tc1784.cmm 2935 2014-08-05 07:49:32Z mobermeir $


; Script arguments:
;
;   DO tc1784 [PREPAREONLY]
;
;     PREPAREONLY only declares flash but does not execute flash programming
;
; Example:
;
;   DO ~~/demo/tricore/flash/tc1784 PREPAREONLY
;
; Flash:
;   2.5 MByte onchip program flash at 0x80000000--0x8027FFFF (cached)
;                                  or 0xa0000000--0xa027FFFF (non cached)
;       Sectors (logical):  8 x 16kB, 1 x 128kB, 9 x 256kB
;       Sectors (physical): 2 x 64kB, 1 x 128kB, 9 x 256kB
;
;   128 kByte onchip data flash at 0x8fe00000--0x8fe0ffff (cached)
;                                  0x8fe10000--0x8fe1ffff (cached)
;                               or 0xafe00000--0xafe0ffff (non cached)
;                                  0xafe10000--0xafe1ffff (non cached)
;       Sectors: 2 x 64kB
;
; RAM:
;   128 kByte DMI Scratch-Pad RAM at 0xd0000000--0xd001ffff for data
;    40 kByte PMI Scratch-Pad RAM at 0xd4000000--0xd4009fff for flash algorithm
;

  LOCAL &parameters &param_prepareonly
  ENTRY %LINE &parameters
  &param_prepareonly=(STRing.SCAN(STRing.UPpeR("&parameters"),"PREPAREONLY",0)!=-1)

  ; ------------------------------------------------------------------------------
  ; Initialize

  IF SYStem.MODE()<5.
  (
    SYStem.RESet
    SYStem.CPU TC1784
    SYStem.Up
  )

  Data.Set 0xF00005F4 %Long 0x00000008    ; disable watchdog for programming

  ; ------------------------------------------------------------------------------
  ; Flash Declaration
  FLASH.RESet
  ; Program flash
  FLASH.Create 1. 0xa0000000--0xa000ffff 0x04000 TARGET Long
  FLASH.Create 2. 0xa0010000--0xa001ffff 0x04000 TARGET Long
  FLASH.Create 3. 0xa0020000--0xa003ffff 0x20000 TARGET Long
  FLASH.Create 3. 0xa0040000--0xa027ffff 0x40000 TARGET Long
  ; Data flash
  FLASH.Create 4. 0xafe00000--0xafe0ffff 0x10000 TARGET Long
  FLASH.Create 5. 0xafe10000--0xafe1ffff 0x10000 TARGET Long
  FLASH.TARGET 0xd4000000 0xd0000000 0x1000 ~~/demo/tricore/flash/long/tc1797.bin
  FLASH.CreateALIAS 0x80000000--0x8fffffff 0xa0000000

  ; Flash script ends here if called with parameter PREPAREONLY
  IF &param_prepareonly
    ENDDO PREPAREDONE

  ; ------------------------------------------------------------------------------
  ; Example for download

  DIALOG.YESNO "Program flash memory?"
  LOCAL &progflash
  ENTRY &progflash
  IF &progflash
  (
    FLASH.ReProgram ALL /Erase
    Data.LOAD.auto *
    FLASH.ReProgram.off
  )

  ENDDO
