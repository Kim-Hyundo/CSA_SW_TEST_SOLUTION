; --------------------------------------------------------------------------------
; @Title: Generic Flash script file for TC1796 devices
; @Description:
;   Example script for flash declaration and programming of Infineon
;   TriCore TC1796 internal flash.
; @Keywords: Flash, Infineon, TriCore
; @Author: WRD
; @Chip: TC1796*
; @Copyright: (C) 1989-2014 Lauterbach GmbH, licensed for use with TRACE32(R) only
; --------------------------------------------------------------------------------
; $Rev: 3256 $
; $Id: tc1796.cmm 3256 2015-04-16 07:19:01Z mobermeir $


; Script arguments:
;
;   DO tc1796 [PREPAREONLY]
;
;     PREPAREONLY only declares flash but does not execute flash programming
;
; Example:
;
;   DO ~~/demo/tricore/flash/tc1796 PREPAREONLY
;
; Flash:
;   2 MByte onchip program flash at 0x80000000--0x801fffff (cached)
;                                or 0xa0000000--0xa01fffff (non cached)
;     Sectors (logical):  8 x 16kB, 1 x 128kB, 1 x 256kB, 3 x 512kB
;     Sectors (physical): 2 x 64kB, 1 x 128kB, 1 x 256kB, 3 x 512kB
;
;   128 kByte onchip data flash at 0x8fe00000--0x8fe1ffff (cached)
;                               or 0xafe00000--0xafe1ffff (non cached)
;     Sectors: 2 x 64kB
;
; RAM:
;   56 kByte DMI Scratch-Pad RAM at 0xd0000000--0xd000dfff for data
;   48 kByte PMI Scratch-Pad RAM at 0xd4000000--0xd400bfff for flash algorithm
;
; NOTES:
;   This script version is supporting TC1796 EES-AB stepping considering
;   EES-AB Errata. For future steppings adaptions of script and flash
;   algorithm binary may be necessary. Logical flash sectors are not
;   supported by revision A chips. The script is reading chip revision to
;   matching flash declaration.
;
;   On TRIBOARD TC1796 switch 5 of DIP Switch S401 has to be in OFF
;   position to enable flash access.
;

LOCAL &parameters &param_prepareonly
ENTRY %LINE &parameters
&param_prepareonly=(STRing.SCAN(STRing.UPpeR("&parameters"),"PREPAREONLY",0)!=-1)

; --------------------------------------------------------------------------------
; Initialize

IF SYStem.MODE()<5.
(
  SYStem.RESet
  SYStem.CPU TC1796
  SYStem.Up
)

Data.Set 0xF0000024 %Long 0x00000008    ; disable watchdog for programming

; --------------------------------------------------------------------------------
; Check chip ID if logical flash sectors are supported by device
;
PRIVATE &chipid &sectorsize
&chipid=Data.Long(D:0xf0000074)
&sectorsize=0x4000
IF &chipid<0x00008a02
(
  ; TC1796 revision A chips
  &sectorsize=0x10000
)

; --------------------------------------------------------------------------------
; Flash Declaration
FLASH.RESet
; Program flash
FLASH.Create 1. 0xa0000000--0xa000ffff &sectorsize TARGET Long
FLASH.Create 2. 0xa0010000--0xa001ffff &sectorsize TARGET Long
FLASH.Create 3. 0xa0020000--0xa003ffff 0x20000 TARGET Long
FLASH.Create 3. 0xa0040000--0xa007ffff 0x40000 TARGET Long
FLASH.Create 3. 0xa0080000--0xa01fffff 0x80000 TARGET Long
; Data flash
FLASH.Create 4. 0xafe00000--0xafe0ffff 0x10000 TARGET Long
FLASH.Create 5. 0xafe10000--0xafe1ffff 0x10000 TARGET Long
FLASH.TARGET 0xd4000000 0xd0000000 0x1000 ~~/demo/tricore/flash/long/tc1796.bin
FLASH.CreateALIAS 0x80000000--0x8fffffff 0xa0000000

; Flash script ends here if called with parameter PREPAREONLY
IF &param_prepareonly
  ENDDO PREPAREDONE

; --------------------------------------------------------------------------------
; Example for download
;
; FLASH.ReProgram or FLASH.AUTO is required for flash programming of unsorted
; files. Each write page can only be written once after it was erased.

DIALOG.YESNO "Program flash memory?"
LOCAL &progflash
ENTRY &progflash
IF &progflash
(
  FLASH.ReProgram ALL /Erase
  Data.LOAD.auto *
  FLASH.ReProgram.off
)

ENDDO
