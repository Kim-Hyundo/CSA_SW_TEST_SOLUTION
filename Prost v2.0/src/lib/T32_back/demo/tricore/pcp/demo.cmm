; --------------------------------------------------------------------------------
; @Title: Dummy script to redirect to PCP demo scripts
; @Description: Redirects to PCP demos
; @Keywords: Infineon, pcp, TriCore
; @Author: MOB
; @Copyright: (C) 1989-2014 Lauterbach GmbH, licensed for use with TRACE32(R) only
; --------------------------------------------------------------------------------
; $Id: demo.cmm 6943 2014-04-23 14:52:46Z mobermeir $


CD "~~~~/../../pcp"

DIALOG.OK "PCP demos are located in" OS.PWD()

DO *.cmm

ENDDO
