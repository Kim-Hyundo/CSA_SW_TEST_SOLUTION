; --------------------------------------------------------------------------------
; @Title: Demo script for TC1784 on TriBoard-TC1784
; @Description:
;   Initializes the TriCore and loads the Sieve-Demo into memory.
; @Keywords: Infineon, internal, intmem, memory, sieve, TriCore
; @Author: MAX
; @Board: TriBoard-TC1784
; @Chip: TC1784
; @Copyright: (C) 1989-2014 Lauterbach GmbH, licensed for use with TRACE32(R) only
; --------------------------------------------------------------------------------
; $Id: tc1784_demo.cmm 7576 2014-08-27 14:49:47Z mobermeir $


; --------------------------------------------------------------------------------
; Memory mappings:
; processor internal program memory mapped to 0xD4000000--0xD4009FFF   40 KB
; processor internal data memory    mapped to 0xD0000000--0xD001FFFF  128 KB
; processor internal program flash  mapped to 0xA0000000--0xA027FFFF  2.5 MB
; processor internal data flash     mapped to 0xAFE00000--0xAFE0FFFF   64 KB
;                                             0xAFE10000--0xAFE1FFFF   64 KB

; --------------------------------------------------------------------------------
; initialize and start the debugger

RESet
SYStem.CPU TC1784

IF DAP.Available()
(
  ; Bi-Directional Debug Cable detected
  SYStem.CONFIG.DEBUGPORTTYPE DAP2    ; instead of JTAG
)
ELSE
(
  ; Uni-Directional Debug Cable
  SYStem.CONFIG.DEBUGPORTTYPE JTAG
)

SYStem.Up

; --------------------------------------------------------------------------------
; load demo program
Data.LOAD.Elf "~~~~/triboard-tc1782_sieve_intmem.elf"
Go.direct main

; open some windows
WinCLEAR
WinPOS 0% 0% 100% 50%
List.auto
WinPOS 0% 50% 50% 50%
Frame.view /Locals /Caller
WinPOS 50% 50% 50% 50%
Var.Watch
Var.AddWatch ast flags

ENDDO
