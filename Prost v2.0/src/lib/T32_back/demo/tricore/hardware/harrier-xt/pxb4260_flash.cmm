; --------------------------------------------------------------------------------
; @Title: Demo script for PXB4260 (RiderB) on Harrier-XT (Flash)
; @Description:
;   Flash programming demo.
;
;   Use the boot and clock option selected by following:
;   S2 CONFIG: ON OFF ON ON ON ON ON ON
;   CLOCK_CFG: ON OFF ON ON
;
; @Keywords: Flash, harrier-xt, Infineon, RiderB, TriCore
; @Author: MAX
; @Board: Harrier-XT
; @Chip: PXB4260
; @Copyright: (C) 1989-2014 Lauterbach GmbH, licensed for use with TRACE32(R) only
; --------------------------------------------------------------------------------
; $Id: pxb4260_flash.cmm 7573 2014-08-27 14:37:31Z mobermeir $


; --------------------------------------------------------------------------------
; Performed tests:
; HarrierXT PXB4260 2006-06-07 MAX
;
; Memory mappings:
; SRAM  (4MB) mapped to 0xA0000000--0xA03FFFFF
; Flash (2MB) mapped to 0xA4000000--0xA41FFFFF
;
; Memory mappings:
; SRAM  (16MB) mapped to 0xA0000000--0xA0FFFFFF
; Flash  (4MB) mapped to 0xA4000000--0xA43FFFFF

; --------------------------------------------------------------------------------
; initialize and start the debugger

RESet
WinCLEAR
SYStem.CPU PXB4260
SYStem.Up

; Disable watchdog timer
Data.Set 0xF0000024 %Long 0x00000008     ; WDTCON1

; --------------------------------------------------------------------------------
; memory initialzation

; initialize external bus unit
Data.Set 0xF0000210 %Long 0x4009FFFF    ; EBU_BCUCON
Data.Set 0xF0000510 %Long 0x0000FF68    ; EBU_EBUCON

; memory assignment
; AMD AM29LV160BB flash
Data.Set 0xF0000560 %Long 0x004213C4    ; EBU_BUSCON0
Data.Set 0xF0000520 %Long 0xA4000051    ; EBU_ADDSEL0
; Infineon HYB39S64160BT-8 SDRAM (4Mx16, PC100, CL2)
Data.Set 0xF0000564 %Long 0x01023000    ; EBU_BUSCON1
Data.Set 0xF0000524 %Long 0xA0000031    ; EBU_ADDSEL1
; unused
Data.Set 0xF0000528 %Long 0x00000000    ; EBU_ADDSEL2
Data.Set 0xF000052C %Long 0x00000000    ; EBU_ADDSEL3

Data.Set 0xF0000518 %Long 0x00000023    ; DRMSTAT (set this before DRMCON)
Data.Set 0xF0000514 %Long 0x1F000030    ; DRMCON

; --------------------------------------------------------------------------------
; flash programming
FLASH.RESet

; flash declaration for uncached address segments
FLASH.Create 1. 0xA4000000--0xA4007FFF  8000 TARGET Long
FLASH.Create 1. 0xA4008000--0xA400FFFF  4000 TARGET Long
FLASH.Create 1. 0xA4010000--0xA401FFFF 10000 TARGET Long
FLASH.Create 1. 0xA4020000--0xA43FFFFF 20000 TARGET Long
FLASH.TARGET 0xA0000000 0xA0001000 1000 ~~/demo/tricore/flash/long/am29lv100.bin

; flash declaration for cached address segments
FLASH.CreateALIAS 0x80000000--0x8FFFFFFF 0xA0000000

; --------------------------------------------------------------------------------
; show flash declaration
WinPOS 0% 0%
FLASH.List

; --------------------------------------------------------------------------------
; program flash
DIALOG.YESNO "Program all external flash memory?"
ENTRY &progflash
IF &progflash
(
  FLASH.ReProgram ALL /Erase
  Data.LOAD.auto *
  FLASH.AUTO off
)

; --------------------------------------------------------------------------------
; open some window
WinPOS 0% 50%
List.auto

ENDDO
