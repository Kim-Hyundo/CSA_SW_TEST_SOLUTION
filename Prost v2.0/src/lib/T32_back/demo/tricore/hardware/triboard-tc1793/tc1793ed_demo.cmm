; --------------------------------------------------------------------------------
; @Title: Demo script for TC1793ED on TriBoard-TC179X
; @Description:
;   Initializes the TriCore and loads the Sieve-Demo into memory.
; @Keywords: Infineon, internal, intmem, memory, sieve, TriCore
; @Author: MOB
; @Board: TriBoard-TC179X
; @Chip: TC1793ED
; @Copyright: (C) 1989-2014 Lauterbach GmbH, licensed for use with TRACE32(R) only
; --------------------------------------------------------------------------------
; $Id: tc1793ed_demo.cmm 16676 2020-10-20 08:21:08Z sltaief $


; --------------------------------------------------------------------------------
; Memory mappings:
; external SRAM                    mapped to 0xA3000000--0xA30FFFFF    1 MB
; external Flash                   mapped to 0xA4000000--0xA41FFFFF    2 MB
; internal program memory PSPR     mapped to 0xC0000000--0xC0007FFF   32 KB
;                                            0xC0200000--0xC0203FFF   16 KB
; internal data memory    DSPR     mapped to 0xD0000000--0xD001FFFF  128 KB
;                                            0xD0200000--0xD0203FFF   16 KB
;                         LMU SRAM mapped to 0xB0000000--0xB001FFFF  128 KB
; internal program flash  PFLASH0  mapped to 0xA0000000--0xA01FFFFF    2 MB
;                         PFLASH1  mapped to 0xA0800000--0xA09FFFFF    2 MB
; internal data flash     DFLASH   mapped to 0xAF000000--0xAF017FFF   96 KB
;                                            0xAF080000--0xAF097FFF   96 KB
; Notes:
; - flash memory is not declared - see tc1793ed_flash.cmm
; - memories mirrored in segment 8 (cached access):
;   - external SRAM and Flash
;   - internal PFLASH0, PFLASH1
; - memories mirrored in segment 9 (cached access):
;   - internal LMU SRAM
; - memories mirrored within their segment
;   - internal PSPR, DSPR with offset 0x08000000
; - memories not mirrored
;   - internal DFLASH0, DFLASH1

; --------------------------------------------------------------------------------
; initialize and start the debugger

RESet
SYStem.CPU TC1793ED

IF DAP.Available()
(
  ; Bi-Directional Debug Cable detected
  ; switch to DAP2 mode instead of using JTAG
  SYStem.CONFIG.DEBUGPORTTYPE DAP2
)
ELSE
(
  ; Uni-Directional Debug Cable
  ; use JTAG as default mode
  SYStem.CONFIG.DEBUGPORTTYPE JTAG
)

;In this demo, the cores runs with a very slow clock. So, the best case is to set f(MCDS)=f(CPU)
;When the application runs with a higher frequency (e.g >150MHZ), the best case is to set f(MCDS)=f(CPU)/2
Data.STARTUP.SELect 1
Data.STARTUP.SEQuence SET 0xF0000534 %Long 0yXXXXxxxxXXXX0001XXXXxxxxXXXX0000  ;set MCDSDIV=f(PLL) &  EDBBBDIV=f(PLL)/2
Data.STARTUP.ON

;Enable clock frequency computation
CLOCK.ON

SYStem.Up

; --------------------------------------------------------------------------------
; Memory initialzation
; initialize external bus unit

; enable debugger access to EBU configuration registers
; this can only be done by the TriCore core and not by a debugger attached
; via the Cerberus IO Client (e.g. JTAG/ DAP debugger)
; see Errata EBU_TC.H010 for additional information
&patchAddress="P:0xB0000000"
; step 1: save target content
&currentPC=Register(PC)
&currentA0=Register(A0)
&currentD0=Register(D0)
&currentMemory=Data.Long(&patchAddress)
; step 2: enable EBU
Register.Set A0 0xF8000004    ; EBU_MODCON
Register.Set D0 0x00000000    ; EBU_MODCON.ACCSINH=0
Data.Assemble &patchAddress st16.w [A0],D0
Register.Set PC &patchAddress
Step.single
; step 3: restore target content
Register.Set D0 &currentD0
Register.Set A0 &currentA0
Register.Set PC &currentPC
Data.Set &patchAddress %Long &currentMemory

; setup External Bus Unit
; using default CLC, EBU runs with CPU Clock/2
PER.Set D:0xF8000004 %Long 0x870000D0    ; EBU_MODCON
; /CS0: ST M58BW16FB4T3 FLASH
PER.Set D:0xF8000018 %Long 0xA4000053    ; EBU_ADDRSEL0
PER.Set D:0xF8000028 %Long 0x50D30040    ; EBU_BUSRCON0
PER.Set D:0xF8000030 %Long 0x50D30000    ; EBU_BUSWCON0
PER.Set D:0xF800002C %Long 0x00000400    ; EBU_BUSRAP0, 8 waitstates
PER.Set D:0xF8000034 %Long 0x00000400    ; EBU_BUSWAP0, 8 waitstates
; /CS1: ISSI IS61WV25616BL-10TLI SRAM
PER.Set D:0xF800001C %Long 0xA3000073    ; EBU_ADDRSEL1
PER.Set D:0xF8000038 %Long 0x40D30040    ; EBU_BUSRCON1
PER.Set D:0xF8000040 %Long 0x40D30000    ; EBU_BUSWCON1
PER.Set D:0xF800003C %Long 0x00000000    ; EBU_BUSRAP1, 1 waitstate
PER.Set D:0xF8000044 %Long 0x00000000    ; EBU_BUSWAP1, 1 waitstate
; /CS2, /CS3: unused

; --------------------------------------------------------------------------------
; load demo program
Data.LOAD.Elf "~~~~/triboard-tc1798_sieve_intmem.elf"
Go.direct main

; --------------------------------------------------------------------------------
; select trace method
IF !Analyzer()
  Trace.METHOD Onchip

; --------------------------------------------------------------------------------
; set up MCDS trace
Trace.OFF

; --------------------------------------------------------------------------------
; open some windows
WinCLEAR
WinPOS 0% 0% 100% 50%
List.auto
WinPOS 0% 50% 50% 50%
Frame.view /Locals /Caller
WinPOS 50% 50% 50% 50%
Var.Watch
Var.AddWatch ast flags

ENDDO
