; --------------------------------------------------------------------------------
; @Title: Flash demo script for TC277TE-Astep on TriBoard-TC2x7 (any app)
; @Description:
;   Allows you to flash your application into memory. Please make sure to
;   understand the comments in the script!
; @Keywords: AURIX, Infineon, TriCore
; @Author: MOB
; @Board: TriBoard-TC2x7
; @Chip: TC277TE
; @Copyright: (C) 1989-2020 Lauterbach GmbH, licensed for use with TRACE32(R) only
; --------------------------------------------------------------------------------
; $Id: tc277te-astep_flash.cmm 15579 2020-01-27 15:08:53Z sltaief $


; Redirect to example script for flash declaration and programming of Infineon
; TriCore TC277TE-Astep internal flash.

; configure/program internal flash
DO ~~/demo/tricore/flash/tc27x.cmm CPU=TC277TE-Astep

; After flashing the symbols can be loaded with:
; Data.LOAD.Elf *.elf /NoCODE

ENDDO
