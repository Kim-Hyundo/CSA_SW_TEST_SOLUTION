; --------------------------------------------------------------------------------
; @Title: Demo script for TriCore TC1130 on Infineon (TSIM) and TRACE32 simulator
; @Description:
;   Loads the Sieve-Demo into memory using the Infineon TSIM simulator.
;
;   Note that TSIM is depreciated and just supported for backwards compatibility.
;   Recommendation is to use the TRACE32 internal simulator: PBI=SIM
;
;   For using Infineon TSIM simulator, modify your config.t32
;   PBI=GDI tsim.dll ; for TriCore 1.x architectures
;   PBI=GDI tsim2.dll ; for TriCore 2.x architectures
;
; @Keywords: Infineon, simulator, TriCore
; @Author: MAX
; @Chip: TC1130
; @Copyright: (C) 1989-2014 Lauterbach GmbH, licensed for use with TRACE32(R) only
; --------------------------------------------------------------------------------
; $Id: demo.cmm 8288 2015-04-07 07:30:14Z mobermaier $


; --------------------------------------------------------------------------------
; initialize and start the debugger
RESet
SYStem.CPU TC1130
SYStem.Up

; Hardware configuration:
; The Lauterbach simulator does not simulate any hardware.
; The Infineon TSIM simulator does simulate some hardware, please refer
; to the infineon TSIM documentation for more information.
;
; Memory mapping:
; The Lauterbach simulator has memory everywhere. For enabling a memory
; area simply do a write access there. A read access to a disabled area
; will produce a bus error.
; The Infineon GDI simulator has predefined memory mappings depending on
; the device (usually internal memory). These mappings do not necessarily
; correspond to the memory availiable on the TriBoards, so configuration
; files have to be provided.
;
; TSIM configuration files
; The Infineon TSIM simulator may require some configuration files for
; describing the hardware configuration (e.g. memory mapping). Some
; predefined examples can be found in the various subdirectories, the
; files have be copied to the TRACE32 installation directory.
; The examples describe the configuration of the CPU and - if necessary -
; the standard configuration of the Infineon TriBoard. This makes it
; possible to use the demos from ../hardware/triboard-*

; --------------------------------------------------------------------------------
; load demo program
Data.LOAD.Elf "~~~~/demo.elf"
Go.direct main

; open some windows
WinCLEAR
WinPOS 0% 0% 100% 50%
List.auto
WinPOS 0% 50% 50% 50%
Frame.view /Locals /Caller
WinPOS 50% 50% 50% 50%
Var.Watch
Var.AddWatch ast flags

ENDDO
