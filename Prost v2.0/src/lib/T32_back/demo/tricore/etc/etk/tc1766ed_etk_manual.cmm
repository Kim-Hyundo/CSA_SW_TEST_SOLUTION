; --------------------------------------------------------------------------------
; @Title: Startup demo script for ETK arbitration with TC1766 on TriBoard TC1766
; @Description:
;   The script shows a manual setup of ETK support for TRACE32 versions without
;   ETK autodetection or when autodetection fails.
;
;   First, have the debug cable disconnected from the target, otherwise the
;   debugger will hold the target in reset.
;   There are several strategies possible setting up the debugger for use
;   with an ETK, depending on the user's requirements.
;
;   Hints:
;   - for using SYStem.Up, SYStem.CONFIG SLAVE ON is required
;   - for information about known issues see the demo scripts in
;     demo/tricore/hardware/
;
; @Keywords: etk, Infineon, TriCore
; @Author: MAX
; @Board: TriBoard-TC1766
; @Chip: TC1766ED
; @Copyright: (C) 1989-2014 Lauterbach GmbH, licensed for use with TRACE32(R) only
; --------------------------------------------------------------------------------
; $Id: tc1766ed_etk_manual.cmm 7580 2014-08-27 15:28:49Z mobermeir $


; --------------------------------------------------------------------------------
; Performed tests:
; Dip Switch S301:      SW1=ON,  SW2=OFF, SW3=ON,  SW4=ON,
;                       SW5=OFF, SW6=ON,  SW7=OFF, SW8=OFF
; TriBoard TC1766.300 TC1766ED EES-BB 2007-03-21 MAX
;
; --------------------------------------------------------------------------------
; Memory mappings:
; processor internal RAM (LDRAM)      56 KB 0xD0000000--0xD000DFFF
; processor internal RAM (SPRAM)      16 KB 0xD4000000--0xD4003FFF
; processor internal program flash   1.5 MB 0xA0000000--0xA0177FFF
; processor internal data flash       16 KB 0xAFE00000--0xAFE03FFF (Bank 0)
;                                     16 KB 0xAFE10000--0xAFE13FFF (Bank 1)

; --------------------------------------------------------------------------------
; initialize and start the debugger

RESet
SYStem.CPU TC1766ED
//SYStem.Option WDTFIX ON          ; only required for A-Step devices
//SYStem.JtagClock 10.0MHz         ; default, recommended minimum

; configure for arbitration with ETK
SYStem.CONFIG PortSHaRing ON
SYStem.Mode   NoDebug

; recommendation is to set SYStem.CONFIG values to defaults
//SYStem.CONFIG TRISTATE OFF    ; do not tristate debug cable when not
//                              ; accessing target (recommended)
//SYStem.CONFIG SLAVE ON        ; prevent debugger from performing
//                              ; any reset (optional)
//SYStem.CONFIG TCKLEVEL 0.     ; pulldown on TCK (required)
//SYStem.CONFIG TAPSTATE 12.    ; Run-Test/ Idle  (required)

; Now it is save to connect the debug cable to the target.
; Memory accesses to invalid addresses should be avoided, otherwise ETK
; may be blocked too long.

SYStem.Option DUALPORT ON          ; enable realtime memory access
SYStem.Mode Attach                 ; connect to target

; --------------------------------------------------------------------------------
; open a window

WinCLEAR
Data.dump 0xD0000000

ENDDO
