// T32_1000663 Thu Jul  2 12:46:26 2020

B::

BMC.RESet
BMC.PMN0.EVENT CM1_STALL
BMC.PMN0.RATIO OFF
BMC.PMN0.SIZE 16BIT
BMC.PMN0.TRIGMODE TRACEOVERFLOW
BMC.PMN0.TRIGVAL 0x2
BMC.PMN1.EVENT CM1_BRMISS
BMC.PMN1.RATIO OFF
BMC.PMN1.SIZE 16BIT
BMC.PMN1.TRIGMODE TRACEOVERFLOW
BMC.PMN1.TRIGVAL 0x2
BMC.PMN2.EVENT CM1_ICMISS
BMC.PMN2.RATIO OFF
BMC.PMN2.SIZE 16BIT
BMC.PMN2.TRIGMODE TRACEOVERFLOW
BMC.PMN2.TRIGVAL 0x2
BMC.PMN4.EVENT CM1_DCMISS
BMC.PMN4.RATIO OFF
BMC.PMN4.SIZE 16BIT
BMC.PMN4.TRIGMODE TRACEOVERFLOW
BMC.PMN4.TRIGVAL 0x2

ENDDO
