; --------------------------------------------------------------------------------
; @Title: Demo showing BMC based runtime measurement on TC3xx
; @Description:
;   Shows how to measure average function runtime using the benchmark counter
;   system
; @Keywords: AURIX, BMC, runtime
; @Author: MEI
; @Chip: TC3*
; @Copyright: (C) 1989-2014 Lauterbach GmbH, licensed for use with TRACE32(R) only
; --------------------------------------------------------------------------------
; $Id: runtime_demo.cmm 15643 2020-02-05 11:24:05Z meick $

IF interface.SIM()
(
  PRINT %ERROR "demo does not work in simulator"
  ENDDO
)

LOCAL &ElfFile 
GOSUB SelectCPUandELF

SYStem.Up
Data.LOAD.Elf &ElfFile

PRIVATE &ppd
&ppd=OS.PPD()
DO &ppd/runtime_capture.cmm prepare

WinPos 0% 0% 50% 100%
BTrace.STATistic.sYmbol
WinPos 50% 0% 50% 100% ,,,,, "Double click symbol name to capture function"
sYmbol.Browse.Function * /Click "DO &ppd/runtime_capture.cmm exec ""*"" ""1s"""

Go.direct

DO &ppd/runtime_capture.cmm exec "func1" "1.s"

ENDDO

SelectCPUandELF:
(
  PRIVATE &name &series &package
  SYStem.DETECT CPU
  &name=STRing.LOWER(CPU())
  &package=STRing.MID("&name",4.,1.)
  IF CPUIS("TC3???A")
  (
    &package="&(package)-adas"
  )
  IF CPUIS("TC3*")
  (
    &ElfFile="~~~~/../../hardware/triboard-tc3x&(package)/&(name)/"+STRing.MID("&name",0.,4)+"x_sieve_intmem.elf"
  )
  ELSE
  (
    PRINT %ERROR "CPU &name not supported by demo"
    ENDDO
  )
  RETURN
)
