// T32_1000663 Thu Jul  2 12:46:23 2020

B::

BMC.RESet
BMC.PMN0.EVENT CM1_STALL
BMC.PMN0.RATIO OFF
BMC.PMN0.SIZE 16BIT
BMC.PMN0.TRIGMODE TRACEOVERFLOW
BMC.PMN0.TRIGVAL 0x2

ENDDO
