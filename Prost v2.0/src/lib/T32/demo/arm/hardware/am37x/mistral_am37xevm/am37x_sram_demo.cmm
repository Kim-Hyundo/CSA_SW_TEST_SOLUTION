; --------------------------------------------------------------------------------
; @Title: Demo script for the Mistral AM37x Board
; @Description:
;   This demo demonstrates the debugging of the Cortex-A8 core of the AM3715
;   using a simple sieve demo loaded on the SRAM. The scripts also configures
;   the clock and disable the watchdog timer using Data.Set commands.
; @Keywords: AM37*, Cortex-A8, sieve, watchdog
; @Author: KJM
; @Board: AM37XEVM
; @Chip: AM3715
; @Copyright: (C) 1989-2019 Lauterbach GmbH, licensed for use with TRACE32(R) only
; --------------------------------------------------------------------------------
; $Id: am37x_sram_demo.cmm 15217 2019-11-04 16:17:15Z bschroefel $


RESet

; setup of ICD

 print "initializing..."
 SYStem.RESet
 SYStem.CPU AM3715
 SYStem.JtagClock 1Mhz          ; start with a fix JTAG clock,
                                ; otherwise every second system.up fails with an RTCK error
 SYStem.Option DACR ON          ; give Debugger global write permissions
 SYStem.Option ResBreak OFF     ; hardware dependent (see manual)
 SYStem.Option WaitReset ON     ; hardware dependent (see manual)
 SYStem.Up
 SYStem.JtagClock RTCK

 ; Enable Interface Clock
 Data.Set 0x48004C10 %Long 0x20

 ; Enable functional clock
 Data.Set 0x48004C00 %l 0x20

 ; Check that module is IDLE
 WAIT (Data.Long(SD:0x48004C20)&0x20)==0

 ; Disable watchdog timer
 Data.Set SD:0x48314048 %LE %Long 0x0000AAAA
 WAIT (Data.Long(SD:0x48314034)&0x10)==0

 Data.Set SD:0x48314048 %LE %Long 0x00005555
 WAIT (Data.Long(SD:0x48314034)&0x10)==0

 ; Check if the watchdog timer is running
 IF (Data.Long(SD:0x48314048)!=0x00005555)
 (
     ; Disable Watchdog 2
     ; Wait until reset complete
     WAIT (Data.LONG(SD:0x48314014)&0x01)!=0

     ; Disable 32Khz watchdog timer
     Data.Set 0x48314048 %Long 0x0000AAAA

     WAIT (Data.Long(SD:0x48314034)&0x10)==0

     ; Disable 32Khz watchdog timer
     Data.Set 0x48314048 %Long 0x00005555

     WAIT (Data.Long(SD:0x48314034)&0x10)==0
  )

 Data.LOAD.ELF ~~~~/demo.axf
 Register.Set PC main
 Register.Set R13 0x4020f000

 ; open some windows
 WinCLEAR
 WinPOS 0% 0% 100% 50%
 List.auto
 WinPOS 0% 50% 50% 50%
 Frame /Locals /Caller
 WinPOS 50% 50% 50% 50%
 Var.Watch
 Var.AddWatch ast; flags;

 ENDDO
