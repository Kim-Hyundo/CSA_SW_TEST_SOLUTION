; --------------------------------------------------------------------------------
; @Props: NoMetaTags
; @Author: TI
; @Copyright: -
; --------------------------------------------------------------------------------
; $Id: omap4430_disable_watchdog.cmm 8886 2015-11-18 18:06:51Z mobermeir $

ENTRY

IF (&DEBUG_INFO==1)
(
  AREA.Select results
  PRINT "DISABLE WATCHDOG ..."
)

// Enable Clock
Data.Set SR:0x4A307830 %Long 0x02

// Check that module is IDLE
WHILE ((Data.Long(SR:0x4A307830)&0x20000)==0x20000) 

// Wait until reset complete 
WHILE ((Data.Long(SR:0x4A314014)&0x01)!=0x1)

//Disable watchdog timer
Data.Set SR:0x4A314048 %LE %Long 0x0000AAAA;
WHILE ((Data.Long(SR:0x4A314034)&0x10)==0x10)

Data.Set SR:0x4A314048 %LE %Long 0x00005555;
WHILE ((Data.Long(SR:0x4A314034)&0x10)==0x10)

IF (&DEBUG_INFO==1)
(
  PRINT " EXITING DISABLE WATCHDOG ..."
)

ENDDO
