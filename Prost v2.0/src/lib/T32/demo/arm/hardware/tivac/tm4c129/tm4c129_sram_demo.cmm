; --------------------------------------------------------------------------------
; @Title: Run a Sieve demo in SRAM for the TM4C1294NCPDT Tiva C series
; @Description:
;   This demo shows how to connect TRACE32 to the TM4C1294NCPDT Cortex-M4F
;   EK-TM4C129XL Rev D Board and load a simple sieve demo on SRAM
;   and start a debug session
;
;     SRAM  : 0x20000000--0x2003FFFF (16Kb)
;
; @Keywords: Cortex-M4F, Tiva, sieve
; @Author: MSA
; @Board: EK-TM4C129XL
; @Chip: TM4C1294NCPDT
; @Copyright: (C) 1989-2019 Lauterbach GmbH, licensed for use with TRACE32(R) only
; --------------------------------------------------------------------------------
; $Id: tm4c129_sram_demo.cmm 15223 2019-11-05 16:29:45Z bschroefel $

  RESet
  SYStem.RESet

  SYStem.CPU TM4C1294NCPDT

  SYStem.Up

  Data.LOAD.Elf ~~~~/sieve_ram_thumb_ii_v7.elf

; open some windows
  WinCLEAR

  WinPOS 0% 0% 50% 50%
  List.auto

  WinPOS 50% 0% 50% 50%
  Register.view /SpotLight

  WinPOS 0% 50% 50% 50%
  Frame /Locals /Caller

  WinPOS 50% 50% 50% 50%
  Var.DRAW sinewave

  GO
  WAIT STATE.RUN()
  Break
  ENDDO
