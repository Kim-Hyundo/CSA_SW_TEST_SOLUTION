; --------------------------------------------------------------------------------
; @Title: Simple sieve demo running in RAM
; @Description:
;   Run a simple sieve demo in onchip SRAM and demonstrate SWV trace.
;   The ITMTrace.List window will show all writes to the mcount variable.
;   Tested with Combiprobe and uTrace.
;   Prerequisites:
;     - Connect uTrace or Combiprobe with MIPI10 cable to
;       the JTAG/DEBUG connector
;
; @Keywords: Cortex-M4 SWV SerialWriteViewer SerialWireOut
; @Author: AME
; @Board: DK-TM4C123G
; @Chip: TM4C123GH6PGE
; @Copyright: (C) 1989-2019 Lauterbach GmbH, licensed for use with TRACE32(R) only
; --------------------------------------------------------------------------------
; $Id: dk-tm4c123g_sieve_swv_trace_ram.cmm 15217 2019-11-04 16:17:15Z bschroefel $

; connect
RESet
SYStem.RESet
SYStem.CPU TM4C123GH6PGE
SYStem.CONFIG.CONNECTOR MIPI20T
SYStem.CONFIG.DEBUGPORTTYPE SWD
IF VERSION.BUILD.BASE()<58225.
( 
  SYStem.Option ResBreak OFF
  SYStem.Option WaitReset 50.0ms
)
SYStem.Up

; Load Demo
Data.LOAD.Elf ~~~~/sieve_ram_thumb_ii_v7.elf
; execute startcode
Go main
WAIT !STATE.RUN()

IF CAnalyzer()
(
  ; switch to SWV mode with TRACECLK/4
  ITM.PortSize SWV
  ITM.PortMode NRZ/4
  ITM.DataTrace ON
  ITM.ON
 
  ; use autocalibration using CAnalyzer.AutoFocus
  Trace.Method CAnalyzer
  CAnalyzer.AutoFocus
  
  ; record all writes to mcount
  Var.Break.Set mcount /Write /TraceData
  ITMTrace.List
)

; open some windows
Mode.Hll
List.auto

ENDDO
