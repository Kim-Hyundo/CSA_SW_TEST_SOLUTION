; --------------------------------------------------------------------------------
; @Title: Demo script for IMX7ULP-CA7 on MCIMX7ULP with Onchip-Trace (RAM)
; @Description:
;   Loads the sieve demo application into RAM and sets up a demo debug
;   scenario.
;   The program flow is traced using the Onchip-Trace.
;   Prerequisites:
;    * Connect Debug Cable to header JTAG
;      or
;      Connect Combiprobe/uTrace to header JTAG
;    * set SW1 to 0y1001 (default, internal boot)
; @Keywords: ARM, Cortex-A7, ETM, ETR
; @Author: AME
; @Board: MCIMX7ULP
; @Chip: IMX7ULP
; @Copyright: (C) 1989-2019 Lauterbach GmbH, licensed for use with TRACE32(R) only
; --------------------------------------------------------------------------------
; $Id: imx7ulp-ca7_sieve_onchip_etr_trace_sram.cmm 15217 2019-11-04 16:17:15Z bschroefel $


WinCLEAR

; --------------------------------------------------------------------------------
; initialize and start the debugger
RESet
SYStem.RESet
SYStem.CPU IMX7ULP-CM4
SYStem.CONFIG.DEBUGPORTTYPE JTAG
SYStem.MemAccess DAP
SYStem.JtagClock CTCK 10MHz
Trace.DISable
SYStem.Up

; --------------------------------------------------------------------------------
; start CA7 manually - bypassing BOOTROM of CM4
Data.Set AD:0x410A1024 %Long Data.Long(AD:0x410A1024)|0x01000000
Data.Set AD:0x41026088 %Long Data.Long(AD:0x41026088)|0x40000000
Data.Set AD:0x41022064 %Long Data.Long(AD:0x41022064)&~0x80

; --------------------------------------------------------------------------------
; trace setup
; set PCC1-PCC_TPIU PCS to 5 (M4_BUS_CLK)
; as the ATB Replicators are clocked from TPIU-CLK also necessary for ETR
Data.Set AD:0x410B2050 %Long Data.Long(AD:0x410B2050)|(5.<<24.)
Data.Set AD:0x410B2050 %Long Data.Long(AD:0x410B2050)|(1.<<30.)

; set SWO TPIU to Integration mode - prevent backpressure
Data.Set DAP:0x80017EF0 %Long 0x1
Data.Set DAP:0x80017F00 %Long 0x1

; --------------------------------------------------------------------------------
; initialize and start the debugger for A7
SYStem.Down
SYStem.CPU IMX7ULP-CA7
SYStem.Mode.Attach
IF STATE.RUN()
  Break

; --------------------------------------------------------------------------------
; load demo program (uses internal RAM only)
Data.LOAD.Elf "~~~~/sieve_pic_arm.elf"

; --------------------------------------------------------------------------------
; initialize ONCHIP trace (ETR)
; these settings are generated by calling
;   DO ~~/demo/arm/etc/embedded_trace_router/etr_utility.cmm
; - we use hardcoded values for SRAM1 here
PRIVATE &EtrAxiBase &EtrSize
&EtrAxiBase=0x2f020000
&EtrSize=0x20000/4.
DO "~~/demo/arm/etc/embedded_trace_router/etr_utility.cmm" ETR1 set DAB    &EtrAxiBase
DO "~~/demo/arm/etc/embedded_trace_router/etr_utility.cmm" ETR1 set RSZ    &EtrSize
DO "~~/demo/arm/etc/embedded_trace_router/etr_utility.cmm" ETR1 set AXICTL 0x00000F00 0x00000FBF
Trace.METHOD ONCHIP
Trace.TraceCONNECT ETR
Trace.AutoInit ON
ETM.Trace ON
GOSUB EtmTimestampCalibration
ETM.ON

; --------------------------------------------------------------------------------
; start program execution
Go.direct main
WAIT !STATE.RUN()

; --------------------------------------------------------------------------------
; open some windows
WinCLEAR
Mode.Hll
WinPOS 0. 0.
List.auto
WinPOS 120. 0. 100. 8.
Frame.view
WinPOS 120. 14.
Var.Watch
Var.AddWatch %SpotLight ast flags
WinPOS 120. 25.
Trace.List
WinPOS 0. 32.
Var.DRAW %DEFault sinewave

ENDDO

; --------------------------------------------------------------------------------

DisableWatchdog:
(
  ; not possible, CM4 is in stopped mode -> CM4 Watchdog is stopped per default
  RETURN
)

; start the timestamp generator and count the number of ticks in one second
EtmTimestampCalibration: ;()
(
  PRIVATE &tmp
  Data.Set DAP:0x80018000 %Long 0x00000001
  &tmp=Data.Quad(DAP:0x80018000+0x8)
  WAIT 1.s
  &tmp=Data.Quad(DAP:0x80018000+0x8)-&tmp
  ETM.TimeStampClock &(tmp)
  ETM.TimeStamps ON
  RETURN
)