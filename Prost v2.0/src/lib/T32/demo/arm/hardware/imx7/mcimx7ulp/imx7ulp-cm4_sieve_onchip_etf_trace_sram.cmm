; --------------------------------------------------------------------------------
; @Title: Demo script for IMX7ULP-CM4 on MCIMX7ULP with Onchip-Trace (RAM)
; @Description:
;   Loads the sieve demo application into RAM and sets up a demo debug
;   scenario.
;   The program flow is traced using the Onchip-Trace.
;   Prerequisites:
;    * Connect Debug Cable to header JTAG
;      or
;      Connect Combiprobe/uTrace to header JTAG
;    * set SW1 to 0y1001 (default, internal boot)
; @Keywords: ARM, Cortex-M4, ETF, ETM
; @Author: AME
; @Board: MCIMX7ULP
; @Chip: IMX7ULP
; @Copyright: (C) 1989-2019 Lauterbach GmbH, licensed for use with TRACE32(R) only
; --------------------------------------------------------------------------------
; $Id: imx7ulp-cm4_sieve_onchip_etf_trace_sram.cmm 15217 2019-11-04 16:17:15Z bschroefel $


WinCLEAR

; --------------------------------------------------------------------------------
; initialize and start the debugger
RESet
SYStem.RESet
SYStem.CPU IMX7ULP-CM4
SYStem.CONFIG.DEBUGPORTTYPE JTAG
SYStem.Option DUALPORT ON
SYStem.MemAccess DAP
SYStem.JtagClock CTCK 10MHz
Trace.DISable
SYStem.Up

GOSUB DisableWatchdog

; --------------------------------------------------------------------------------
; initialize onchip-trace (ETM ON, ITM OFF)
Trace.METHOD Onchip
Trace.AutoInit ON
ETM.Trace ON
GOSUB EtmTimestampCalibration
ETM.ON

; --------------------------------------------------------------------------------
; load demo program (uses internal RAM only)
Data.LOAD.Elf "~~~~/sieve_ram_thumb_ii_v7m.elf"

; --------------------------------------------------------------------------------
; start program execution
Go.direct main
WAIT !STATE.RUN()

; --------------------------------------------------------------------------------
; open some windows
WinCLEAR
Mode.Hll
WinPOS 0. 0.
List.auto
WinPOS 120. 0. 100. 8.
Frame.view
WinPOS 120. 14.
Var.Watch
Var.AddWatch %SpotLight ast flags
WinPOS 120. 25.
Trace.List
WinPOS 0. 32.
Var.DRAW %DEFault sinewave

ENDDO

; --------------------------------------------------------------------------------

DisableWatchdog:
(
  ; not possible, code continuously triggers the watchdog
  RETURN
)

; start the timestamp generator and count the number of ticks in one second
EtmTimestampCalibration: ;()
(
  PRIVATE &tmp
  Data.Set DAP:0x80018000 %Long 0x00000001
  &tmp=Data.Quad(DAP:0x80018000+0x8)
  WAIT 1.s
  &tmp=Data.Quad(DAP:0x80018000+0x8)-&tmp
  ETM.TimeStampClock &(tmp)
  ETM.TimeStamps ON
  RETURN
)
