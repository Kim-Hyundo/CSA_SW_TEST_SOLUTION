; --------------------------------------------------------------------------------
; @Title: Simple demo script for IMX7ULP-CA7 on MCIMX7ULP (RAM)
; @Description:
;   Loads the sieve demo application into RAM and sets up a demo debug
;   scenario.
;   The CA7 is normally kicked by the CM4 BootROM. For simplicity we stop the M4
;   right after reset and start the CA7 using the debugger.
;   Use this script for getting started.
;   Prerequisites:
;    * Connect Debug Cable to header JTAG
;      or
;      Connect Combiprobe/uTrace to header JTAG
;    * set SW1 to 0y1001 (default, internal boot)
; @Keywords: ARM, Cortex-A7
; @Author: AME
; @Board: MCIMX7ULP
; @Chip: IMX7ULP
; @Copyright: (C) 1989-2019 Lauterbach GmbH, licensed for use with TRACE32(R) only
; --------------------------------------------------------------------------------
; $Id: imx7ulp-ca7_sieve_sram.cmm 15217 2019-11-04 16:17:15Z bschroefel $


WinCLEAR

; --------------------------------------------------------------------------------
; initialize and start the debugger for M4
RESet
SYStem.RESet
SYStem.CPU IMX7ULP-CM4
SYStem.CONFIG.DEBUGPORTTYPE JTAG
SYStem.Option DUALPORT ON
SYStem.MemAccess DAP
SYStem.JtagClock CTCK 10MHz
Trace.DISable
SYStem.Up

GOSUB DisableWatchdog

; --------------------------------------------------------------------------------
; start CA7 manually - bypassing BOOTROM of CM4
Data.Set AD:0x410A1024 %Long Data.Long(AD:0x410A1024)|0x01000000
Data.Set AD:0x41026088 %Long Data.Long(AD:0x41026088)|0x40000000
Data.Set AD:0x41022064 %Long Data.Long(AD:0x41022064)&~0x80

; --------------------------------------------------------------------------------
; initialize and start the debugger for A7
SYStem.Down
SYStem.CPU IMX7ULP-CA7
SYStem.Mode.Attach
IF STATE.RUN()
  Break

; --------------------------------------------------------------------------------
; load demo program (uses internal RAM only)
Data.LOAD.Elf "~~~~/sieve_pic_arm.elf"

; --------------------------------------------------------------------------------
; start program execution
Go.direct main
WAIT !STATE.RUN()

; --------------------------------------------------------------------------------
; open some windows
WinCLEAR
Mode.Hll
WinPOS 0. 0.
List.auto
WinPOS 120. 0. 100. 8.
Frame.view
WinPOS 120. 14.
Var.Watch
Var.AddWatch %SpotLight ast flags
WinPOS 120. 25.
Register.view /SpotLight
WinPOS 0. 32.
Var.DRAW %DEFault sinewave

ENDDO

DisableWatchdog:
(
  ; not possible, CM4 is in stopped mode -> CM4 Watchdog is stopped per default
  RETURN
)


