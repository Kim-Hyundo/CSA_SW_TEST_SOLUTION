; --------------------------------------------------------------------------------
; @Title: Demo script for IMX7DUAL-CA7 with Offchip-Trace (RAM)
; @Description:
;   Loads the sieve demo application into RAM and sets up a demo debug
;   scenario.
;   The program flow is traced using the Offchip-Trace.
;   Pinmuxing setup is handled in the script.
;   Use this script to test the Offchip-Trace.
;   Prerequisites:
;    * Connect Debug Cable / CombiProbe to J12 (remove pin 7)
;    * Connect AutoFocus Preprocessor Mictor cable to J14 via trace converter MCIMX.
;    * set BOOTMODE SW3[1..2]=0y10 - Internal Boot
;    * set SW2[1..8]=0y00100000 - SD-Card
;    * remove SD-Card
; @Keywords: ARM, Cortex-A7, ETM
; @Author: AME
; @Board: MCIMX7SABRE, iMX7D SABRE
; @Chip: IMX7DUAL-CA7
; @Copyright: (C) 1989-2019 Lauterbach GmbH, licensed for use with TRACE32(R) only
; --------------------------------------------------------------------------------
; $Id: mcimx7sabre_sieve_offchip_trace_sram.cmm 15217 2019-11-04 16:17:15Z bschroefel $


WinCLEAR
; --------------------------------------------------------------------------------
; check prerequisites
IF VERSION.BUILD.BASE()<75701.
(
  PRINT %ERROR "Please use more recent Software! Contact support@lauterbach.com."
  ENDDO
)

; --------------------------------------------------------------------------------
; initialize and start the debugger
RESet
SYStem.RESet
SYStem.CPU IMX7DUAL-CA7
SYStem.Option ResBreak OFF
SYStem.Option WaitReset 30.0ms
SYStem.JtagClock CTCK 10MHz
Trace.DISable
CORE.ASSIGN 1.
SYStem.Up

; --------------------------------------------------------------------------------
; load demo program (uses internal RAM only)
Data.LOAD.Elf "~~~~/sieve_ram_arm_v7.elf"

; --------------------------------------------------------------------------------
; start program execution
Go.direct main
WAIT !STATE.RUN()

; --------------------------------------------------------------------------------
; initialize OFFCHIP trace if Analyzer is plugged (ETM)
IF Analyzer()
(
  ; set the pin-multiplexing for the off-chip trace (SW_MUX_CTL_PAD_LCD_DATAxx=ALT2)
  Data.Set AD:0x303300c8 %Long 0x2
  Data.Set AD:0x303300cc %Long 0x2
  Data.Set AD:0x303300d0 %Long 0x2
  Data.Set AD:0x303300d4 %Long 0x2
  Data.Set AD:0x303300d8 %Long 0x2
  Data.Set AD:0x303300dc %Long 0x2
  Data.Set AD:0x303300e0 %Long 0x2
  Data.Set AD:0x303300e4 %Long 0x2
  Data.Set AD:0x303300e8 %Long 0x2
  Data.Set AD:0x303300ec %Long 0x2
  Data.Set AD:0x303300f0 %Long 0x2
  Data.Set AD:0x303300f4 %Long 0x2
  Data.Set AD:0x303300f8 %Long 0x2
  Data.Set AD:0x303300fc %Long 0x2
  Data.Set AD:0x30330100 %Long 0x2
  Data.Set AD:0x30330104 %Long 0x2
  Data.Set AD:0x30330108 %Long 0x2
  Data.Set AD:0x3033010c %Long 0x2

  ; set the pin driving strength for the off-chip trace (SW_PAD_CTL_PAD_LCD_DATAxx)
  Data.Set AD:0x30330338 %Long 0x3
  Data.Set AD:0x3033033c %Long 0x3
  Data.Set AD:0x30330340 %Long 0x3
  Data.Set AD:0x30330344 %Long 0x3
  Data.Set AD:0x30330348 %Long 0x3
  Data.Set AD:0x3033034c %Long 0x3
  Data.Set AD:0x30330350 %Long 0x3
  Data.Set AD:0x30330354 %Long 0x3
  Data.Set AD:0x30330358 %Long 0x3
  Data.Set AD:0x3033035c %Long 0x3
  Data.Set AD:0x30330360 %Long 0x3
  Data.Set AD:0x30330364 %Long 0x3
  Data.Set AD:0x30330368 %Long 0x3
  Data.Set AD:0x3033036c %Long 0x3
  Data.Set AD:0x30330370 %Long 0x3
  Data.Set AD:0x30330374 %Long 0x3
  Data.Set AD:0x30330378 %Long 0x3
  Data.Set AD:0x3033037c %Long 0x3

  Trace.Method Analyzer
  TPIU.PortSize 16
  TPIU.PortMode Continuous
  ETM.Trace ON
  ETM.DataTrace OFF
  ETM.ON
  ; use Autofocus based calibration
  Analyzer.AutoFocus
)

; --------------------------------------------------------------------------------
; open some windows
WinCLEAR
Mode.Hll
WinPOS 0. 0. 116. 26.
List.auto
WinPOS 120. 0. 100. 8.
Frame.view
WinPOS 120. 14.
Var.Watch
Var.AddWatch %SpotLight ast flags
WinPOS 120. 25.
Trace.List
WinPOS 0. 32.
Var.DRAW %DEFault sinewave

ENDDO
