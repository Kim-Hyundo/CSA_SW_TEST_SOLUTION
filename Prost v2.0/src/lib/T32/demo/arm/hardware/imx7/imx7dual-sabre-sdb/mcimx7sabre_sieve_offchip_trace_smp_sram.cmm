; --------------------------------------------------------------------------------
; @Title: SMP-Demo script for IMX7DUAL-CA7 with Offchip-Trace (RAM, SMP)
; @Description:
;   Loads the sieve demo application into RAM and sets up a demo debug
;   scenario.
;   The program flow is traced using the Offchip-Trace.
;   Pinmuxing setup is handled in the script.
;   As not all cores are accessible after Reset (SYStem.Up) we handle the start
;   of the secondary cores in the script and switch to SMP later.
;   Use this script to test the Offchip-Trace.
;   Prerequisites:
;    * Connect Debug Cable / CombiProbe to J12 (remove pin 7)
;    * Connect AutoFocus Preprocessor Mictor cable to J14 via trace converter MCIMX.
;    * set BOOTMODE SW3[1..2]=0y10 - Internal Boot
;    * set SW2[1..8]=0y00100000 - SD-Card
;    * remove SD-Card
; @Keywords: ARM, Cortex-A7, ETM, SMP
; @Author: AME
; @Board: MCIMX7SABRE, iMX7D SABRE
; @Chip: IMX7DUAL-CA7
; @Copyright: (C) 1989-2019 Lauterbach GmbH, licensed for use with TRACE32(R) only
; --------------------------------------------------------------------------------
; $Id: mcimx7sabre_sieve_offchip_trace_smp_sram.cmm 15217 2019-11-04 16:17:15Z bschroefel $


WinCLEAR
; --------------------------------------------------------------------------------
; check prerequisites
IF VERSION.BUILD.BASE()<75701.
(
  PRINT %ERROR "Please use more recent Software! Contact support@lauterbach.com."
  ENDDO
)

; --------------------------------------------------------------------------------
; initialize and start the debugger
RESet
SYStem.RESet
SYStem.CPU IMX7DUAL-CA7
SYStem.Option ResBreak OFF
SYStem.Option WaitReset 30.0ms
SYStem.JtagClock CTCK 10MHz
Trace.DISable
CORE.ASSIGN 1.    ; select only master core 1 - 1. first core, 2. second core, 1. 2. first + second core (SMP) ...
SYStem.Up

; --------------------------------------------------------------------------------
; kick secondary cores
GOSUB KickCA7


; disconnect from system and reattach in SMP mode
SYStem.Mode.Down
CORE.ASSIGN 1. 2.
SYStem.Mode.Attach

IF STATE.RUN()
  Break.direct

; --------------------------------------------------------------------------------
; load demo program (uses internal RAM only)
CORE.select 0.
Data.LOAD.Elf "~~~~/sieve_ram_arm_v7.elf"
; Set PC for all secondary cores
Register.Set T 0 /CORE 1.
Register.Set PC _start /CORE 1.

; --------------------------------------------------------------------------------
; start program execution
Go.direct main
WAIT !STATE.RUN()

; --------------------------------------------------------------------------------
; initialize OFFCHIP trace if Analyzer is plugged (ETM)
IF Analyzer()
(
  ; set the pin-multiplexing for the off-chip trace (SW_MUX_CTL_PAD_LCD_DATAxx=ALT2)
  Data.Set AD:0x303300c8 %Long 0x2
  Data.Set AD:0x303300cc %Long 0x2
  Data.Set AD:0x303300d0 %Long 0x2
  Data.Set AD:0x303300d4 %Long 0x2
  Data.Set AD:0x303300d8 %Long 0x2
  Data.Set AD:0x303300dc %Long 0x2
  Data.Set AD:0x303300e0 %Long 0x2
  Data.Set AD:0x303300e4 %Long 0x2
  Data.Set AD:0x303300e8 %Long 0x2
  Data.Set AD:0x303300ec %Long 0x2
  Data.Set AD:0x303300f0 %Long 0x2
  Data.Set AD:0x303300f4 %Long 0x2
  Data.Set AD:0x303300f8 %Long 0x2
  Data.Set AD:0x303300fc %Long 0x2
  Data.Set AD:0x30330100 %Long 0x2
  Data.Set AD:0x30330104 %Long 0x2
  Data.Set AD:0x30330108 %Long 0x2
  Data.Set AD:0x3033010c %Long 0x2

  ; set the pin driving strength for the off-chip trace (SW_PAD_CTL_PAD_LCD_DATAxx)
  Data.Set AD:0x30330338 %Long 0x3
  Data.Set AD:0x3033033c %Long 0x3
  Data.Set AD:0x30330340 %Long 0x3
  Data.Set AD:0x30330344 %Long 0x3
  Data.Set AD:0x30330348 %Long 0x3
  Data.Set AD:0x3033034c %Long 0x3
  Data.Set AD:0x30330350 %Long 0x3
  Data.Set AD:0x30330354 %Long 0x3
  Data.Set AD:0x30330358 %Long 0x3
  Data.Set AD:0x3033035c %Long 0x3
  Data.Set AD:0x30330360 %Long 0x3
  Data.Set AD:0x30330364 %Long 0x3
  Data.Set AD:0x30330368 %Long 0x3
  Data.Set AD:0x3033036c %Long 0x3
  Data.Set AD:0x30330370 %Long 0x3
  Data.Set AD:0x30330374 %Long 0x3
  Data.Set AD:0x30330378 %Long 0x3
  Data.Set AD:0x3033037c %Long 0x3

  Trace.Method Analyzer
  TPIU.PortSize 16
  TPIU.PortMode Continuous
  ETM.Trace ON
  ETM.DataTrace OFF
  ETM.ON
  ; use Autofocus based calibration
  Analyzer.AutoFocus
)

; --------------------------------------------------------------------------------
; open some windows
WinCLEAR
Mode.Hll
WinPOS 0. 0. 116. 26.
List.auto
WinPOS 120. 0. 100. 8.
Frame.view
WinPOS 120. 14.
Var.Watch
Var.AddWatch %SpotLight ast flags
WinPOS 120. 25.
Trace.List
WinPOS 0. 32.
Var.DRAW %DEFault sinewave

ENDDO

KickCA7:
(
  PRIVATE &SRC_BASE_ADDR &GPC_IPS_BASE_ADDR
  &SRC_BASE_ADDR=0x30390000
  &GPC_IPS_BASE_ADDR=0x303A0000

  ; assemble endless loop to SRAM
  Data.Set AD:0x00900000 %Long 0xE0011001 // ARM: and r1,r1,r1 THUMB: asrs r1,r0,#0x0; b $+0x8
  Data.Set AD:0x00900004 %Long 0xEAFFFFFE // ARM: b $+0x0
  Data.Set AD:0x00900008 %Long 0xE7FEE7FE // THUMB: b $+0x0

  ; set SRC_GPR3 to SRAM
  Data.Set AD:&SRC_BASE_ADDR+0x8+0x74 %Long 0x00900000
  ; set GPC_PGC_C1.PCR
  Data.Set AD:&GPC_IPS_BASE_ADDR+0x840 %Long 0x1
  ; set CPU_PGC_SW_PUP_REQ.CORE1
  Data.Set AD:&GPC_IPS_BASE_ADDR+0xf0 %Long Data.Long(AD:&GPC_IPS_BASE_ADDR+0xf0)|0x2
  ; wait for ACK, poll CPU_PGC_PUP_STATUS
  WAIT (Data.Long(AD:&GPC_IPS_BASE_ADDR+0x130)&0x2)==0x0
  ; clear GPC_PGC_C1.PCR
  Data.Set AD:&GPC_IPS_BASE_ADDR+0x840 %Long 0x0
  ; set A7RCR1.CORE1_ENABLE
  Data.Set AD:&SRC_BASE_ADDR+0x8 %Long Data.Long(AD:&SRC_BASE_ADDR+0x8)|0x2

  RETURN
)
