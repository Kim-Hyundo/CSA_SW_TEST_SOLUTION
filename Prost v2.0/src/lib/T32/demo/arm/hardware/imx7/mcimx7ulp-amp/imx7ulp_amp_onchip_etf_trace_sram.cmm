; --------------------------------------------------------------------------------
; @Title: AMP-Demo script for IMX7ULP with Onchip-Trace (AMP, RAM, ETF)
; @Description:
;   Setup a AMP debug session using a single script approach.
;   Loads the sieve demo application into RAM and sets up a demo debug
;   scenario.
;   The program flow is traced using the Onchip-Trace (ETF).
;   Prerequisites:
;    * Connect Debug Cable/Combiprobe to header JTAG
;    * TRACE32 is started using the .bat/.sh file in this directory
;    * set SW1 to 0y1001 (default, internal boot)
; @Keywords: ARM, ETF, ETM
; @Author: AME
; @Board: MCIMX7ULP-BB
; @Chip: IMX7ULP
; @Copyright: (C) 1989-2019 Lauterbach GmbH, licensed for use with TRACE32(R) only
; --------------------------------------------------------------------------------
; $Id: imx7ulp_amp_onchip_etf_trace_sram.cmm 15362 2019-12-03 14:50:48Z mschleinkofer $

PRIVATE &currPath &rclPort &remoteCmd
&currPath=OS.PPD()
&rclPort=FORMAT.DecimalU(1.,RCL.PORT(0))+"."

WinCLEAR

; --------------------------------------------------------------------------------
; check prerequisites
IF SYStem.INSTANCE()<1.
(
  PRINT %ERROR "TRACE32 is not running in AMP mode! Use .bat/.sh file in this directory."
  ENDDO
)

; --------------------------------------------------------------------------------
; enable INTERCOM if not already specified and prepare related variables
IF (INTERCOM.PORT()==0)
(
  InterCom.ENable CM4
)
&remoteCmd="InterCom.execute CA7"

; --------------------------------------------------------------------------------
; close any existing REMOTE GUI
INTERCOM.execute OTHERS QUIT

; --------------------------------------------------------------------------------
; open SLAVE GUI with or without enabled remote API
IF (RCL.PORT(0)!=0)
(
  TargetSystem.NewInstance CA7 /ARCHitecture ARM /ChipIndex 2. /APIPORT &rclPort+1. /ONCE
)
ELSE
(
  TargetSystem.NewInstance CA7 /ARCHitecture ARM /ChipIndex 2. /ONCE
)

; --------------------------------------------------------------------------------
; set titles for SLAVE GUIs
TITLE "TRACE32 for ARM - IMX7ULP-CM4 - MASTER"
&remoteCmd TITLE "TRACE32 for ARM - IMX7ULP-CA7 - SLAVE1"

; --------------------------------------------------------------------------------
; common SYStem settings
RESet
&remoteCmd RESet
SYStem.RESet
&remoteCmd SYStem.RESet
SYStem.CPU IMX7ULP-CM4
SYStem.CONFIG CORE 1. 1.
SYStem.CONFIG SLAVE OFF
&remoteCmd SYStem.CPU IMX7ULP-CA7
&remoteCmd SYStem.CONFIG CORE 2. 1.
&remoteCmd SYStem.CONFIG SLAVE ON

; disable Trace for connection phase
Trace.DISable
&remoteCmd Trace.DISable

SYStem.Up

; --------------------------------------------------------------------------------
; kick secondary cores
; start CA7 manually - bypassing BOOTROM of CM4
Data.Set AD:0x410A1024 %Long Data.Long(AD:0x410A1024)|0x01000000
Data.Set AD:0x41026088 %Long Data.Long(AD:0x41026088)|0x40000000
Data.Set AD:0x41022064 %Long Data.Long(AD:0x41022064)&~0x80

; --------------------------------------------------------------------------------
; attach to all cores on all sessions
&remoteCmd SYStem.Mode.Up

; --------------------------------------------------------------------------------
; load demo program on all sessions (use internal RAM only)
Data.LOAD.Elf ~~~~/master/sieve_ram_thumb_ii_v7m.elf
&remoteCmd ChDir &currPath
&remoteCmd Data.LOAD.Elf ./slave1/sieve_ram_arm_v7.elf

; --------------------------------------------------------------------------------
; initialize ONCHIP trace (ETF)
Trace.METHOD ONCHIP
Trace.TraceCONNECT ETF
&remoteCmd Trace.METHOD ONCHIP
&remoteCmd Trace.TraceCONNECT ETF

ETM.TraceID 1.
ETM.Trace ON
ETM.ON
&remoteCmd ETM.TraceID 2.
&remoteCmd ETM.Trace ON
&remoteCmd ETM.ON

; --------------------------------------------------------------------------------
; start program execution
Go.direct main\1
WAIT !STATE.RUN()
&remoteCmd Go.direct main\1
&remoteCmd WAIT !STATE.RUN()

; --------------------------------------------------------------------------------
; open some windows
WinCLEAR
Mode.Hll
WinPOS 0. 0.
List.auto
WinPOS 0. 32.
Trace.List
&remoteCmd WinCLEAR
&remoteCmd Mode.Hll
&remoteCmd WinPOS 0. 0.
&remoteCmd List.auto
&remoteCmd WinPOS 0. 32.
&remoteCmd Trace.List

ENDDO
