; --------------------------------------------------------------------------------
; @Title: Simple demo script for RM48L952-ZWT on HERCULES RM48 (RAM)
; @Description:
;   Loads the sieve demo application into RAM and sets up a demo debug
;   scenario.
;   Use this script for getting started.
;   Prerequisites:
;    * Connect Debug Cable/Combiprobe to J4
; @Keywords: ARM, Cortex-R4
; @Author: AME
; @Board: HERCULES RM48
; @Chip: RM48L952-ZWT
; @Copyright: (C) 1989-2019 Lauterbach GmbH, licensed for use with TRACE32(R) only
; --------------------------------------------------------------------------------
; $Id: hercules_rm48_sieve_sram.cmm 15217 2019-11-04 16:17:15Z bschroefel $


WinCLEAR

; --------------------------------------------------------------------------------
; initialize and start the debugger
RESet
SYStem.RESet
SYStem.CPU RM48L952-ZWT
SYStem.MemAccess DAP
SYStem.JtagClock CTCK 10MHz
; TPIU is unclocked
ETM.OFF
Trace.DISable
SYStem.Up

; Init ECC - via CPU
Data.Set 0x08000000++0xffff %Quad 0x0

; --------------------------------------------------------------------------------
; load demo program (uses internal RAM only)
Data.LOAD.Elf "~~~~/sieve_ram_arm_v7r_le.elf"

; --------------------------------------------------------------------------------
; start program execution
Go.direct main
WAIT !STATE.RUN()

; --------------------------------------------------------------------------------
; open some windows
WinCLEAR
Mode.Hll
WinPOS 0. 0. 116. 26.
List.auto
WinPOS 120. 0. 100. 8.
Frame.view
WinPOS 120. 14.
Var.Watch
Var.AddWatch %SpotLight ast flags
WinPOS 120. 25.
Register.view /SpotLight
WinPOS 0. 32.
Var.DRAW %DEFault sinewave
ENDDO
