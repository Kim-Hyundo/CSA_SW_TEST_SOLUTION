; --------------------------------------------------------------------------------
; @Title: SMP-Demo script for CYCLONEVSOC on SoCrates with Offchip-Trace (RAM, SMP)
; @Description:
;   Boots the PRELOADER in order to setup PLLs and DRAM and loads the sieve demo
;   application into SRAM and sets up a demo debug scenario.
;   The program flow is traced using the Offchip-Trace. Pinmuxing and Clock
;   setup is handled in the script.
;   As not all cores are accessible after Reset (SYStem.Up) we handle the start
;   of the secondary cores in the script and switch to SMP later.
;   Use this script to test the Offchip-Trace.
;   Prerequisites:
;   * Please set bootmode to SD-Card and REMOVE SD-Card
;     => Device will stop in BOOT ROM
;     on SoCrates P18[6..8]=0y101
;   * Connect Debugcable or Combiprobe to P19 header
;     using LA-3863 (ARM->NIOS halfsize converter)
;   * Connect TPINTC Adapter to P13
;   * Connect AutoFocus Preprocessor to TPINTC Adapter using Mictor38 cable
; @Keywords: ARM, Cortex-A9, ETM, SMP
; @Author: AME
; @Board: SoCrates
; @Chip: CYCLONEVSOC
; @Copyright: (C) 1989-2019 Lauterbach GmbH, licensed for use with TRACE32(R) only
; --------------------------------------------------------------------------------
; $Id: socrates_sieve_offchip_trace_smp_dram.cmm 15223 2019-11-05 16:29:45Z bschroefel $


WinCLEAR
AREA.CLEAR
AREA.view

PRIVATE &ppd
&ppd=OS.PPD()

; unzip the FPGA design if not yet done
IF !OS.FILE("&ppd/ep5csxfc6.rbf")
(
  UNZIP "&ppd/ep5csxfc6.rbf.gz" "&ppd/ep5csxfc6.rbf"
)


; --------------------------------------------------------------------------------
; initialize and start the debugger
RESet
SYStem.RESet
SYStem.CPU CYCLONEVSOC
; settings for HPS-FPGA scanchain - hardwired on SoCrates
SYStem.CONFIG DAPIRPOST  0.
SYStem.CONFIG DAPIRPRE  10.
SYStem.CONFIG DAPDRPOST  0.
SYStem.CONFIG DAPDRPRE   1.
SYStem.JtagClock CTCK 10MHz
CORE.ASSIGN 1.    ; select only master core 1 - 1. first core, 2. second core, 1. 2. first + second core (SMP) ...
SYStem.Up

; --------------------------------------------------------------------------------
; Write to the clock manage to prevent the system from gating the debug clocks during a warm reset
Data.Set A:0xFFD04010 %Long 0x1
; Watchdog is activated by BOOTROM
; the only way is to use the RESET MANAGER
; disable Watchdog - Toggle RESET in PERMODRST
Data.Set A:0xFFD05014 %Long Data.Long(A:0xFFD05014)|0x40
Data.Set A:0xFFD05014 %Long Data.Long(A:0xFFD05014)&(~0x40)

; --------------------------------------------------------------------------------
; now execute u-boot-spl - setup DRAM
PRINT "run U-Boot-SPL ... load"
Data.LOAD.Binary "~~~~/u-boot-spl.bin" 0xFFFF0000--0xFFFFFFFF
Register.Set PC 0xFFFF0000
Register.Set T 0
PRINT "run U-Boot-SPL ... start"
Go.direct 0xFFFF6204 /Onchip
WAIT !STATE.RUN() 3.s
IF STATE.RUN()||(Register(PC)!=0xFFFF6204)
(
  PRINT %ERROR "run U-Boot-SPL ... fail"
  ENDDO
)
PRINT "run U-Boot-SPL ... finished - DRAM ready"

; Watchdog may be reactivated by PRELOADER
; the only way is to use the RESET MANAGER
; disable Watchdog - Toggle RESET in PERMODRST
Data.Set A:0xFFD05014 %Long Data.Long(A:0xFFD05014)|0x40
Data.Set A:0xFFD05014 %Long Data.Long(A:0xFFD05014)&(~0x40)

; --------------------------------------------------------------------------------
; Load FPGA to route the trace signals from the HAPS through the FPGA to pin-header P18
PRINT "load FPGA design using FPGA Manager ..."
;DO "~~/demo/arm/hardware/cyclonevsoc/cyclonevsoc_fpgaloadrbf.cmm"  "&ppd/ep5csxfc6.rbf"  0x100000
DO "~~~~/../cyclonevsoc_fpgaloadrbf.cmm"  "&ppd/ep5csxfc6.rbf"  0x100000
PRINT "load FPGA design using FPGA Manager ... finished"

; ensure DBGCTRL.STAYOSC1 is disabled (otherwise the ETR runs with failsafe clock)
Data.Set A:0xFFD04010 %Long Data.Long(A:0xFFD04010)&~0x1

; --------------------------------------------------------------------------------
; kick secondary cores:
; 1st: Hold 2nd core in reset
Data.Set A:0xFFD05010 %Long Data.Long(A:0xFFD05010)|0x2
; 2nd: Set secondary boot address to OCM (SRAM)
; cpu1startaddr = 0xffff0000  ->  2nd core's start-address when released from reset
Data.Set A:0xFFD080C4 %Long 0xFFFF0000
; 3rd: Write infinite loop in OCM (SRAM) at previously set reset address
Data.Assemble R:0xFFFF0000 B $+0x0
; 4th: Release 2nd core's reset
; mpumodrst.cpu1 = 0 -> no reset
Data.Set A:0xFFD05010 %Long Data.Long(A:0xFFD05010)&~0x2

; disconnect from system and re-attach in SMP mode
SYStem.Mode Down
CORE.ASSIGN 1. 2.
SYStem.Mode Attach

IF STATE.RUN()
  Break.direct

; --------------------------------------------------------------------------------
; Load demo program (uses internal SRAM only).
CORE.select 0.
Data.LOAD.Elf "~~~~/sieve_ram_arm_v7.elf" /PlusVM
; Set PC for all secondary cores
Register.Set PC _start /CORE 1.

; --------------------------------------------------------------------------------
; start program execution
Go.direct main
WAIT !STATE.RUN()

; --------------------------------------------------------------------------------
; initialize OFFCHIP trace if Analyzer is plugged (ETM)
IF Analyzer()
(
  PRIVATE &AutoFocus

  Trace.Method Analyzer
  Trace.RESet
  Trace.AutoArm  ON
  Trace.AutoInit ON
  Trace.TraceCLOCK 400.MHz   ; data-rate on the physical trace port
  Trace.PortSize 16   ; Physical trace port has 16 pins
  TPIU.PortSize  32   ; TPIU exports to FPGA with 32 lines
  TPIU.PortMode Continuous
  ETM.ON
  ETM.Trace ON
  ETM.TImeMode ExternalInterpolated
  ETM.CLOCK 800.MHz   ; CPU core clock
  ETM.TimeStampCLOCK 400.MHz

  ; Calibrate AutoFocus-II preprocessor
  &AutoFocus=TRUE()
  IF OS.FILE("~~~~/af.tmp")
  (
    ; Load & check previous used settings
    DO "~~~~/af.tmp"
    Analyzer.TestFocus
    &AutoFocus=FOUND()
  )
  IF &AutoFocus
  (
    PRINT "Performing AutoFocus..."
    Analyzer.AutoFocus
    STOre "~~~~/af.tmp" AnalyzerFocus
    PRINT %CONTinue " DONE"
  )
)

; --------------------------------------------------------------------------------
; open some windows
WinCLEAR
Mode.Hll
WinPOS 0. 0.
List.auto
WinPOS 120. 0. 100. 8.
Frame.view
WinPOS 120. 14.
Var.Watch
Var.AddWatch %SpotLight ast flags
WinPOS 0. 32.
Var.DRAW %DEFault sinewave
IF Analyzer()
(
  WinPOS 120. 25.
  Trace.List
)

ENDDO
