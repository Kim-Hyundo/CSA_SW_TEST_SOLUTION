; --------------------------------------------------------------------------------
; @Title: SMP-Demo script for CYCLONEVSOC on SoCrates with Onchip-Trace (DRAM, SMP, ETR)
; @Description:
;   Boots the PRELOADER in order to setup PLLs and DRAM and loads the sieve demo
;   application into SRAM and sets up a demo debug scenario.
;   The program flow is traced using the Onchip-Trace (ETR). Therefore a part
;   of the targets DRAM is used for trace storage.
;   As not all cores are accessible after Reset (SYStem.Up) we handle the start
;   of the secondary cores in the script and switch to SMP later.
;   Prerequisites:
;   * Please set bootmode to SD-Card and REMOVE SD-Card
;     => Device will stop in BOOT ROM
;     on SoCrates P18[6..8]=0y101
;   * Connect Debugcable or Combiprobe to P19 header
;     using LA-3863 (ARM->NIOS halfsize converter)
; @Keywords: ARM, Cortex-A9, ETM, ETR, SMP
; @Author: AME
; @Board: SoCrates
; @Chip: CYCLONEVSOC
; @Copyright: (C) 1989-2019 Lauterbach GmbH, licensed for use with TRACE32(R) only
; --------------------------------------------------------------------------------
; $Id: socrates_sieve_onchip_etr_trace_smp_dram.cmm 15223 2019-11-05 16:29:45Z bschroefel $


WinCLEAR

; --------------------------------------------------------------------------------
; initialize and start the debugger
RESet
SYStem.RESet
SYStem.CPU CYCLONEVSOC
; settings for HPS-FPGA scanchain - hardwired on SoCrates
SYStem.CONFIG DAPIRPOST  0.
SYStem.CONFIG DAPIRPRE  10.
SYStem.CONFIG DAPDRPOST  0.
SYStem.CONFIG DAPDRPRE   1.
SYStem.JtagClock CTCK 10MHz
CORE.ASSIGN 1.    ; select only master core 1 - 1. first core, 2. second core, 1. 2. first + second core (SMP) ...
SYStem.Up

; --------------------------------------------------------------------------------
; Write to the clock manage to prevent the system from gating the debug clocks during a warm reset
Data.Set A:0xFFD04010 %Long 0x1
; Watchdog is activated by BOOTROM
; the only way is to use the RESET MANAGER
; disable Watchdog - Toggle RESET in PERMODRST
Data.Set A:0xFFD05014 %Long Data.Long(A:0xFFD05014)|0x40
Data.Set A:0xFFD05014 %Long Data.Long(A:0xFFD05014)&(~0x40)

; --------------------------------------------------------------------------------
; now execute u-boot-spl - setup dram
PRINT "run U-Boot-SPL ... load"
Data.LOAD.Binary "~~~~/u-boot-spl.bin" 0xFFFF0000--0xFFFFFFFF
Register.Set PC 0xFFFF0000
Register.Set T 0
PRINT "run U-Boot-SPL ... start"
Go.direct 0xFFFF6204 /Onchip
WAIT !STATE.RUN() 3.s
IF STATE.RUN()||(Register(PC)!=0xFFFF6204)
(
  PRINT %ERROR "run U-Boot-SPL ... fail"
  ENDDO
)
PRINT "run U-Boot-SPL ... finished - SDRAM ready"

; Watchdog may be reactivated by PRELOADER
; the only way is to use the RESET MANAGER
; disable Watchdog - Toggle RESET in PERMODRST
Data.Set A:0xFFD05014 %Long Data.Long(A:0xFFD05014)|0x40
Data.Set A:0xFFD05014 %Long Data.Long(A:0xFFD05014)&(~0x40)

; ensure DBGCTRL.STAYOSC1 is disabled (otherwise the ETR runs with failsafe clock)
Data.Set A:0xFFD04010 %Long Data.Long(A:0xFFD04010)&~0x1

; --------------------------------------------------------------------------------
; kick secondary cores:
; 1st: Hold 2nd core in reset
Data.Set A:0xFFD05010 %Long Data.Long(A:0xFFD05010)|0x2
; 2nd: Set secondary boot address to OCM (SRAM)
; cpu1startaddr = 0xffff0000  ->  2nd core's start-address when released from reset
Data.Set A:0xFFD080C4 %Long 0xFFFF0000
; 3rd: Write infinite loop in OCM (SRAM) at previously set reset address
Data.Assemble R:0xFFFF0000 B $+0x0
; 4th: Release 2nd core's reset
; mpumodrst.cpu1 = 0 -> no reset
Data.Set A:0xFFD05010 %Long Data.Long(A:0xFFD05010)&~0x2

; disconnect from system and re-attach in SMP mode
SYStem.Mode Down
CORE.ASSIGN 1. 2.
SYStem.Mode Attach

IF STATE.RUN()
  Break.direct

; --------------------------------------------------------------------------------
; load demo program (uses internal SRAM only)
CORE.select 0.
Data.LOAD.Elf "~~~~/sieve_ram_arm_v7.elf"
; Set PC for all secondary cores
Register.Set PC _start /CORE 1.

; --------------------------------------------------------------------------------
; start program execution
Go.direct main
WAIT !STATE.RUN()

; --------------------------------------------------------------------------------
; initialize ONCHIP trace (ETR)
; these settings are generated by calling
;   DO "~~/demo/arm/etc/embedded_trace_router/etr_utility.cmm"
; - use hardcoded values here DRAM 0x01000000++0x3ffff
PRIVATE &EtrAxiBase &EtrSize
&EtrAxiBase=0x01000000
&EtrSize=0x10000
DO "~~/demo/arm/etc/embedded_trace_router/etr_utility.cmm" ETR1 set DAB    &EtrAxiBase
DO "~~/demo/arm/etc/embedded_trace_router/etr_utility.cmm" ETR1 set RSZ    &EtrSize
DO "~~/demo/arm/etc/embedded_trace_router/etr_utility.cmm" ETR1 set AXICTL 0x00000F00 0x00000FBF
Trace.METHOD ONCHIP
Trace.TraceCONNECT ETR
ETM.ON
ETM.Trace ON
ETM.CLOCK 800.MHz

; --------------------------------------------------------------------------------
; open some windows
WinCLEAR
Mode.Hll
WinPOS 0. 0.
List.auto
WinPOS 120. 0. 100. 8.
Frame.view
WinPOS 120. 14.
Var.Watch
Var.AddWatch %SpotLight ast flags
WinPOS 120. 25.
Trace.List
WinPOS 0. 32.
Var.DRAW %DEFault sinewave

ENDDO
