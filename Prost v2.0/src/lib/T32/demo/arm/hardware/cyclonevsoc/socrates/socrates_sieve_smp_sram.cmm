; --------------------------------------------------------------------------------
; @Title: Simple SMP demo script for CYCLONEVSOC on SoCrates (RAM, SMP)
; @Description:
;   Loads the sieve demo application into RAM and sets up a demo debug scenario
;   on all cores.
;   Use this script for getting started.
;   As not all cores are accessible after Reset (SYStem.Up) we handle the start
;   of the secondary cores in the script and switch to SMP later.
;   Prerequisites:
;   * Please set bootmode to SD-Card and REMOVE SD-Card
;     => Device will stop in BOOT ROM
;     on SoCrates P18[6..8]=0y101
;   * Connect Debugcable or Combiprobe to P19 header
;     using LA-3863 (ARM->NIOS halfsize converter)
; @Keywords: ARM, Cortex-A9, SMP
; @Author: AME
; @Board: SoCrates
; @Chip: CYCLONEVSOC
; @Copyright: (C) 1989-2019 Lauterbach GmbH, licensed for use with TRACE32(R) only
; --------------------------------------------------------------------------------
; $Id: socrates_sieve_smp_sram.cmm 15217 2019-11-04 16:17:15Z bschroefel $


WinCLEAR

; --------------------------------------------------------------------------------
; initialize and start the debugger
RESet
SYStem.RESet
SYStem.CPU CYCLONEVSOC
; settings for HPS-FPGA scanchain - hardwired on SoCrates
SYStem.CONFIG DAPIRPOST  0.
SYStem.CONFIG DAPIRPRE  10.
SYStem.CONFIG DAPDRPOST  0.
SYStem.CONFIG DAPDRPRE   1.
SYStem.JtagClock CTCK 10MHz
CORE.ASSIGN 1.    ; select only master core 1 - 1. first core, 2. second core, 1. 2. first + second core (SMP) ...
SYStem.Up

; --------------------------------------------------------------------------------
; Write to the clock manage to prevent the system from gating the debug clocks during a warm reset
Data.Set A:0xFFD04010 %Long 0x1
; Watchdog is activated by BOOTROM
; the only way is to use the RESET MANAGER
; disable Watchdog - Toggle RESET in PERMODRST
Data.Set A:0xFFD05014 %Long Data.Long(A:0xFFD05014)|0x40
Data.Set A:0xFFD05014 %Long Data.Long(A:0xFFD05014)&(~0x40)

; --------------------------------------------------------------------------------
; kick secondary cores:
; 1st: Hold 2nd core in reset
Data.Set A:0xFFD05010 %Long Data.Long(A:0xFFD05010)|0x2
; 2nd: Set secondary boot address to OCM (SRAM)
; cpu1startaddr = 0xffff0000  ->  2nd core's start-address when released from reset
Data.Set A:0xFFD080C4 %Long 0xFFFF0000
; 3rd: Write infinite loop in OCM (SRAM) at previously set reset address
Data.Assemble R:0xFFFF0000 B $+0x0
; 4th: Release 2nd core's reset
; mpumodrst.cpu1 = 0 -> no reset
Data.Set A:0xFFD05010 %Long Data.Long(A:0xFFD05010)&~0x2

; disconnect from system and re-attach in SMP mode
SYStem.Mode.Down
CORE.ASSIGN 1. 2.
SYStem.Mode Attach

IF STATE.RUN()
  Break.direct

; --------------------------------------------------------------------------------
; load demo program (uses internal RAM only)
CORE.select 0.
Data.LOAD.Elf "~~~~/sieve_ram_arm_v7.elf"
; Set PC for all secondary cores
Register.Set PC _start /CORE 1.

; --------------------------------------------------------------------------------
; start program execution
Go.direct main
WAIT !STATE.RUN()

; --------------------------------------------------------------------------------
; open some windows
WinCLEAR
Mode.Hll
WinPOS 0. 0.
List.auto
WinPOS 120. 0. 100. 8.
Frame.view
WinPOS 120. 14.
Var.Watch
Var.AddWatch %SpotLight ast flags
WinPOS 120. 25.
Register.view /SpotLight
WinPOS 0. 32.
Var.DRAW %DEFault sinewave

ENDDO
