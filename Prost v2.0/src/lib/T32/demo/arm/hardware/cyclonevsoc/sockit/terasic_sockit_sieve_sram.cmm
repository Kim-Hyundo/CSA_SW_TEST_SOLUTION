; --------------------------------------------------------------------------------
; @Title: Simple demo script for TERASIC/Arrow SOCKIT
; @Description:
;   Loads the sieve demo into RAM and sets up a
;   demo debug scenario on the first core.
;   Prerequisites:
;     * please populate J1 (10pin Jtag Header)
;     * connect the DebugCable or Combiprobe using
;       LA3863 ARM20 to Altera10 connector
;       to J1. 
;     * short NRESET-PIN6 on LA3863
;     * replace R138 with 200-500 Ohms to prevent damage of the debug cable
;       and the ADM811 on the board
;     * set SW4[1..0]=0y10 -> JTAG_HPS_EN
;     * set bootmode to SD-Card and remove the SD-Card
;       BOOTSEL[2..0]=0y101 => J17=1-2 J19=2-3 J18=1-2
; @Keywords: ALTERA, Cortex-A9, Cyclone, Cyclonev
; @Author: AME
; @Board: Arrow SoCKit, Terasic SoCKit
; @Chip: CYCLONEVSOC
; @Copyright: (C) 1989-2019 Lauterbach GmbH, licensed for use with TRACE32(R) only
; --------------------------------------------------------------------------------
; $Id: terasic_sockit_sieve_sram.cmm 15223 2019-11-05 16:29:45Z bschroefel $


; Start-up the debugger
  RESet
  SYStem.CPU CYCLONEVSOC
  SYStem.Option ResBreak OFF                ; required on some boards - don't hold in RESET
  SYStem.JtagClock CTCK 10MHz
  CORE.ASSIGN 1                             ; "1" = first core, "2" = second core, "1 2" = both cores (SMP)
  
; assume HPS-FPGA scanchain
; use e.g. SYStem.DETECT.DaisyChain, AREA to explore the current scanchain
  SYStem.CONFIG DAPIRPOST 10.
  SYStem.CONFIG DAPIRPRE  0.
  SYStem.CONFIG DAPDRPOST 1.
  SYStem.CONFIG DAPDRPRE  0.
  
; initially connect to the platform
  SYStem.Up
; Write to the clock manage to prevent the system from gating the debug clocks during a warm reset
  Data.Set AHB:0xffd04010 %Long 0x1  
; Watchdog is activated by BOOTROM 
; the only way is to use the RESET MANAGER
; disable Watchdog - Toggle RESET in PERMODRST
  Data.Set A:0xFFD05014 %Long Data.Long(A:0xFFD05014)|0x40
  Data.Set A:0xFFD05014 %Long Data.Long(A:0xFFD05014)&(~0x40)
  
  ; use inifinite loops as exception vectors
  Data.Assemble A:0xffff0000 b $+0
  Data.Assemble , b $+0
  Data.Assemble , b $+0
  Data.Assemble , b $+0
  Data.Assemble , b $+0
  Data.Assemble , b $+0
  Data.Assemble , b $+0
  ; remap exception vectors to SRAM - I-Cache Enabled, MMU OFF
  Data.Set C15:0x1 0xC53878 
  
  ; load Position Independent SIEVE demo into SRAM
  DO ~~/demo/arm/compiler/gnu-pic/demo_sieve 0xffff1000
  Go main
  WAIT !STATE.RUN()
  List.auto
  
  ENDDO
  


