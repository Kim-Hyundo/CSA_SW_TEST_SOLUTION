; --------------------------------------------------------------------------------
; @Title: Start-Up Script (SMP) for OMAP5432 PandaBoard
; @Description:
;  This script connects the OMAP5432 and loads a demo application
;  to demonstrate basic debug in SMP mode.
; @Author: KJM
; @Keywords: debug, sieve
; @Board: PandaBoard
; @Chip: OMAP5432
; @Copyright: (C) 1989-2019 Lauterbach GmbH, licensed for use with TRACE32(R) only
; --------------------------------------------------------------------------------
; $Id: omap5432_sieve_smp_sram_demo.cmm 15217 2019-11-04 16:17:15Z bschroefel $

  RESet
  SYStem.CPU OMAP5432ES2
  SYStem.Up

  Data.Set C15:0x1 %Long 0xC5087A

  CORE.select 0.
  Register.RESet
  Data.LOAD.Elf ~~~~/demo.axf /PlusVM
  Register.Set PC main
  Register.Set CPSR 0x1d3
  Register.Set R13 0x40304000
  CORE.select 1.
  Register.RESet
  Register.Set PC background
  Register.Set CPSR 0x1d3
  CORE.select 0.

; open some windows
  WinCLEAR
  WinPOS 0% 0% 50% 50%
  List.auto
  WinPOS 0% 50% 50% 50%
  Frame /Locals /Caller
  WinPOS 50% 50% 50% 50%
  Var.Watch
  Var.AddWatch ast; flags;
  WinPOS 50% 0% 50% 50%
  Register.view /SpotLight

  ENDDO

