; --------------------------------------------------------------------------------
; @Title: Start-Up Script for the Cortex-A8 on OMAP3503 TMDSEVM3503
; @Description: Cortex-A8 on OMAP3503 TMDSEVM3503 Mistral startup.
; @Keywords: Cortex-A8, mistral, TI
; @Author: PEG
; @Board: TMDSEVM3503
; @Chip: OMAP3503
; @Copyright: (C) 1989-2019 Lauterbach GmbH, licensed for use with TRACE32(R) only
; --------------------------------------------------------------------------------
; $Id: demo.cmm 15217 2019-11-04 16:17:15Z bschroefel $


; start-up the debugger
  SYStem.RESet
  SYStem.CPU OMAP3503
  SYStem.Up

  GOSUB disable_watchdog

; load demo application
  Data.LOAD.ELF ~~~~/demo.axf
  Register.Set PC main
  Register.Set R13 0x4020f000

; open some windows
  WinCLEAR
  WinPOS 0% 0% 100% 50%
  List.auto
  WinPOS 0% 50% 50% 50%
  Frame /Locals /Caller
  WinPOS 50% 50% 50% 50%
  Var.Watch
  Var.AddWatch ast; flags;

  ENDDO

disable_watchdog:

  ; Enable Interface Clock
  Data.Set 0x48004C10 %Long 0x20

  ; Enable functional clock
  Data.Set 0x48004C00 %l 0x20

  ; Check that module is IDLE
  WAIT (Data.Long(SD:0x48004C20)&0x20)==0

  ; Disable watchdog timer
  Data.Set SD:0x48314048 %LE %Long 0x0000AAAA
  WAIT (Data.Long(SD:0x48314034)&0x10)==0

  Data.Set SD:0x48314048 %LE %Long 0x00005555
  WAIT (Data.Long(SD:0x48314034)&0x10)==0

  ; Check if the watchdog timer is running
  IF (Data.Long(SD:0x48314048)!=0x00005555)
  (
    ; Disable Watchdog 2
    ; Wait until reset complete
    WAIT (Data.LONG(SD:0x48314014)&0x01)!=0

    ; Disable 32Khz watchdog timer
    Data.Set 0x48314048 %Long 0x0000AAAA

    WAIT (Data.Long(SD:0x48314034)&0x10)==0

    ; Disable 32Khz watchdog timer
    Data.Set 0x48314048 %Long 0x00005555

    WAIT (Data.Long(SD:0x48314034)&0x10)==0
  )

  RETURN

