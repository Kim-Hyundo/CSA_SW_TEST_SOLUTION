; --------------------------------------------------------------------------------
; @Title: Simple SRAM demo for the MCB1760 board
; @Description:
;   Loads the sieve demo into SRAM and sets up a
;   demo debug scenario.
; @Keywords: KEIL, NXP
; @Author: STK
; @Board: MCB-1760
; @Chip: LPC1768
; @Copyright: (C) 1989-2019 Lauterbach GmbH, licensed for use with TRACE32(R) only
; --------------------------------------------------------------------------------
; $Id: mcb1760_simple_sram_demo.cmm 15217 2019-11-04 16:17:15Z bschroefel $


; Basic setup

  Break.Reset
  SYStem.RESet
  SYStem.CPU LPC1768
  SYStem.CONFIG SWDP    ON
  SYStem.Option EnReset OFF
  SYStem.CONFIG CONNECTOR MIPI20T
  SYStem.Up

; Load the demo code into the SRAM
  Data.LOAD.ELF ~~~~/demo.axf
  Register.Set PC main
  Register.Set R13 0x10005000

  ; open some windows
  WinCLEAR
  WinPOS 0% 0% 100% 50%
  List.auto
  WinPOS 0% 50% 50% 50%
  Frame /Locals /Caller
  WinPOS 50% 50% 50% 50%
  Var.Watch
  Var.AddWatch ast; flags;

  ENDDO
