; --------------------------------------------------------------------------------
; @Title: Demo script for LPC845M301JBD64 on  (FLASH)
; @Description:
;   Programs the midi demo application into the processor internal flash and
;   sets up a demo debug scenario.
;   This script can be used as a template for flashing an application.
;   Prerequisites:
;    * Connect Debug Cable to P4 using Adapter LA-3770
;      or
;      Connect Combiprobe/uTrace to P4
;    * Disable onboard debugger by setting JP1
; @Keywords: ARM, Cortex-M0+, Flash
; @Author: STK
; @Board:
; @Chip: LPC845M301JBD64
; @Copyright: (C) 1989-2020 Lauterbach GmbH, licensed for use with TRACE32(R) only
; --------------------------------------------------------------------------------
; $Id: lpcxpresso845max_sieve_flash.cmm 16067 2020-05-14 15:02:18Z skrausse $


WinCLEAR

; --------------------------------------------------------------------------------
; initialize and start the debugger
RESet
SYStem.CPU LPC845M301JBD64
SYStem.CONFIG.DEBUGPORTTYPE SWD
SYStem.Option DUALPORT ON
SYStem.MemAccess DAP
SYStem.Up

; --------------------------------------------------------------------------------
; Flash programming

; prepare flash programming (declarations)
DO ~~/demo/arm/flash/lpc8xx.cmm PREPAREONLY

; ReProgram Flash
FLASH.ReProgram ALL
; 1. Download file
Data.LOAD.Elf "~~~~/midi_flash_thumb_v6m.elf"
; 2. Checksum generation
Data.SUM 0x0--0x1B /Long         ;Calculate checksum of all (other) vectors
Data.Set 0x1C %Long -Data.SUM()  ;Write the 2's complement in reserved vector's spot
FLASH.ReProgram OFF

; --------------------------------------------------------------------------------
; Reset the target again
SYStem.Up

; --------------------------------------------------------------------------------
; start program execution
Go.direct main
WAIT !STATE.RUN()

; --------------------------------------------------------------------------------
; open some windows
WinCLEAR
Mode.Hll
WinPOS 0. 0. 116. 26.
List.auto
WinPOS 120. 0. 100. 8.
Frame.view
WinPOS 120. 14.
Var.Watch
Var.AddWatch %SpotLight ast flags
WinPOS 120. 25.
Register.view /SpotLight
WinPOS 0. 32.
Var.DRAW %DEFault sinewave

ENDDO
