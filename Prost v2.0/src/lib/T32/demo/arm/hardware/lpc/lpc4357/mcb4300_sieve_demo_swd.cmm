; --------------------------------------------------------------------------------
; @Title: Simple debug demo on SWD for LPC4357 on MCB4357 board
; @Description:
;   This is a small demo how to setup a SWD debug session on Cortex-M4
;   for LPC4357 on MCB4357 board
; @Keywords: Cortex-M4, debug, NXP, SWD
; @Author: HDA
; @Board: MCB4300
; @Chip: LPC4357*
; @Copyright: (C) 1989-2019 Lauterbach GmbH, licensed for use with TRACE32(R) only
; --------------------------------------------------------------------------------
; $Id: mcb4300_sieve_demo_swd.cmm 15217 2019-11-04 16:17:15Z bschroefel $


; Basic setup
  Break.RESet
  SYStem.RESet
  SYStem.CPU LPC4357FET256
  SYStem.CONFIG.DEBUGPORTTYPE SWD
  SYStem.CONFIG.CONNECTOR MIPI20T
  SYStem.Option EnReset OFF
  SYStem.Up

  Data.LOAD.Elf ~~~~/demo.axf
  Register.Set PC main
  Register.Set R13 0x10005000

  ; open some windows
  WinCLEAR

  WinPOS 0% 0% 50% 50%
  List.auto

  WinPOS 50% 0% 50% 50%
  Register.view /SpotLight

  WinPOS 0% 50% 50% 50%
  Frame /Locals /Caller

  WinPOS 50% 50% 50% 50%
  Var.Watch
  Var.AddWatch ast; flags;
