; --------------------------------------------------------------------------------
; @Title: Demo script for LPC54628J512ET180 on LPCXpresso546xx (FLASH)
; @Description:
;   Programs the sieve demo application into the processor internal flash and
;   sets up a demo debug scenario.
;   This script can be used as a template for flashing an application.
;   Prerequisites:
;    * Connect Debug Cable to P1 (SWD) using Adapter LA-3770
;      or
;      Connect Combiprobe/uTrace to P1 (SWD)
;    * DO NOT USE J8 to avoid conflicts between TARCE32 and the onboard debugger
;    * Remove jumper JP1 (default)
; @Keywords: ARM, Cortex-M4, Flash
; @Author: STK
; @Board: LPCXpresso546xx
; @Chip: LPC54628J512ET180
; @Copyright: (C) 1989-2019 Lauterbach GmbH, licensed for use with TRACE32(R) only
; --------------------------------------------------------------------------------
; $Id: lpcxpresso546xx_sieve_flash.cmm 16243 2020-06-30 09:45:17Z wdoering $


WinCLEAR

; --------------------------------------------------------------------------------
; initialize and start the debugger
RESet
SYStem.RESet
SYStem.CPU LPC54628J512ET180
SYStem.CONFIG.DEBUGPORTTYPE SWD
IF COMBIPROBE()||UTRACE()
(
  SYStem.CONFIG.CONNECTOR MIPI20T
)
SYStem.Option DUALPORT ON
SYStem.MemAccess DAP
SYStem.JtagClock CTCK 10MHz
SYStem.Option WaitReset 1ms
Trace.DISable
SYStem.Up

; --------------------------------------------------------------------------------
; Flash programming

; prepare flash programming (declarations)
DO ~~/demo/arm/flash/lpc54xx.cmm PREPAREONLY

; ReProgram Flash
FLASH.ReProgram ALL
Data.LOAD.Elf "~~~~/sieve_flash_thumb_ii_v7m.elf"
Data.SUM 0x00000000--0x0000001B /Long  ; Calculate checksum of all (other) vectors
Data.Set 0x0000001C %Long -Data.SUM()  ; Write the 2's complement in reserved vector's spot
Data.Set 0x00000020 %Long 0xFFFFFFFF   ; ECRP
Data.Set 0x00000024 %Long 0xFFFFFFFF   ; legacy image
FLASH.ReProgram OFF

; --------------------------------------------------------------------------------
; Reset the target again
SYStem.Up

; --------------------------------------------------------------------------------
; start program execution
Go.direct main
WAIT !STATE.RUN()

; --------------------------------------------------------------------------------
; open some windows
WinCLEAR
Mode.Hll
WinPOS 0. 0. 116. 26.
List.auto
WinPOS 120. 0. 100. 8.
Frame.view
WinPOS 120. 14.
Var.Watch
Var.AddWatch %SpotLight ast flags
WinPOS 120. 25.
Register.view /SpotLight
WinPOS 0. 32.
Var.DRAW %DEFault sinewave

ENDDO
