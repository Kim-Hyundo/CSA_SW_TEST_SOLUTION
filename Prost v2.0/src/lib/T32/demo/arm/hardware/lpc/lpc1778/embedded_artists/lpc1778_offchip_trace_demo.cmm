; --------------------------------------------------------------------------------
; @Title: Off-chip trace demo for Embedded Artists eval board with LPC1778
; @Description:
;   Loads the sieve demo into SRAM and sets up a
;   debug and trace scenario.
; @Keywords: NXP, Trace
; @Author: STK
; @Board: LPC1778
; @Chip: LPC1778
; @Copyright: (C) 1989-2019 Lauterbach GmbH, licensed for use with TRACE32(R) only
; --------------------------------------------------------------------------------
; $Id: lpc1778_offchip_trace_demo.cmm 15217 2019-11-04 16:17:15Z bschroefel $


; Basic setup

  Break.Reset
  SYStem.RESet
  SYStem.CPU LPC1778
  SYStem.Option ResBreak OFF
  SYStem.Option DUALPORT ON
  SYStem.CONFIG CONNECTOR MIPI20T
  SYStem.MemAccess DAP
  SYStem.Up

  Go
  Wait 1s
  Break

  ; Load the demo code into the SRAM
  Data.LOAD.ELF ~~~~/demo.axf
  Register.Set PC main
  Register.Set R13 0x10005000

  IF hardware.COMBIPROBE()||hardware.UTRACE()
  (
      ; Enable Trace
      Data.Set D:0x4002C108 %LONG 0x285
      Data.Set D:0x4002C10C %LONG 0x285
      Data.Set D:0x4002C110 %LONG 0x285
      Data.Set D:0x4002C114 %LONG 0x285
      Data.Set D:0x4002C118 %LONG 0x285

      ETM.ON
      ITM.ON

      ETM.PortMode Continuous
      ETM.PortSize 4.

      Trace.Method CAnalyzer   ; Using CombiProbe
      CAnalyzer.CLOCKDelay Small
      CAnalyzer.THreshold 1.5

      Trace.Off                ; Enable the trace and turn it off
      Trace.Init
  )

  ENDDO
