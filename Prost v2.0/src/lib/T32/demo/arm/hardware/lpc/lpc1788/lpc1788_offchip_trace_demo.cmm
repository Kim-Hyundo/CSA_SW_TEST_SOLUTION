; --------------------------------------------------------------------------------
; @Title: Off-chip trace demo for lpc1788-32 developer's kit from embedded artists
; @Description:
;   Loads the sieve demo into SRAM and sets up a
;   debug and trace scenario.
; @Keywords: NXP, Trace, Cortex-M3
; @Author: HDA
; @Board: LPC1788
; @Chip: LPC1788
; @Copyright: (C) 1989-2019 Lauterbach GmbH, licensed for use with TRACE32(R) only
; --------------------------------------------------------------------------------
; $Id: lpc1788_offchip_trace_demo.cmm 15217 2019-11-04 16:17:15Z bschroefel $


; Basic setup

  Break.Reset
  SYStem.RESet
  SYStem.CPU LPC1788
  SYStem.Option ResBreak OFF
  SYStem.Option DUALPORT ON
  SYStem.CONFIG CONNECTOR MIPI20T
  SYStem.MemAccess DAP
  SYStem.Up

  Go
  Wait 1s
  Break

  ; Load the demo code into the SRAM
  Data.LOAD.ELF ~~~~/demo.axf
  Register.Set PC main
  Register.Set R13 0x10005000

  IF hardware.COMBIPROBE()||hardware.UTRACE()
  (
      ; Enable Trace
      Data.Set D:0x4002C108 %LONG 0x285
      Data.Set D:0x4002C10C %LONG 0x285
      Data.Set D:0x4002C110 %LONG 0x285
      Data.Set D:0x4002C114 %LONG 0x285
      Data.Set D:0x4002C118 %LONG 0x285

      ETM.ON
      ITM.ON

      ETM.PortMode Continuous
      ETM.PortSize 4.

      Trace.Method CAnalyzer   ; Using CombiProbe
      CAnalyzer.CLOCKDelay Small
      CAnalyzer.THreshold 1.5

      Trace.Off                ; Enable the trace and turn it off
      Trace.Init
  )

  ;open some window
  WinCLEAR

  WinPOS 0.0 0.0 93. 19. 16. 1. W001
  WinTABS 10. 10. 25. 62.
  List.auto

  WinPOS 98.714 0.0 91. 19. 10. 1. W000
  WinTABS 32.
  Trace.List

  WinPOS 0.0 25.583 93. 14. 5. 0. W002
  Frame /Locals /Caller

  WinPOS 98.143 25.833 92. 14. 0. 0. W003
  Var.Watch
  Var.AddWatch flags; ast;

  ;run for 3 seconds
  Go.direct
  WAIT 3.s
  Break.direct

  ENDDO
