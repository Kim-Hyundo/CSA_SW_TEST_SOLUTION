; --------------------------------------------------------------------------------
; @Title: Simple SRAM demo for Hitex LPC2921
; @Description:
;   Loads the sieve demo into SRAM and sets up a
;   demo debug scenario.
; @Keywords: NXP
; @Author: STK
; @Board: Hitex-LPC2921
; @Chip: LPC29*
; @Copyright: (C) 1989-2019 Lauterbach GmbH, licensed for use with TRACE32(R) only
; --------------------------------------------------------------------------------
; $Id: hitex_lpc2919_sram_demo.cmm 15217 2019-11-04 16:17:15Z bschroefel $


  SYStem.Reset
  SYStem.CPU LPC2919
  SYStem.JtagClock 100khz
  SYStem.Option ResBreak OFF
  SYStem.Up


; load demo application
  Data.LOAD.ELF ~~~~/demo.axf
  Register.RESet
  Register.Set T 1
  Register.Set PC main
  Register.Set P13 0x80008000

; open some windows
  WinCLEAR
  WinPOS 0% 0% 100% 50%
  List.auto
  WinPOS 0% 50% 50% 50%
  Frame /Locals /Caller
  WinPOS 50% 50% 50% 50%
  Var.Watch
  Var.AddWatch ast; flags;

  ENDDO

