; --------------------------------------------------------------------------------
; @Title: Demo script for LPC812M101FD20 on LPCXpresso812 (FLASH)
; @Description:
;   Programs the sieve demo application into the processor internal flash and
;   sets up a demo debug scenario.
;   This script can be used as a template for flashing an application.
;   Prerequisites:
;    * Connect Debug Cable to J5 using Adapter LA-3770
;      or
;      Connect Combiprobe/uTrace to J5
;    * Solder a brigde on R29 to provide a reference voltage on J5
;    * Remove R23, R24, R25, R26, R28 and R30 to disconnect onboard debugger
; @Keywords: ARM, Cortex-M0+, Flash
; @Author: STK
; @Board: LPCXpresso812
; @Chip: LPC812M101FD20
; @Copyright: (C) 1989-2020 Lauterbach GmbH, licensed for use with TRACE32(R) only
; --------------------------------------------------------------------------------
; $Id: lpcxpresso812_sieve_flash.cmm 16020 2020-05-06 09:05:20Z skrausse $


WinCLEAR

; --------------------------------------------------------------------------------
; initialize and start the debugger
RESet
SYStem.CPU LPC812M101FD20
SYStem.Option DUALPORT ON
SYStem.MemAccess DAP
SYStem.Up

; --------------------------------------------------------------------------------
; Flash programming

; prepare flash programming (declarations)
DO ~~/demo/arm/flash/lpc8xx.cmm PREPAREONLY

; Switch memory mapping to user flash mode, so that on-chip flash is 
; mapped to address 0x0--0x1ff. System Memory Remap register 
; SYSMEMREMAP:0..1 = 10b
Data.Set 0x40048000 %Long 0x02

; ReProgram Flash
FLASH.ReProgram.ALL /Erase
Data.LOAD.Elf "~~~~/midi_flash_thumb_v6m.elf"
; 2. Checksum generation
Data.SUM 0x0--0x1B /Long         ;Calculate checksum of all (other) vectors
Data.Set 0x1C %Long -Data.SUM()  ;Write the 2's complement in reserved vector's spot
; 3. Flash programming
FLASH.ReProgram.off

; --------------------------------------------------------------------------------
; Reset the target again
SYStem.Up

; --------------------------------------------------------------------------------
; start program execution
Go.direct main
WAIT !STATE.RUN()

; --------------------------------------------------------------------------------
; open some windows
WinCLEAR
Mode.Hll
WinPOS 0. 0. 116. 26.
List.auto
WinPOS 120. 0. 100. 8.
Frame.view
WinPOS 120. 14.
Var.Watch
Var.AddWatch %SpotLight ast flags
WinPOS 120. 25.
Register.view /SpotLight
WinPOS 0. 32.
Var.DRAW %DEFault sinewave

ENDDO
