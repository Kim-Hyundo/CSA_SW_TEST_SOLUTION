; --------------------------------------------------------------------------------
; @Title: Demo script for LPC11U68JBD100 on LPCXpresso11U68 (FLASH)
; @Description:
;   Programs the sieve demo application into the processor internal flash and
;   sets up a demo debug scenario.
;   This script can be used as a template for flashing an application.
;   Prerequisites:
;    * Connect Debug Cable to P1 using Adapter LA-3770
;      or
;      Connect Combiprobe/uTrace to P1
;    * Remove jumper JP1
;    * Set jumper JP2 to position 1-2
;    * YOU MUST NOT USE J5 (Link2 Micro-USB) to provide power to the board,
;      instead provide power via J3 (Target Micro-USB) or via P2-2!
; @Keywords: ARM, Cortex-M0+, Flash
; @Author: STK
; @Board: LPCXpresso11U68
; @Chip: LPC11U68JBD100
; @Copyright: (C) 1989-2019 Lauterbach GmbH, licensed for use with TRACE32(R) only
; --------------------------------------------------------------------------------
; $Id: lpcxpresso11u68_sieve_flash.cmm 15217 2019-11-04 16:17:15Z bschroefel $


WinCLEAR

; --------------------------------------------------------------------------------
; initialize and start the debugger
RESet
SYStem.RESet
SYStem.CPU LPC11U68JBD100
SYStem.CONFIG.DEBUGPORTTYPE SWD
IF COMBIPROBE()||UTRACE()
(
  SYStem.CONFIG.CONNECTOR MIPI20T
)
SYStem.Option DUALPORT ON
SYStem.MemAccess DAP
SYStem.JtagClock 10MHz
Trace.DISable
SYStem.Up

; --------------------------------------------------------------------------------
; Flash programming

; prepare flash programming (declarations)
DO ~~/demo/arm/flash/lpc11xx.cmm PREPAREONLY

; ReProgram Flash
FLASH.ReProgram ALL
Data.LOAD.Elf "~~~~/sieve_flash_thumb_v6m.elf"
; Checksum generation
Data.SUM 0x0--0x1B /Long         ;Calculate checksum of all (other) vectors
Data.Set 0x1C %Long -Data.SUM()  ;Write the 2's complement in reserved vector's spot
FLASH.ReProgram OFF

; --------------------------------------------------------------------------------
; Reset the target again
SYStem.Up

; --------------------------------------------------------------------------------
; start program execution
Go.direct main
WAIT !STATE.RUN()

; --------------------------------------------------------------------------------
; open some windows
WinCLEAR
Mode.Hll
WinPOS 0. 0. 116. 26.
List.auto
WinPOS 120. 0. 100. 8.
Frame.view
WinPOS 120. 14.
Var.Watch
Var.AddWatch %SpotLight ast flags
WinPOS 120. 25.
Register.view /SpotLight
WinPOS 0. 32.
Var.DRAW %DEFault sinewave

ENDDO
