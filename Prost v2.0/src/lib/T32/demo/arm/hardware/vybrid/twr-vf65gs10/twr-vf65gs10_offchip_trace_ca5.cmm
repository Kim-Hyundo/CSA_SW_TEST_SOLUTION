; --------------------------------------------------------------------------------
; @Title: Off-chip trace demo on Cortex-A5 of twr-vf65gs10 board
; @Description:
;   This demo shows how to configure off chip trace on twr-vf65gs10.
;   The demo connect to the CA5 and then configure the pin multiplexing
;   to export up to 16 bits ETM traces via TPIU.
;   To debug TWR-VF65GS10 revision H you have to solder a 10K resistor at R161.
; @Keywords: Cortex-A5, ETM, off-chip, trace, vybrid
; @Author: HDA
; @Board: TWR-Vf65GS10
; @Chip: VF6*
; @Copyright: (C) 1989-2019 Lauterbach GmbH, licensed for use with TRACE32(R) only
; --------------------------------------------------------------------------------
; $Id: twr-vf65gs10_offchip_trace_ca5.cmm 15217 2019-11-04 16:17:15Z bschroefel $


; Basic settings
  RESet
  SYStem.CPU VF6XX-CA5
  ETM.OFF
  SYStem.CONFIG.CORE 1. 1.
  SYStem.Mode Attach
  Break.direct

; Un-gate trace module clocks
  Data.Set ZSD:0x4006B048 %Long 0xFFFFFFFF
  Data.Set ZSD:0x4006B04C %Long 0xFFFFFFFF
  Data.Set ZSD:0x4006B008 %Long 0x01000000

; Enable trace clock and SWO and set divider
  Data.Set ZSD:0x4006B01c %Long 0x14000000
  ETM.ON

  IF Analyzer()
  (
    ; Set ETM IOMUX PADS
    Data.Set ZSD:0x40048014 %Long 0x1031C2 ;PTA12 ==> TRACECK
    Data.Set ZSD:0x40048018 %Long 0x1031C2 ;PTA16 ==> TRACED[0]
    Data.Set ZSD:0x4004801C %Long 0x1031C2 ;PTA17 ==> TRACED[1]
    Data.Set ZSD:0x40048020 %Long 0x1031C2 ;PTA18 ==> TRACED[2]
    Data.Set ZSD:0x40048024 %Long 0x1031C2 ;PTA19 ==> TRACED[3]
    Data.Set ZSD:0x40048028 %Long 0x1031C2 ;PTA20 ==> TRACED[4]
    Data.Set ZSD:0x4004802C %Long 0x1031C2 ;PTA21 ==> TRACED[5]
    Data.Set ZSD:0x40048030 %Long 0x1031C2 ;PTA22 ==> TRACED[6]
    Data.Set ZSD:0x40048034 %Long 0x1031C2 ;PTA23 ==> TRACED[7]
    Data.Set ZSD:0x40048038 %Long 0x1031C2 ;PTA24 ==> TRACED[8]
    Data.Set ZSD:0x4004803C %Long 0x1031C2 ;PTA25 ==> TRACED[9]
    Data.Set ZSD:0x40048040 %Long 0x1031C2 ;PTA26 ==> TRACED[10]
    Data.Set ZSD:0x40048044 %Long 0x1031C2 ;PTA27 ==> TRACED[11]
    Data.Set ZSD:0x40048048 %Long 0x1031C2 ;PTA28 ==> TRACED[12]
    Data.Set ZSD:0x4004804C %Long 0x1031C2 ;PTA29 ==> TRACED[13]
    Data.Set ZSD:0x40048050 %Long 0x1031C2 ;PTA30 ==> TRACED[14]
    Data.Set ZSD:0x40048054 %Long 0x1031C2 ;PTA31 ==> TRACED[15]
    Data.Set ZSD:0x4004808c %Long 0x6031C2 ;PTB13 ==> TRACECTL

    ETM.PortSize 16
    ETM.PortMode Continuous

    Trace.METHOD Analyzer
    Trace.AutoFocus
  )

; Load demo program
  Data.LOAD.Elf ~~~~/demo.axf
  Register.Set PC main
  Register.Set CPSR 0x1d3
  Register.Set R13 0x3f000100

; Avoid touching areas which react badly
  MAP.DenyAccess 0x30000000--0x3effffff
  MAP.DenyAccess 0x80000000--0xffffffff

; Open some windows
  WinCLEAR
  WinPOS 93.429 0.0 83. 34. 0. 0.
  Register.view /SpotLight
  WinPOS 0.0 0.0 86. 32. 16. 1. W001
  List.auto
  WinPOS 0.28571 39.083 86. 3. 0. 0. W003
  Var.Watch flags ast
  WinPOS 0.57143 50.0 86. 15. 5. 0. W005
  Frame.view /Locals /Caller
  WinPOS 93.286 39.167 83. 26. 12. 1.
  Trace.List

  ENDDO
