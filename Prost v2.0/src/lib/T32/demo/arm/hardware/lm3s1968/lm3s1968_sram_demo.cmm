; --------------------------------------------------------------------------------
; @Title: Run a Sieve demo in SRAM for Luminary Micro LM3S1968 Evaluation Board
; @Description: 
;     SRAM: 0x20000000--0x2000FFFF
;
; @Keywords: Cortex-M3, SWD, sieve 
; @Author: MSA
; @Board: Luminary Micro
; @Chip: LM3S1968
; @Copyright: (C) 1989-2019 Lauterbach GmbH, licensed for use with TRACE32(R) only
; --------------------------------------------------------------------------------
; $Id: lm3s1968_sram_demo.cmm 15217 2019-11-04 16:17:15Z bschroefel $

  RESet
  SYStem.RESet
  SYStem.CPU LM3S1968
;  SYStem.CONFIG.DEBUGPORTTYPE SWD

  SYStem.Up

  Data.LOAD.Elf ~~~~/sieve_ram_thumb_ii_v7.elf

  ; open some windows
  WinCLEAR

  WinPOS 0% 0% 50% 50%
  List.auto

  WinPOS 50% 0% 50% 50%
  Register.view /SpotLight

  WinPOS 0% 50% 50% 50%
  Frame /Locals /Caller

  WinPOS 50% 50% 50% 50%
  Var.DRAW sinewave
  
  GO
  WAIT 2.s
  Break
  ENDDO
