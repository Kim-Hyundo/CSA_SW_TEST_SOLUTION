; --------------------------------------------------------------------------------
; @Title: Demo script for MSR1-CM7 on STA800C with Onchip-Trace (RAM)
; @Description:
;   Loads the STM stimulus demo application into RAM and sets up a demo debug
;   scenario.
;   The code will either continuously produce raw STM data or will demonstrate
;   the STM printf trace feature by writing to STIMULUS register 0.
;   The STM data is traced using the Onchip-Trace (ETF).
;   Prerequisites:
;    * Connect Debug Cable to J14
;      or connect Combiprobe/uTrace to J14 using adapter LA-3771.
; @Keywords: ARM, MSR1, Cortex-M7, ETF, ETM, STM
; @Author: ALI
; @Board: STA800C
; @Chip: MSR1-CM7
; @Copyright: (C) 1989-2019 Lauterbach GmbH, licensed for use with TRACE32(R) only
; --------------------------------------------------------------------------------
; $Id: sta800c_cm7_stm_onchip_trace_sram.cmm 14794 2019-08-12 13:22:33Z alintner $


WinCLEAR

; --------------------------------------------------------------------------------
; initialize and start the debugger
RESet
SYStem.RESet
SYStem.CPU MSR1-CM7
IF COMBIPROBE()||UTRACE()
(
  SYStem.CONFIG.CONNECTOR MIPI20T
)
SYStem.Option DUALPORT ON
SYStem.JtagClock 10MHz
SYStem.Option EnReset OFF

; try to guess TSEL
SYStem.DETECT.IDCode
IF IDCODE(0)!=0x6BA00477 ; the ARM DAP should be the first in the JTAG chain
(
  PRINT %ERROR "No ARM Debug Access Port detected"
  ENDDO
)
IF IDCODENUMBER()>1.
(
  SYStem.CONFIG.DAPIRPRE 5.
  SYStem.CONFIG.DAPDRPRE 1.
)
Trace.DISable
ETM.OFF
ITM.OFF
STM.OFF
SYStem.Up

; --------------------------------------------------------------------------------
; load demo program (uses internal RAM only)
Data.LOAD.Elf "~~~~/stm_stimulus_ram_thumb_ii_v7m.elf"

; --------------------------------------------------------------------------------
; start program execution
Go.direct main
WAIT !STATE.RUN()

; --------------------------------------------------------------------------------
; initialize global variables
; set STM STIMULUS base address
Var.Assign pStimulusBase=0x41D00000

; --------------------------------------------------------------------------------
; initialize ONCHIP trace (ETF, ETM, STM)

; Enable CoreSight component clock
DO ~~~~/../scripts/coresight_enable
WAIT 100.ms

Trace.METHOD ONCHIP
SystemTrace.METHOD ONCHIP
ETM.Trace OFF
ETM.ON
STM.ON

; per default demonstrate data trace only
IF TRUE() ; for data trace only
(
  ; some more variable initializations for the example code
  Var.Assign bLongStimulusEnable=1
  Var.Assign nLongStimulus=0x12345678
  Var.Assign bAlternateStimulusEnable=1

  ; --------------------------------------------------------------------------------
  ; open some windows
  WinCLEAR
  Mode.Hll
  WinPOS 0. 0. 116. 26.
  List.auto
  WinPOS 120. 0. 100. 16.
  Var.Watch
  Var.AddWatch %SpotLight %Hex bByteStimulusEnable bWordStimulusEnable bLongStimulusEnable bQuadStimulusEnable
  Var.AddWatch %SpotLight %Hex bAlternateStimulusEnable
  Var.AddWatch %SpotLight %Hex nByteStimulus nWordStimulus nLongStimulus nQuadStimulus
  WinPOS 0. 32.
  SystemTrace.List
)
ELSE ; for STM string printout only
(
  ; some more variable initializations for the example code
  Var.Assign pPrintfString="STM test string"

  ; --------------------------------------------------------------------------------
  ; open some windows
  WinCLEAR
  Mode.Hll
  WinPOS 0. 0. 116. 26.
  List.auto
  WinPOS 120. 0. 100. 16.
  Var.Watch
  Var.AddWatch %SpotLight %String pPrintfString
  WinPOS 0. 32.
  SystemTrace.List
  WinPOS 120. 25.
  PrintfTrace.List MESSAGE
)

ENDDO
