; --------------------------------------------------------------------------------
; @Title: Demo script IMX8QXP-CM4 on MCIMX8QXP-CPU with Power Request
; @Description:
;   Requests Power for the CM4 core on i.MX8X using the CS-GPR.
;   Loads the sieve demo application into RAM and sets up a demo debug
;   scenario.
;   Use this script for getting started.
;   Prerequisites:
;    * Connect Debug Cable/Combiprobe to JTAG HDR using Adapter LA-3770
;    * referring to readme.txt the SCU/SC_FW firmware must be running
;    * the script tries to request power for the CM4 from the SCU/SC_FW using the
;      CS-GPR
;    * the script is tested with
;        bootimage-mx8qxp-mek-csgpr.img on a SD-Card
;      with BOOT SW2[4..1]=0y0011
; @Keywords: ARM, Cortex-M4
; @Author: AME
; @Board: MCIMX8QXP-CPU
; @Chip: IMX8QXP-CM4
; @Copyright: (C) 1989-2019 Lauterbach GmbH, licensed for use with TRACE32(R) only
; --------------------------------------------------------------------------------
; $Id: imx8qxp-m4_csgpr_powerrequest.cmm 15576 2020-01-27 10:11:09Z alintner $


WinCLEAR

; --------------------------------------------------------------------------------
; check prerequisites
IF VERSION.BUILD.BASE()<108683.
(
  PRINT %ERROR "Please use more recent software."
  ENDDO
)

; --------------------------------------------------------------------------------
; initialize and start the debugger
RESet
SYStem.RESet
SYStem.CPU IMX8QXP-CM4
SYStem.Option DUALPORT ON
SYStem.MemAccess DAP
SYStem.JtagClock CTCK 10MHz
Trace.DISable
; see readme.txt
Data.EPILOG.SEQuence SET EA:0xE0080480 %LE %Long 0x00300001
Data.EPILOG.ON
; [optional ]assertion of nRESET power cycles the board -> use ResetOut, wait
; SYStem.RESetOut
; WAIT 200ms ; boot time depends on size of bootimage!
; <PowerRequest>
SYStem.Option EnReset OFF
SYStem.Option TRST OFF
SYStem.Mode.Prepare
; DO ~~/demo/arm64/hardware/imx8/imx8x/scripts/kick_cores "M4_0 CSGPR"
DO ~~~~/../../scripts/kick_cores "M4_0 CSGPR"
; </PowerRequest>
SYStem.Mode Attach
Break

GOSUB DisableWatchdog_M4

; --------------------------------------------------------------------------------
; load demo program (uses internal RAM only)
Data.LOAD.Elf "~~~~/sieve_ram_thumb_ii_v7m.elf"

; --------------------------------------------------------------------------------
; start program execution
Go.direct main
WAIT !STATE.RUN()

; --------------------------------------------------------------------------------
; open some windows
WinCLEAR
Mode.Hll
WinPOS 0. 0. 116. 26.
List.auto
WinPOS 120. 0. 100. 8.
Frame.view
WinPOS 120. 14.
Var.Watch
Var.AddWatch %SpotLight ast flags
WinPOS 120. 25.
Register.view /SpotLight
WinPOS 0. 32.
Var.DRAW %DEFault sinewave

ENDDO

DisableWatchdog_M4:
(
  Data.Set AD:0x41420004 %Long 0xD928C520
  Data.Set AD:0x41420008 %Long 0xFFFF
  Data.Set AD:0x41420000 %Long 0y0X1Xxxxx ; (Data.Long(0x41420000)&~0x80)|0x20
  RETURN
)