; --------------------------------------------------------------------------------
; @Title: Simple demo script for IMX8MMQ-CM4 on X-8MMINILPD4-EVK (RAM)
; @Description:
;   Loads the sieve demo application into RAM and sets up a demo debug
;   scenario. The script supports two scenarios. Per default the CM4 is started
;   by the debugger.
;   Use this script for getting started.
;   Prerequisites:
;    * Connect Debug Cable to J902 using Adapter LA-3770
;      or
;      Connect Combiprobe/uTrace to J902
;    * set bootmode to SD-Card and remove SD-Card -> A53_0 will stop in BootROM
;      set SW1101[1..8]=0y01000110 SW1102[1..8]=0y00110100
; @Keywords: ARM, Cortex-M4
; @Author: ALI
; @Board: X-8MMINILPD4-EVK
; @Chip: IMX8MMQ-CM4
; @Copyright: (C) 1989-2019 Lauterbach GmbH, licensed for use with TRACE32(R) only
; --------------------------------------------------------------------------------
; $Id: x-8mminilpd4-evk_sieve_sram.cmm 15576 2020-01-27 10:11:09Z alintner $


WinCLEAR

; --------------------------------------------------------------------------------
; check prerequisites
IF VERSION.BUILD.BASE()<104665.
(
  PRINT %ERROR "Please use more recent Software! Contact support@lauterbach.com."
  ENDDO
)

; --------------------------------------------------------------------------------
; initialize and start the debugger
RESet
SYStem.RESet
SYStem.CPU IMX8MMQ-CM4
IF COMBIPROBE()||UTRACE()
(
  SYStem.CONFIG.CONNECTOR MIPI20T
)
SYStem.Option DUALPORT ON
SYStem.Option ResBreak OFF
SYStem.Option WaitIDCODE 1.5s
SYStem.Option SYSRESETREQ OFF
SYStem.MemAccess DAP
SYStem.JtagClock 10MHz
Trace.DISable
IF TRUE()
(
  ; Method 1: Assume that the CM4 is not started by the firmware
  ; kick the CM4 using the debugger
  SYStem.Mode Prepare
  WAIT 200ms ; give BootROM some time
  ; DO ~~/demo/arm64/hardware/imx8/imx8mmini/scripts/kick-cores "M4_0"
  DO ~~~~/../../scripts/kick-cores "M4_0"
  SYStem.Mode Attach
  Break
)
ELSE
(
  ; Method 2: Assume that the CM4 is started by the firmware
  ; RESET -> WAIT -> CONNECT
  SYStem.Option WaitReset <time> ; depends on firmware
  SYStem.Up
)

; --------------------------------------------------------------------------------
; load demo program (uses internal RAM only)
Data.LOAD.Elf "~~~~/sieve_ram_thumb_ii_v7m.elf"

; --------------------------------------------------------------------------------
; start program execution
Go.direct main
WAIT !STATE.RUN()

; --------------------------------------------------------------------------------
; open some windows
WinCLEAR
Mode.Hll
WinPOS 0. 0. 116. 26.
List.auto
WinPOS 120. 0. 100. 8.
Frame.view
WinPOS 120. 14.
Var.Watch
Var.AddWatch %SpotLight ast flags
WinPOS 120. 25.
Register.view /SpotLight
WinPOS 0. 32.
Var.DRAW %DEFault sinewave

ENDDO
