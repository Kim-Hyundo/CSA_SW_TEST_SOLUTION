; --------------------------------------------------------------------------------
; @Title: Demo script for IMX8MQ-CM4 on IMX8MQ-EVK with Onchip-Trace (RAM)
; @Description:
;   Loads the sieve demo application into RAM and sets up a demo debug
;   scenario.
;   The program flow is traced using the Onchip-Trace.
;   Prerequisites:
;    * Connect Debug Cable/Combiprobe to J401 using Adapter LA-3770
; @Keywords: ARM, Cortex-M4, ETM, ETR
; @Author: ALI
; @Board: IMX8MQ-EVK
; @Chip: IMX8MQ-CM4
; @Copyright: (C) 1989-2019 Lauterbach GmbH, licensed for use with TRACE32(R) only
; --------------------------------------------------------------------------------
; $Id: imx8mq-evk-m4_sieve_onchip_etr_trace_sram.cmm 15576 2020-01-27 10:11:09Z alintner $


WinCLEAR

; --------------------------------------------------------------------------------
; check prerequisites
IF VERSION.BUILD.BASE()<104665.
(
  PRINT %ERROR "Please use more recent Software! Contact support@lauterbach.com."
  ENDDO
)

; --------------------------------------------------------------------------------
; initialize and start the debugger
RESet
SYStem.RESet
SYStem.CPU IMX8MQ-CM4
IF COMBIPROBE()||UTRACE()
(
  SYStem.CONFIG.CONNECTOR MIPI20T
)
SYStem.Option DUALPORT ON
SYStem.MemAccess DAP
SYStem.JtagClock 10MHz
SYStem.Option ResBreak OFF
SYStem.Option WaitIDCODE 1.5s
Trace.DISable

; --------------------------------------------------------------------------------
; Kick Cortex M4 using the debugger.
SYStem.Mode Prepare
WAIT 200ms ; give BootROM some time
;DO ~~/demo/arm64/hardware/imx8/imx8m/scripts/kick-cores "M4_0"
DO ~~~~/../../scripts/kick-cores "M4_0"
SYStem.Attach
Break

; --------------------------------------------------------------------------------
; load demo program (uses internal RAM only)
Data.LOAD.Elf "~~~~/sieve_ram_thumb_ii_v7m.elf"

; --------------------------------------------------------------------------------
; initialize ONCHIP trace (ETR, ETM, ITM)
; these settings are generated by calling
;   DO ~~/demo/arm/etc/embedded_trace_router/etr_utility.cmm
; - we use hardcoded values here
PRIVATE &EtrAxiBase &EtrSize
&EtrAxiBase=0x910000
&EtrSize=0x10000/4.
DO "~~/demo/arm/etc/embedded_trace_router/etr_utility.cmm" ETR1 set DAB    &EtrAxiBase
DO "~~/demo/arm/etc/embedded_trace_router/etr_utility.cmm" ETR1 set RSZ    &EtrSize
DO "~~/demo/arm/etc/embedded_trace_router/etr_utility.cmm" ETR1 set AXICTL 0x00000F00 0x00000FBF
Trace.METHOD ONCHIP
Trace.TraceCONNECT ETR
Trace.AutoInit ON
ITM.DataTrace CorrelatedData
ITM.ON
ETM.Trace ON
ETM.ON

; --------------------------------------------------------------------------------
; start program execution
Go.direct main
WAIT !STATE.RUN()

; --------------------------------------------------------------------------------
; open some windows
WinCLEAR
Mode.Hll
WinPOS 0. 0. 116. 26.
List.auto
WinPOS 120. 0. 100. 8.
Frame.view
WinPOS 120. 14.
Var.Watch
Var.AddWatch %SpotLight ast flags
WinPOS 120. 25.
Trace.List
WinPOS 0. 32.
Var.DRAW %DEFault sinewave

ENDDO
