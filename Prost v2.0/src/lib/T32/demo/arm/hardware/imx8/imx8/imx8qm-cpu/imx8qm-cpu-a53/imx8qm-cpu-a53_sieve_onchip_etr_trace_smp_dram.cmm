; --------------------------------------------------------------------------------
; @Title: SMP-Demo script for IMX8QM on IMX8QM-CPU board with Onchip-Trace (RAM, SMP, ETR)
; @Description:
;   Loads the sieve demo application into RAM and sets up a demo debug
;   scenario.
;   The program flow is traced using the Onchip-Trace (ETR). Therefore a part
;   of the targets RAM is used for trace storage.
;   As not all cores are accessible after Reset we handle the start
;   of the secondary cores in the script and switch to SMP later.
;   Prerequisites:
;    * Connect Debug Cable/Combiprobe to J11 using Adapter LA-3770
;    * set SW2[1..6]=0y001100
;    * follow the instructions in readme.txt
;    * use bootimage-mx8qm-mek-bootloop-a53-m4.img
; @Keywords: ARM, Cortex-A53, ETM, ETR, SMP
; @Author: AME
; @Board: IMX8QM-CPU
; @Chip: IMX8QM
; @Copyright: (C) 1989-2019 Lauterbach GmbH, licensed for use with TRACE32(R) only
; --------------------------------------------------------------------------------
; $Id: imx8qm-cpu-a53_sieve_onchip_etr_trace_smp_dram.cmm 15576 2020-01-27 10:11:09Z alintner $


WinCLEAR

; --------------------------------------------------------------------------------
; initialize and start the debugger
RESet
SYStem.RESet
SYStem.CPU IMX8QM
SYStem.Option ResBreak OFF
SYStem.JtagClock CTCK 10MHz
CORE.ASSIGN 2. ; 1.=A72_0 2.=A53_0 3.=A72_1 4.=A53_1 5=<> 6.=A53_2 7.=<> 8.=A53_3
Trace.DISable
; assertion of nRESET power cycles the board -> use ResetOut, wait, connect
SYStem.RESetOut
WAIT 200ms ; boot time depends on size of bootimage!
SYStem.Mode.Attach
Break

; --------------------------------------------------------------------------------
; kick secondary cores
; DO ~~/demo/arm64/hardware/imx8/imx8/scripts/kick_cores "A53_234"
DO ~~~~/../../scripts/kick_cores "A53_234"

; disconnect from system and reattach in SMP mode
SYStem.Mode.Down
CORE.ASSIGN 2. 4. 6. 8.
Trace.DISable
SYStem.Mode.Attach

IF STATE.RUN()
  Break.direct

; --------------------------------------------------------------------------------
; load demo program (uses internal RAM only)
CORE.select 0.
Data.LOAD.Elf "~~~~/sieve_ram_aarch64_v8.elf"
; Set PC for all secondary cores
Register.Init /CORE 1.
Register.Set PC _start /CORE 1.
Register.Init /CORE 2.
Register.Set PC _start /CORE 2.
Register.Init /CORE 3.
Register.Set PC _start /CORE 3.

; --------------------------------------------------------------------------------
; start program execution
Go.direct main
WAIT !STATE.RUN()

; --------------------------------------------------------------------------------
; initialize ONCHIP trace (ETR, ETM)
; these settings are generated by calling
;   DO ~~/demo/arm64/etc/embedded_trace_router/etr_utility.cmm
; - we use parameters obtained from the ELF file here (section .ETR)
PRIVATE &EtrAxiBase &EtrSize
&EtrAxiBase=ADDRESS.OFFSET(sYmbol.SECADDRESS(.etr))
&EtrSize=(sYmbol.SECEND(.etr)-sYmbol.SECADDRESS(.etr)+1.)/4.
DO "~~/demo/arm64/etc/embedded_trace_router/etr_utility.cmm" ETR1 set DAB    &EtrAxiBase
DO "~~/demo/arm64/etc/embedded_trace_router/etr_utility.cmm" ETR1 set RSZ    &EtrSize
DO "~~/demo/arm64/etc/embedded_trace_router/etr_utility.cmm" ETR1 set AXICTL 0x00000F00 0x00000FBF
Trace.METHOD ONCHIP
ETM.Trace ON
ETM.ON

; --------------------------------------------------------------------------------
; open some windows
WinCLEAR
Mode.Hll
WinPOS 0. 0. 116. 26.
List.auto
WinPOS 120. 0. 100. 8.
Frame.view
WinPOS 120. 14.
Var.Watch
Var.AddWatch %SpotLight ast flags
WinPOS 120. 25.
Trace.List
WinPOS 0. 32.
Var.DRAW %DEFault sinewave

ENDDO
