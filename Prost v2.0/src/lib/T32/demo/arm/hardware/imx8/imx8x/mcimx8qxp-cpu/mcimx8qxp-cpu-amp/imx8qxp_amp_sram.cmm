; --------------------------------------------------------------------------------
; @Title: AMP-Demo script for IMX8QXP on MCIMX8QXP-CPU (AMP, RAM)
; @Description:
;   Setup a AMP debug session using a single script approach.
;   Loads the sieve demo application into RAM and sets up a demo debug
;   scenario.
;   Use this script to test the AMP-Debugging.
;   Prerequisites:
;    * Connect Debug Cable/Combiprobe to JTAG HDR using Adapter LA-3770
;    * on some boards reset is not properly working -> please power cycle the board
;    * follow the instructions in readme.txt
;    * use the bootimage-mx8qxp-mek-bootloop-a35-m4.img
;    * TRACE32 is started using the .bat/.sh file in this directory
; @Keywords: ARM
; @Author: AME
; @Board: MCIMX8QXP-CPU
; @Chip: IMX8QXP
; @Copyright: (C) 1989-2019 Lauterbach GmbH, licensed for use with TRACE32(R) only
; --------------------------------------------------------------------------------
; $Id: imx8qxp_amp_sram.cmm 14147 2019-03-18 14:13:52Z bschroefel $


WinCLEAR

; --------------------------------------------------------------------------------
; check prerequisites
IF SYStem.INSTANCE()<1.
(
  PRINT %ERROR "TRACE32 is not running in AMP mode! Use .bat/.sh file in this directory."
  ENDDO
)

; store current script path in &ppd
PRIVATE &ppd
&ppd=OS.PPD()

; --------------------------------------------------------------------------------
; close any existing REMOTE GUIs
IC OTHERS QUIT

; --------------------------------------------------------------------------------
; open all SLAVE GUIs
IF !INTERCOM.PING(M4_1)
  TargetSystem.NewInstance M4_1 /ARCHitecture ARM

; --------------------------------------------------------------------------------
; set titles for SLAVE GUIs
TITLE "TRACE32 for ARM64 - IMX8QXP - MASTER"
InterCom M4_1 TITLE "TRACE32 for ARM - IMX8QXP-CM4 - SLAVE1"

; --------------------------------------------------------------------------------
; common SYStem settings
RESet
InterCom M4_1 RESet
SYStem.RESet
InterCom M4_1 SYStem.RESet
SYStem.CPU IMX8QXP
SYStem.CONFIG CORE 1. 1.
SYStem.CONFIG SLAVE OFF
InterCom M4_1 SYStem.CPU IMX8QXP-CM4
InterCom M4_1 SYStem.CONFIG CORE 2. 1.
InterCom M4_1 SYStem.CONFIG SLAVE ON

; disable Trace for connection phase
ETM.OFF
STM.OFF
Trace.DISable
InterCom M4_1 ETM.OFF
InterCom M4_1 ITM.OFF
InterCom M4_1 STM.OFF
InterCom M4_1 Trace.DISable

SYStem.Mode.Attach
Break.direct

; --------------------------------------------------------------------------------
; kick secondary cores
; DO ~~/demo/arm64/hardware/imx8/imx8x/scripts/kick_cores "A35_234 M4_0"
DO ~~~~/../../scripts/kick_cores "A35_234 M4_0"
GOSUB InitHw_M4
GOSUB DisableWatchdog_M4

; --------------------------------------------------------------------------------
; attach to all cores on all sessions
SYStem.Down
CORE.ASSIGN 1. 2. 3. 4.
Trace.DISable
SYStem.Mode.Attach
InterCom M4_1 SYStem.Mode.Up

; --------------------------------------------------------------------------------
; load demo program on all sessions (use internal RAM only)
CORE.select 0.
Data.LOAD.Elf &(ppd)/master/sieve_ram_aarch64_v8.elf
InterCom M4_1 Data.LOAD.Elf &(ppd)/slave1/sieve_ram_thumb_ii_v7m.elf

Register.Set PC _start /CORE 1.
Register.Set PC _start /CORE 2.
Register.Set PC _start /CORE 3.

; --------------------------------------------------------------------------------
; start program execution
Go.direct main\1
WAIT !STATE.RUN()
InterCom M4_1 Go.direct main\1
InterCom M4_1 WAIT !STATE.RUN()

; --------------------------------------------------------------------------------
; open some windows
WinCLEAR
Mode.Hll
WinPOS 0. 0. 116. 26.
List.auto
InterCom M4_1 WinCLEAR
InterCom M4_1 Mode.Hll
InterCom M4_1 WinPOS 0. 0. 116. 26.
InterCom M4_1 List.auto

ENDDO

InitHw_M4:
(
  ; Configure LMEM Parity/ECC Control Register
  ;
  ; Note: ECC Multi-bit IRQ should be disabled
  ;       prior to list/dump of locations that
  ;       have not been written to avoid vectoring
  ;       to the NMI
  ;
  ; 31:22 RESERVED
  ; 21    Enable Cache Parity IRQ
  ; 20    Enable Cache Parity Report
  ; 19:17 RESERVED
  ; 16    Enable RAM Parity Reporting
  ; 15:10 RESERVED
  ; 9     Enable RAM ECC 1-bit IRQ
  ; 8     Enable RAM ECC 1-bit Report
  ; 7:2   RESERVED
  ; 1     Enable RAM ECC Multi-bit IRQ
  ; 0     Enable RAM ECC Multi-bit

  InterCom M4_1 Data.Set AD:0xE0080480 %LE %Long 0x00300001
  RETURN
)

DisableWatchdog_M4:
(
  InterCom M4_1 Data.Set AD:0x41420004 %Long 0xD928C520
  InterCom M4_1 Data.Set AD:0x41420008 %Long 0xFFFF
  InterCom M4_1 Data.Set AD:0x41420000 %Long 0y0X1Xxxxx ; (Data.Long(0x41420000)&~0x80)|0x20
  RETURN
)