; --------------------------------------------------------------------------------
; @Title: Simple demo script for IMX8QXP on MCIMX8QXP-CPU (RAM)
; @Description:
;   Loads the sieve demo application into RAM and sets up a demo debug
;   scenario.
;   Use this script for getting started.
;   Prerequisites:
;    * Connect Debug Cable/Combiprobe to JTAG HDR using Adapter LA-3770
;    * on some boards reset is not properly working -> please power cycle the board
;    * follow the instructions in readme.txt
;    * use the bootimage-mx8qxp-mek-bootloop-a35-m4.img
; @Keywords: ARM, Cortex-A35
; @Author: AME
; @Board: MCIMX8QXP-CPU
; @Chip: IMX8QXP
; @Copyright: (C) 1989-2019 Lauterbach GmbH, licensed for use with TRACE32(R) only
; --------------------------------------------------------------------------------
; $Id: imx8qxp-a35_sieve_sram.cmm 15576 2020-01-27 10:11:09Z alintner $


WinCLEAR

; --------------------------------------------------------------------------------
; initialize and start the debugger
RESet
SYStem.RESet
SYStem.CPU IMX8QXP
SYStem.JtagClock CTCK 10MHz
CORE.ASSIGN 1.
Trace.DISable
SYStem.Mode.Attach
Break

; --------------------------------------------------------------------------------
; load demo program (uses internal RAM only)
Data.LOAD.Elf "~~~~/sieve_ram_aarch64_v8.elf"

; --------------------------------------------------------------------------------
; start program execution
Go.direct main
WAIT !STATE.RUN()

; --------------------------------------------------------------------------------
; open some windows
WinCLEAR
Mode.Hll
WinPOS 0. 0. 116. 26.
List.auto
WinPOS 120. 0. 100. 8.
Frame.view
WinPOS 120. 14.
Var.Watch
Var.AddWatch %SpotLight ast flags
WinPOS 120. 25.
Register.view /SpotLight
WinPOS 0. 32.
Var.DRAW %DEFault sinewave

ENDDO
