; --------------------------------------------------------------------------------
; @Title: Simple SMP demo script for IMX8MQ on IMX8MQ-EVK (RAM, SMP)
; @Description:
;   Loads the sieve demo application into RAM and sets up a demo debug scenario
;   on all cores.
;   Use this script for getting started.
;   As not all cores are accessible after Reset (SYStem.Up) we handle the start
;   of the secondary cores in the script and switch to SMP later.
;   Prerequisites:
;    * Connect Debug Cable/Combiprobe to J401 using Adapter LA-3770
; @Keywords: ARM, Cortex-A53, SMP
; @Author: AME
; @Board: IMX8MQ-EVK
; @Chip: IMX8MQ*
; @Copyright: (C) 1989-2019 Lauterbach GmbH, licensed for use with TRACE32(R) only
; --------------------------------------------------------------------------------
; $Id: imx8mq-evk-a53_sieve_smp_sram.cmm 15576 2020-01-27 10:11:09Z alintner $


WinCLEAR

; --------------------------------------------------------------------------------
; check prerequisites
IF VERSION.BUILD.BASE()<104665.
(
  PRINT %ERROR "Please use more recent Software! Contact support@lauterbach.com."
  ENDDO
)

; --------------------------------------------------------------------------------
; initialize and start the debugger
RESet
SYStem.RESet
SYStem.CPU IMX8MQ
SYStem.JtagClock CTCK 10MHz
SYStem.Option ResBreak OFF
SYStem.Option WaitIDCODE 1.5s
CORE.ASSIGN 1.    ; select only master core 1 - 1. first core, 2. second core, 1. 2. first + second core (SMP) ...
Trace.DISable
SYStem.Up

; --------------------------------------------------------------------------------
; kick secondary cores
; DO ~~/demo/arm64/hardware/imx8/imx8m/scripts/kick-cores "A53_234"
DO ~~~~/../../scripts/kick-cores "A53_234"

; disconnect from system and reattach in SMP mode
SYStem.Mode.Down
CORE.ASSIGN 1. 2. 3. 4.
Trace.DISable
SYStem.Mode.Attach

IF STATE.RUN()
  Break.direct

; --------------------------------------------------------------------------------
; load demo program (uses internal RAM only)
CORE.select 0.
Data.LOAD.Elf "~~~~/sieve_ram_aarch64_v8.elf"
; Set PC for all secondary cores
Register.Init /CORE 1.
Register.Set PC _start /CORE 1.
Register.Init /CORE 2.
Register.Set PC _start /CORE 2.
Register.Init /CORE 3.
Register.Set PC _start /CORE 3.

; --------------------------------------------------------------------------------
; start program execution
Go.direct main
WAIT !STATE.RUN()

; --------------------------------------------------------------------------------
; open some windows
WinCLEAR
Mode.Hll
WinPOS 0. 0. 116. 26.
List.auto
WinPOS 120. 0. 100. 8.
Frame.view
WinPOS 120. 14.
Var.Watch
Var.AddWatch %SpotLight ast flags
WinPOS 120. 25.
Register.view /SpotLight
WinPOS 0. 32.
Var.DRAW %DEFault sinewave

ENDDO
