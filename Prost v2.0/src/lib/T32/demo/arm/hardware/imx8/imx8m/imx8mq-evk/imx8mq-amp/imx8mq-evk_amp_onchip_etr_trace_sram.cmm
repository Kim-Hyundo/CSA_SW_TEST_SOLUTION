; --------------------------------------------------------------------------------
; @Title: AMP-Demo script for IMX8MQ with Onchip-Trace (AMP, RAM, ETR)
; @Description:
;   Setup a AMP debug session using a single script approach.
;   Loads the sieve demo application into RAM and sets up a demo debug
;   scenario.
;   The program flow is traced using the Onchip-Trace (ETR). Therefore a part
;   of the targets RAM is used for trace storage.
;   Prerequisites:
;    * Connect Debug Cable/Combiprobe to J1601 using Adapter LA-3770
;    * press the Reset Button J2 before running the script
;    * TRACE32 is started using the .bat/.sh file in this directory
; @Keywords: ARM, ETM, ETR
; @Author: AME
; @Board: IMX8MQ-EVK
; @Chip: IMX8MQ*
; @Copyright: (C) 1989-2019 Lauterbach GmbH, licensed for use with TRACE32(R) only
; --------------------------------------------------------------------------------
; $Id: imx8mq-evk_amp_onchip_etr_trace_sram.cmm 15576 2020-01-27 10:11:09Z alintner $


WinCLEAR

; --------------------------------------------------------------------------------
; check prerequisites
IF SYStem.INSTANCE()<1.
(
  PRINT %ERROR "TRACE32 is not running in AMP mode! Use .bat/.sh file in this directory."
  ENDDO
)
IF VERSION.BUILD.BASE()<104665.
(
  PRINT %ERROR "Please use more recent Software! Contact support@lauterbach.com."
  ENDDO
)

; store current script path in &ppd
PRIVATE &ppd
&ppd=OS.PPD()

; --------------------------------------------------------------------------------
; close any existing REMOTE GUIs
IC OTHERS QUIT

; --------------------------------------------------------------------------------
; open all SLAVE GUIs
IF !INTERCOM.PING(M4_1)
  TargetSystem.NewInstance M4_1 /ARCHitecture ARM

; --------------------------------------------------------------------------------
; set titles for SLAVE GUIs
TITLE "TRACE32 for ARM64 - IMX8MQ - MASTER"
InterCom M4_1 TITLE "TRACE32 for ARM - IMX8MQ-CM4 - SLAVE1"

; --------------------------------------------------------------------------------
; common SYStem settings
RESet
InterCom M4_1 RESet
SYStem.RESet
InterCom M4_1 SYStem.RESet
SYStem.CPU IMX8MQ
SYStem.CONFIG CORE 1. 1.
SYStem.CONFIG SLAVE OFF
SYStem.Option ResBreak OFF
SYStem.Option WaitIDCODE 1.5s
InterCom M4_1 SYStem.CPU IMX8MQ-CM4
InterCom M4_1 SYStem.CONFIG CORE 2. 1.
InterCom M4_1 SYStem.CONFIG SLAVE ON

; disable Trace for connection phase
ETM.OFF
InterCom M4_1 ETM.OFF
InterCom M4_1 ITM.OFF
Trace.DISable

SYStem.Up

; --------------------------------------------------------------------------------
; kick secondary cores
; DO ~~/demo/arm64/hardware/imx8/imx8m/scripts/kick-cores "M4_0 A53_234"
DO ~~~~/../../scripts/kick-cores "M4_0 A53_234"

; --------------------------------------------------------------------------------
; attach to all cores on all sessions
SYStem.Down
CORE.ASSIGN 1. 2. 3. 4.
Trace.DISable
SYStem.Mode.Attach
InterCom M4_1 SYStem.Mode.Up

; --------------------------------------------------------------------------------
; load demo program on all sessions (use internal RAM only)
CORE.select 0.
Data.LOAD.Elf &(ppd)/master/sieve_ram_aarch64_v8.elf
InterCom M4_1 Data.LOAD.Elf &(ppd)/slave1/sieve_ram_thumb_ii_v7m.elf

Register.Set PC _start /CORE 1.
Register.Set PC _start /CORE 2.
Register.Set PC _start /CORE 3.

; --------------------------------------------------------------------------------
; initialize ONCHIP trace (ETR)
; these settings are generated by calling
;   DO ~~/demo/arm64/etc/embedded_trace_router/etr_utility.cmm
; - we use parameters obtained from the ELF file here (section .ETR)
PRIVATE &EtrAxiBase &EtrSize
&EtrAxiBase=ADDRESS.OFFSET(sYmbol.SECADDRESS(.etr))
&EtrSize=(sYmbol.SECEND(.etr)-sYmbol.SECADDRESS(.etr)+1.)/4.
DO "~~/demo/arm64/etc/embedded_trace_router/etr_utility.cmm" ETR1 set DAB    &EtrAxiBase
DO "~~/demo/arm64/etc/embedded_trace_router/etr_utility.cmm" ETR1 set RSZ    &EtrSize
DO "~~/demo/arm64/etc/embedded_trace_router/etr_utility.cmm" ETR1 set AXICTL 0x00000F00 0x00000FBF
Trace.METHOD ONCHIP
Trace.TraceCONNECT ETR
InterCom M4_1 Trace.METHOD ONCHIP
InterCom M4_1 Trace.TraceCONNECT ETR

ETM.TraceID 1.
ETM.Trace ON
ETM.ON
InterCom M4_1 ETM.TraceID 5.
InterCom M4_1 ETM.Trace ON
InterCom M4_1 ETM.ON

; --------------------------------------------------------------------------------
; start program execution
Go.direct main\1
WAIT !STATE.RUN()
InterCom M4_1 Go.direct main\1
InterCom M4_1 WAIT !STATE.RUN()

; --------------------------------------------------------------------------------
; open some windows
WinCLEAR
Mode.Hll
WinPOS 0. 0. 116. 26.
List.auto
WinPOS 0. 32.
Trace.List
InterCom M4_1 WinCLEAR
InterCom M4_1 Mode.Hll
InterCom M4_1 WinPOS 0. 0. 116. 26.
InterCom M4_1 List.auto
InterCom M4_1 WinPOS 0. 32.
InterCom M4_1 Trace.List

ENDDO
