; --------------------------------------------------------------------------------
; @Title: Kick secondary cores on i.MX8MQ
; @Description:
;   This script assists in starting the secondary cores on a i.MX8MQ. The scripts
;   are tested in a bare metal environment only.
;   Parameters:
;     A53_234    - kick secondary A53 cores
;     M4_0       - kick M4 core
;     NOBOOTLOOP - don't assemble a bootloop into TCM/DDR
;   Usage:
;     DO kick_cores "A53_234"
;     DO kick_cores "M4_0"
;
; @Keywords: ARM, i.MX8, IPC
; @Author: AME
; @Board: -
; @Chip: IMX8MQ* IMX8MD*
; @Copyright: (C) 1989-2019 Lauterbach GmbH, licensed for use with TRACE32(R) only
; --------------------------------------------------------------------------------
; $Id: kick-cores.cmm 14125 2019-03-14 07:19:32Z bschroefel $

PRIVATE &params
ENTRY %LINE &params

PRIVATE &bA53_234 &bM4_0 &bM4_1 &bNoBootloop
&params=STRing.UPpeR("&params")
&bA53_234=STRing.SCAN("&params","A53_234",0.)>=0.
&bM4_0=STRing.SCAN("&params","M4_0",0.)>=0.
&bNoBootloop=STRing.SCAN("&params","NOBOOTLOOP",0.)>=0.


IF &bM4_0
(
  IF !&bNoBootloop
  (
    ; assemble a endless loop to TCM
    Data.Set ENAHB:0x7e0000 %Long 0x8000
    Data.Set ENAHB:0x7e0004 %Long 0x8|0x1
    Data.Set ENAHB:0x7e0008 %Long 0xe7fee7fe
  )

  ; CCM_CCGR1 - enable CM4 Clocks
  Data.Set ENAHB:0x30384010 %Long 0x0
  ; SRC_M4RCR - release reset
  Data.Set ENAHB:0x3039000C %LE %Long (Data.Long(ENAHB:0x3039000C)&~0x1)|0x4
)

IF &bA53_234
(
  IF !&bNoBootloop
  (
    ; assemble a endless loop to OCM
    Data.Set AD:0x900000 %Long 0x14000000 // b $+0x0
  )

  ; disable cores
  Data.Set AD:0x30390008 %Long Data.Long(AD:0x30390008)&~0xe
  ; set start address
  PRIVATE &hi &lo
  &lo=((0x900000>>2.)>>22.)&0xffff
  &hi=((0x900000>>2.))&0x003fffff
  Data.Set AD:0x3039007C %Long &lo &hi
  Data.Set AD:0x30390084 %Long &lo &hi
  Data.Set AD:0x3039008C %Long &lo &hi
  Data.Set AD:0x30390008 %Long Data.Long(AD:0x30390008)|0xf
)

ENDDO