; --------------------------------------------------------------------------------
; @Title: AMP-Demo script for IMX8QM on MCIMX8QM-CPU (AMP, RAM)
; @Description:
;   Setup a AMP debug session using a single script approach.
;   Loads the sieve demo application into RAM and sets up a demo debug
;   scenario.
;   Use this script to test the AMP-Debugging.
;   Prerequisites:
;    * Connect Debug Cable/Combiprobe to J11 using Adapter LA-3770
;    * set SW2[1..6]=0y001100
;    * follow the instructions in readme.txt
;    * use bootimage-mx8qm-mek-bootloop-a53-m4.img
; @Keywords: ARM
; @Author: AME
; @Board: MCIMX8QM-CPU
; @Chip: IMX8QM
; @Copyright: (C) 1989-2019 Lauterbach GmbH, licensed for use with TRACE32(R) only
; --------------------------------------------------------------------------------
; $Id: imx8qm-cpu_amp_sram.cmm 15576 2020-01-27 10:11:09Z alintner $


WinCLEAR

; --------------------------------------------------------------------------------
; check prerequisites
IF SYStem.INSTANCE()!=1.
(
  PRINT %ERROR "This file must be called from MASTER GUI!"
  ENDDO
)

; store current script path in &ppd
PRIVATE &ppd
&ppd=OS.PPD()

; --------------------------------------------------------------------------------
; [optional] close any existing REMOTE GUIs
; IC OTHERS QUIT

; --------------------------------------------------------------------------------
; open all SLAVE GUIs
IF !INTERCOM.PING(M4_0)
  TargetSystem.NewInstance M4_0 /ARCHitecture ARM
IF !INTERCOM.PING(M4_1)
  TargetSystem.NewInstance M4_1 /ARCHitecture ARM

; --------------------------------------------------------------------------------
; set titles for SLAVE GUIs
TITLE "TRACE32 for ARM64 - IMX8QM - MASTER"
InterCom M4_0 TITLE "TRACE32 for ARM - IMX8QM-CM4-0 - SLAVE1"
InterCom M4_1 TITLE "TRACE32 for ARM - IMX8QM-CM4-1 - SLAVE2"

; --------------------------------------------------------------------------------
; common SYStem settings
RESet
InterCom M4_0 RESet
InterCom M4_1 RESet
SYStem.RESet
InterCom M4_0 SYStem.RESet
InterCom M4_1 SYStem.RESet
SYStem.CPU IMX8QM
SYStem.CONFIG CORE 1. 1.
SYStem.CONFIG SLAVE OFF
CORE.ASSIGN 2. ; 1.=A72_0 2.=A53_0 3.=A72_1 4.=A53_1 5=<> 6.=A53_2 7.=<> 8.=A53_3
Trace.DISable
InterCom M4_0 SYStem.CPU IMX8QM-CM4-0
InterCom M4_0 SYStem.CONFIG CORE 2. 1.
InterCom M4_0 SYStem.CONFIG SLAVE ON
InterCom M4_1 SYStem.CPU IMX8QM-CM4-1
InterCom M4_1 SYStem.CONFIG CORE 3. 1.
InterCom M4_1 SYStem.CONFIG SLAVE ON

; disable Trace for connection phase
ETM.OFF
STM.OFF
InterCom M4_0 ETM.OFF
InterCom M4_0 ITM.OFF
InterCom M4_0 Trace.DISable
InterCom M4_1 ETM.OFF
InterCom M4_1 ITM.OFF
InterCom M4_1 Trace.DISable

SYStem.RESetOut
WAIT 200ms ; boot time depends on size of bootimage!
SYStem.Mode.Attach
Break

; --------------------------------------------------------------------------------
; kick secondary A53&A72 cores
; DO ~~/demo/arm64/hardware/imx8/imx8/scripts/kick_cores "A53_234 A72_1 A72_2"
DO ~~~~/../../scripts/kick_cores "A53_234 A72_1 A72_2"

; --------------------------------------------------------------------------------
; attach to secondary A53&A72 cores
SYStem.Down
CORE.ASSIGN 1. 2. 3. 4. 6. 8.
Trace.DISable
SYStem.Mode.Attach
; --------------------------------------------------------------------------------
; kick&attach M4_0&1 cores
; M4_0&1 are already started by bootimage-mx8qm-mek-bootloop-a53-m4.img
; DO ~~/demo/arm64/hardware/imx8/imx8/scripts/kick_cores "M4_0"
; DO ~~~~/../../scripts/kick_cores "M4_0"
InterCom M4_0 SYStem.Mode.Attach
InterCom M4_0 Break
; DO ~~/demo/arm64/hardware/imx8/imx8/scripts/kick_cores "M4_1"
; DO ~~~~/../../scripts/kick_cores "M4_1"
InterCom M4_1 SYStem.Mode.Attach
InterCom M4_1 Break

; --------------------------------------------------------------------------------
; init HW and disable Watchdogs of M4_0&1
GOSUB InitHw_M4_0
GOSUB DisableWatchdog_M4_0
GOSUB InitHw_M4_1
GOSUB DisableWatchdog_M4_1

; --------------------------------------------------------------------------------
; load demo program on all sessions (use internal RAM only)
CORE.select 0.
Data.LOAD.Elf &(ppd)/master/sieve_ram_aarch64_v8.elf
InterCom M4_0 Data.LOAD.Elf &(ppd)/slave1/sieve_ram_thumb_ii_v7m.elf
InterCom M4_1 Data.LOAD.Elf &(ppd)/slave2/sieve_ram_thumb_ii_v7m.elf

Register.Set PC _start_secondary /CORE 1.
Register.Set PC _start /CORE 2.
Register.Set PC _start /CORE 3.
Register.Set PC _start /CORE 4.
Register.Set PC _start /CORE 5.

; --------------------------------------------------------------------------------
; start program execution
Go.direct main\1
WAIT !STATE.RUN()
InterCom M4_0 Go.direct main\1
InterCom M4_0 WAIT !STATE.RUN()
InterCom M4_1 Go.direct main\1
InterCom M4_1 WAIT !STATE.RUN()

; --------------------------------------------------------------------------------
; open some windows
WinCLEAR
Mode.Hll
WinPOS 0. 0. 116. 26.
List.auto
InterCom M4_0 WinCLEAR
InterCom M4_0 Mode.Hll
InterCom M4_0 WinPOS 0. 0. 116. 26.
InterCom M4_0 List.auto
InterCom M4_1 WinCLEAR
InterCom M4_1 Mode.Hll
InterCom M4_1 WinPOS 0. 0. 116. 26.
InterCom M4_1 List.auto

ENDDO

InitHw_M4_0:
(
  ; Configure LMEM Parity/ECC Control Register
  ;
  ; Note: ECC Multi-bit IRQ should be disabled
  ;       prior to list/dump of locations that
  ;       have not been written to avoid vectoring
  ;       to the NMI
  ;
  ; 31:22 RESERVED
  ; 21    Enable Cache Parity IRQ
  ; 20    Enable Cache Parity Report
  ; 19:17 RESERVED
  ; 16    Enable RAM Parity Reporting
  ; 15:10 RESERVED
  ; 9     Enable RAM ECC 1-bit IRQ
  ; 8     Enable RAM ECC 1-bit Report
  ; 7:2   RESERVED
  ; 1     Enable RAM ECC Multi-bit IRQ
  ; 0     Enable RAM ECC Multi-bit

  InterCom M4_0 Data.Set AD:0xE0080480 %LE %Long 0x00300001
  RETURN
)

DisableWatchdog_M4_0:
(
  InterCom M4_0 Data.Set AD:0x41420004 %Long 0xD928C520
  InterCom M4_0 Data.Set AD:0x41420008 %Long 0xFFFF
  InterCom M4_0 Data.Set AD:0x41420000 %Long 0y0X1Xxxxx ; (Data.Long(0x41420000)&~0x80)|0x20
  ; M4_0 Data.Assemble r(pc) movw r0,#0x0 movt r0,#0x4142 movw r1,#0xc520 movt r1,#0xd928 movw r2,#0xffff str r1,[r0,#0x4] str r2,[r0,#0x8] ldr r3,[r0] bic.w r3,r3,#0x80 orr r3,r3,#0x20 str r3,[r0] bkpt #0
  ; M4_0 Go
  ; M4_0 WAIT !STATE.RUN()
  RETURN
)

InitHw_M4_1:
(
  ; Configure LMEM Parity/ECC Control Register
  ;
  ; Note: ECC Multi-bit IRQ should be disabled
  ;       prior to list/dump of locations that
  ;       have not been written to avoid vectoring
  ;       to the NMI
  ;
  ; 31:22 RESERVED
  ; 21    Enable Cache Parity IRQ
  ; 20    Enable Cache Parity Report
  ; 19:17 RESERVED
  ; 16    Enable RAM Parity Reporting
  ; 15:10 RESERVED
  ; 9     Enable RAM ECC 1-bit IRQ
  ; 8     Enable RAM ECC 1-bit Report
  ; 7:2   RESERVED
  ; 1     Enable RAM ECC Multi-bit IRQ
  ; 0     Enable RAM ECC Multi-bit

  InterCom M4_1 Data.Set AD:0xE0080480 %LE %Long 0x00300001
  RETURN
)

DisableWatchdog_M4_1:
(
  InterCom M4_1 Data.Set AD:0x41420004 %Long 0xD928C520
  InterCom M4_1 Data.Set AD:0x41420008 %Long 0xFFFF
  InterCom M4_1 Data.Set AD:0x41420000 %Long 0y0X1Xxxxx ; (Data.Long(0x41420000)&~0x80)|0x20
  ; M4_0 Data.Assemble r(pc) movw r0,#0x0 movt r0,#0x4142 movw r1,#0xc520 movt r1,#0xd928 movw r2,#0xffff str r1,[r0,#0x4] str r2,[r0,#0x8] ldr r3,[r0] bic.w r3,r3,#0x80 orr r3,r3,#0x20 str r3,[r0] bkpt #0
  ; M4_0 Go
  ; M4_0 WAIT !STATE.RUN()
  RETURN
)