; --------------------------------------------------------------------------------
; @Title: Simple SMP demo script for IMX8QM on MX8QMLPD4CPU (RAM, SMP)
; @Description:
;   Loads the sieve demo application into RAM and sets up a demo debug scenario
;   on all cores.
;   Use this script for getting started.
;   We handle the start of the secondary (A53) cores in the script and switch to
;   SMP later.
;   Prerequisites:
;    * Connect Debug Cable/Combiprobe to J500 using Adapter LA-3770
;    * on some boards reset is not properly working -> please power cycle the board
;    * follow the instructions in readme.txt
;    * use bootimage-imx8qmlpd4cpu-bootloop-a53.img
; @Keywords: ARM, Cortex-A53, SMP
; @Author: AME
; @Board: MX8QMLPD4CPU
; @Chip: IMX8QM
; @Copyright: (C) 1989-2019 Lauterbach GmbH, licensed for use with TRACE32(R) only
; --------------------------------------------------------------------------------
; $Id: imx8qm-lpd4cpu-a53_sieve_smp_dram.cmm 15576 2020-01-27 10:11:09Z alintner $


WinCLEAR

; --------------------------------------------------------------------------------
; initialize and start the debugger
RESet
SYStem.RESet
SYStem.CPU IMX8QM
SYStem.Option ResBreak OFF
; WaitReset is highly dependent on Bootsource & imx-image size
SYStem.Option WaitReset 200.ms
SYStem.JtagClock CTCK 10MHz
CORE.ASSIGN 2. ; 1.=A72_0 2.=A53_0 3.=A72_1 4.=A53_1 5=<> 6.=A53_2 7.=<> 8.=A53_3
Trace.DISable
SYStem.Up

; --------------------------------------------------------------------------------
; kick secondary cores
; DO ~~/demo/arm64/hardware/imx8/imx8/scripts/kick_cores "A53_234"
DO ~~~~/../../scripts/kick_cores "A53_234"

; disconnect from system and reattach in SMP mode
SYStem.Mode.Down
CORE.ASSIGN 2. 4. 6. 8.
Trace.DISable
SYStem.Mode.Attach

IF STATE.RUN()
  Break.direct

; --------------------------------------------------------------------------------
; load demo program (uses internal RAM only)
CORE.select 0.
Data.LOAD.Elf "~~~~/sieve_ram_aarch64_v8.elf"
; Set PC for all secondary cores
Register.Init /CORE 1.
Register.Set PC _start /CORE 1.
Register.Init /CORE 2.
Register.Set PC _start /CORE 2.
Register.Init /CORE 3.
Register.Set PC _start /CORE 3.

; --------------------------------------------------------------------------------
; start program execution
Go.direct main
WAIT !STATE.RUN()

; --------------------------------------------------------------------------------
; open some windows
WinCLEAR
Mode.Hll
WinPOS 0. 0. 116. 26.
List.auto
WinPOS 120. 0. 100. 8.
Frame.view
WinPOS 120. 14.
Var.Watch
Var.AddWatch %SpotLight ast flags
WinPOS 120. 25.
Register.view /SpotLight
WinPOS 0. 32.
Var.DRAW %DEFault sinewave

ENDDO
