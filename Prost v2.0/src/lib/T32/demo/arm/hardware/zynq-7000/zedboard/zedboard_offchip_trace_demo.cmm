; --------------------------------------------------------------------------------
; @Title: Off-chip Trace demo script for the ZedBoard
; @Description:
;   Configures the off-chip trace for the ZedBoard.
;   On the ZEDBOARD board the only way to use the TRACE port is to attach the
;   XILINX HW_FMC-105-DEBUG board to J3 FMC1 connector.
;   A design that routes TRACECLK, TRACECTRL and TRACEDATA[15:0] signals has
;   to be programmend to the FPGA. Please note that the TRACECLK on the output
;   must be half the TPIU input clock.
;   Prerequisites:
;     * Debugger or Combiprobe is connected to 
;       14pin JTAG header using LA-3881 adapter
;     *  MIO[6..2]=0y00000 - JTAG BOOT
;       or
;        MIO[6..2]=0y01100 - SD BOOT and remove the SD-Card
;     * HW-FMC-105-DEBUG card is plugged
;     * a Jumper is set between J5-TDI+TDO on HW-FMC-105-DEBUG
;     * AutoFocus Preprocessor is connected to Mictor38 header on
;       HW-FMC-105-DEBUG
; @Keywords: Cortex-A9, ETM, PTM, Trace, Xilinx, Zynq, Zynq7000
; @Board: ZedBoard
; @Chip: Zynq-7000
; @Author: KJM
; @Copyright: (C) 1989-2019 Lauterbach GmbH, licensed for use with TRACE32(R) only
; --------------------------------------------------------------------------------
; $Id: zedboard_offchip_trace_demo.cmm 15217 2019-11-04 16:17:15Z bschroefel $

LOCAL &ppd
&ppd=OS.PPD()

WinCLEAR
RESet
SYStem.RESet

AREA.CLEAR
WinPOS 0.14286 32.167 80. 25. 0. 0. W002
AREA.view

SYStem.CPU ZYNQ-7000
; set DaisyChaining Parameters of the board
; check e.g. SYStem.DETECT.ShowCHAIN
SYStem.CONFIG DAPIRPRE  6.
SYStem.CONFIG DAPIRPOST 0.
SYStem.CONFIG DAPDRPRE  1.
SYStem.CONFIG DAPDRPOST 0.

; trigger a soft-reset using the AHB Bus -> we loose the connection
SYStem.Mode.Prepare
ON ERROR CONTinue
Data.Set EAHB:0xF8000008 %Long 0xDF0D
Data.Set EAHB:0xF8000200 %Long 0x1
WAIT 0.1s
PRINT ""
ON ERROR inherit

SYStem.Mode.Attach

IF STATE.RUN()
  Break

PRINT "initializing the target"
DO "~~/demo/arm/hardware/zynq-7000/scripts/trace/ps7_init.cmm" "&ppd/ps7_init.tcl"

PRINT "programming the FPGA design"
LOCAL &bitfile
&bitfile="&ppd/zynq-fpga.bin"
IF !OS.FILE("&bitfile")&&OS.FILE("&bitfile.gz")
	UNZIP "&bitfile.gz" "&bitfile"
DO "~~/demo/arm/hardware/zynq-7000/scripts/zynq_bitstream" "&bitfile" 0x00100000

PRINT "initializing the target - Postconfig"
DO "~~/demo/arm/hardware/zynq-7000/scripts/trace/ps7_init.cmm" "&ppd/ps7_init.tcl" "POST"

IF Analyzer()
(
  Trace.METHOD Analyzer
  ; ETM SETUP
  ETM.PortSize 16			; Set the trace port width to 16
  ETM.PortMode Wrapped
  ETM.ON				; Turn ETM on

  Analyzer.AutoFocus		; Set threshold and sampling points automatically
)

; load code
Data.LOAD.Elf "~~~~/sieve_ram_arm_v7.elf"
Register.Set PC _start /CORE 1.

; run to main
Go main
WAIT !STATE.RUN() 

; open some windows
WinCLEAR
Mode.Hll
WinPOS 0% 0%
List.auto
WinPOS 0% 50% 
Register.view /SpotLight
WinPOS 50% 0% 
Trace.List

ENDDO
