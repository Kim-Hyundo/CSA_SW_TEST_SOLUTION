; --------------------------------------------------------------------------------
; @Title: Simple demo script for the ZedBoard
; @Description: 
;   Loads the sieve demo into RAM and sets up a demo debug scenario 
;   for SMP debugging.
;   Prerequisites:
;     * Debugger or Combiprobe is connected to 
;       14pin JTAG header using LA-3881 adapter
;     *  MIO[6..2]=0y00000 - JTAG BOOT
;       or
;        MIO[6..2]=0y01100 - SD BOOT and remove the SD-Card
;
; @Keywords: Cortex-A9, Xilinx, Zynq, Zynq7000
; @Author: AME
; @Board: ZedBoard
; @Chip: Zynq-7000
; @Copyright: (C) 1989-2019 Lauterbach GmbH, licensed for use with TRACE32(R) only
; --------------------------------------------------------------------------------
; $Id: zedboard_smp_sieve_demo.cmm 15217 2019-11-04 16:17:15Z bschroefel $

RESet
SYStem.RESet
SYStem.CPU ZYNQ-7000
 
; set DaisyChaining Parameters of the board
; check e.g. SYStem.DETECT.ShowCHAIN
SYStem.CONFIG DAPIRPRE  6.
SYStem.CONFIG DAPIRPOST 0.
SYStem.CONFIG DAPDRPRE  1.
SYStem.CONFIG DAPDRPOST 0.

; trigger a soft-reset using the AHB Bus -> we loose the connection
SYStem.Mode.Prepare
ON ERROR CONTinue
Data.Set EAHB:0xF8000008 %Long 0xDF0D
Data.Set EAHB:0xF8000200 %Long 0x1
WAIT 0.1s
PRINT ""
ON ERROR inherit

SYStem.Mode.Attach

IF STATE.RUN()
  Break
 
; load code
CORE.select 0.
Data.LOAD.Elf ~~~~/sieve_ram_arm_v7.elf
Register.Set PC _start /CORE 1.
Register.Set T 0 /CORE 1.

; run till main
Go main
WAIT !STATE.RUN()

; open some windows
Mode.Hll
WinCLEAR
WinPOS 0% 0% 100% 50%
List.auto
WinPOS 0% 50% 50% 50%
Register /SpotLight
 
ENDDO
 
