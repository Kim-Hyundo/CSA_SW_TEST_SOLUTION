; --------------------------------------------------------------------------------
; @Title: Simple demo script for the ZC706
; @Description: 
;   Loads the sieve demo into RAM and sets up a demo debug scenario 
;   for SMP debugging.
;   Prerequisites:
;     * Debugger or Combiprobe is connected to J64
;     * Set SW4 to 11.
;     * Set SW11
;        MIO[2..6]=0y00000 - JTAG BOOT
;       or
;        MIO[2..6]=0y00110 - SD BOOT and remove the SD-Card
;     * IF a FMC debug card is plugged TDI-TDO must be shorted on the card
; @Keywords: Cortex-A9, Trace, Xilinx, Zynq, Zynq7000
; @Board: ZC706
; @Chip: Zynq-7000
; @Author: KJM
; @Copyright: (C) 1989-2019 Lauterbach GmbH, licensed for use with TRACE32(R) only
; --------------------------------------------------------------------------------
; $Id: zc706_smp_sieve_demo.cmm 15217 2019-11-04 16:17:15Z bschroefel $

LOCAL &ppd
&ppd=OS.PPD()

WinCLEAR
RESet
SYStem.RESet

AREA.CLEAR
WinPOS 0.14286 32.167 80. 25. 0. 0. W002
AREA.view

SYStem.CPU ZYNQ-7000
; set DaisyChaining Parameters of the board
; check e.g. SYStem.DETECT.ShowCHAIN
SYStem.CONFIG DAPIRPRE  6.
SYStem.CONFIG DAPIRPOST 0.
SYStem.CONFIG DAPDRPRE  1.
SYStem.CONFIG DAPDRPOST 0.

; trigger a soft-reset using the AHB Bus -> we loose the connection
SYStem.Mode.Prepare
ON ERROR CONTinue
Data.Set EAHB:0xF8000008 %Long 0xDF0D
Data.Set EAHB:0xF8000200 %Long 0x1
WAIT 0.1s
PRINT ""
ON ERROR inherit

SYStem.Mode.Attach

IF STATE.RUN()
  Break

; load code
Data.LOAD.Elf "~~~~/sieve_ram_arm_v7.elf"
Register.Set PC _start /CORE 1.

; run to main
Go main
WAIT !STATE.RUN() 

; open some windows
WinCLEAR
Mode.Hll
WinPOS 0% 0%
List.auto
WinPOS 0% 50% 
Register.view /SpotLight

ENDDO

