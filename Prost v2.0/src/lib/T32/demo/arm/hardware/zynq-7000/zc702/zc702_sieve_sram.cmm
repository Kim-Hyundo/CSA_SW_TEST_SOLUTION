; --------------------------------------------------------------------------------
; @Title: Simple demo script for ZYNQ-7000 on ZC702 (RAM)
; @Description:
;   Loads the sieve demo application into RAM and sets up a demo debug
;   scenario.
;   Use this script for getting started.
;   Prerequisites:
;    * Connect Debug Cable/Combiprobe to J58
;    * Set SW10 to 0y11
;    * Set SW16
;       MIO[2..6]=0y00000 - JTAG BOOT
;      or
;       MIO[2..6]=0y00110 - SD BOOT and remove the SD-Card
; @Keywords: ARM, Cortex-A9
; @Author: AME
; @Board: ZC702
; @Chip: ZYNQ-7000
; @Copyright: (C) 1989-2019 Lauterbach GmbH, licensed for use with TRACE32(R) only
; --------------------------------------------------------------------------------
; $Id: zc702_sieve_sram.cmm 15217 2019-11-04 16:17:15Z bschroefel $


WinCLEAR

; --------------------------------------------------------------------------------
; initialize and start the debugger
RESet
SYStem.RESet
SYStem.CPU ZYNQ-7000
SYStem.JtagClock CTCK 10MHz
; set DaisyChaining Parameters of the board
; check e.g. SYStem.DETECT.ShowCHAIN
SYStem.CONFIG DAPIRPRE  6.
SYStem.CONFIG DAPIRPOST 0.
SYStem.CONFIG DAPDRPRE  1.
SYStem.CONFIG DAPDRPOST 0.
; Reset line is connected on ZC702 - give BootROM time to execute
SYStem.Option ResBreak OFF
SYStem.Option WaitReset 40.ms
Trace.DISable
CORE.ASSIGN 1.
SYStem.Up

; --------------------------------------------------------------------------------
; load demo program (uses internal RAM only)
Data.LOAD.Elf "~~~~/sieve_ram_arm_v7.elf"

; --------------------------------------------------------------------------------
; start program execution
Go.direct main
WAIT !STATE.RUN()

; --------------------------------------------------------------------------------
; open some windows
WinCLEAR
Mode.Hll
WinPOS 0. 0. 116. 26.
List.auto
WinPOS 120. 0. 100. 8.
Frame.view
WinPOS 120. 14.
Var.Watch
Var.AddWatch %SpotLight ast flags
WinPOS 120. 25.
Register.view /SpotLight
WinPOS 0. 32.
Var.DRAW %DEFault sinewave

ENDDO
