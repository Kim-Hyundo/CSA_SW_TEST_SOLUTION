; --------------------------------------------------------------------------------
; @Title: Simple smp sieve demo script for the ZYBO board
; @Description: 
;   Loads the sieve demo into RAM and sets up a demo debug scenario 
;   for SMP debugging.
;   Prerequisites:
;     * Debugger  is connected to J12
;     * Set JP5 to JTAG
;     * Disable JP6
;        
; @Keywords: Cortex-A9, Xilinx, Zynq, Zynq-7010, smp
; @Board: ZYBO
; @Chip: Zynq-7000
; @Author: MSA
; @Copyright: (C) 1989-2019 Lauterbach GmbH, licensed for use with TRACE32(R) only
; --------------------------------------------------------------------------------
; $Id: zynq-7010_sram_smp_demo.cmm 15223 2019-11-05 16:29:45Z bschroefel $

RESet
SYStem.RESet
SYStem.CPU ZYNQ-7000
SYStem.CONFIG.DAPIRPRE  6
SYStem.CONFIG.DAPDRPRE  1.

TrOnchip.Set DABORT OFF
TrOnchip.Set PABORT OFF

;SYStem.Up command should work since there is no wired Reset line  
SYStem.Mode Attach
IF STATE.RUN()
  Break.direct
  
;load sieve demo
CORE.select 0.
Data.LOAD.Elf ~~~~/sieve_ram_thumb_ii_v7.elf
Register.Set PC _start /CORE 1.
Register.Set T 1 /CORE 1.

Go main
WAIT !STATE.RUN()
  
; open some windows
WinCLEAR
WinPOS 0% 0% 50% 50%
List /CORE 0.
WinPOS 0% 50% 50% 50%
List /CORE 1.
WinPOS 50% 0% 25% 50%
Register /SpotLight /CORE 0.
WinPOS 75% 0% 25% 50%
Register /SpotLight /CORE 1.
WinPOS 50% 50% 50% 50%
Var.DRAW sinewave

ENDDO


