; --------------------------------------------------------------------------------
; @Title: Initialization Script for the PS7 of a Xilinx ZYNQ FPGA.
; @Description: 
;    This script parses an TCL script generated by the Xilinx Toolchain
;    and initializes the MIO, PLL, CLOCK, DDR & PERIPHERALS
;    If TCL script contains "mwr -force" command, you should enable DACR
;    option using command "SYStem.Option DACR ON" BEFORE running this script.
;    Usage:
;     DO ps7_init "<<path_to>/ps7_init.tcl>" ["POST"]
; @Chip: Zynq-7000
; @Board: ZC70* ZedBoard
; @Author: -
; @Copyright: (C) 1989-2019 Lauterbach GmbH, licensed for use with TRACE32(R) only
; --------------------------------------------------------------------------------
; $Id: ps7_init.cmm 15217 2019-11-04 16:17:15Z bschroefel $


;   Changelog:
;     06.11.2017 [Mohamed Samet,    Lauterbach]: Added handling for "mwr -force" command
;     23.08.2013 [Alexander Merkle, Lauterbach]: Added handling for multiple silicon revisions in the same tcl script
;     28.08.2013 [Alexander Merkle, Lauterbach]: Added option "POST" to run post_config of TCL script. Added custom post_config.
;     13.03.2013 [Alexander Merkle, Lauterbach]: Use _3_0 initialization sequence from silicon revision 3 onwards

LOCAL &file_name &arguments
ENTRY &file_name %LINE &arguments
PRINT "ps7_init: &file_name"

; Parameter Parser
LOCAL &param_post
&param_post=(STRing.SCAN(STRing.UPpeR("&arguments"),"POST",0)!=-1)

LOCAL &sil_ver
GOSUB SILICON_VERSION
ENTRY &sil_ver

IF "&sil_ver"!=""
	PRINT "Detected Silicon Version: "+FORMAT.Decimal(1.,&sil_ver)
ELSE
(
	PRINT %ERROR "Unknown Silicon Version!"
	STOP
	ENDDO FALSE()
)

LOCAL &pass 
IF &param_post==FALSE()
(
	GOSUB PS7_INIT &sil_ver
	ENTRY &pass
)
ELSE
(
	GOSUB PS7_POST_CONFIG &sil_ver
	ENTRY &pass
)
ENDDO &pass

; --------------------------------------------------------------------------------
; Init Routines
; --------------------------------------------------------------------------------

PS7_INIT:
	LOCAL &sil_ver &status &pass
	ENTRY &sil_ver 
	&pass=TRUE()
	GOSUB DATA_INIT "mio" &sil_ver
	ENTRY &status
	&pass=(&pass)&&(&status)
	GOSUB DATA_INIT "pll" &sil_ver
	ENTRY &status
	&pass=(&pass)&&(&status)
	GOSUB DATA_INIT "clock" &sil_ver
	ENTRY &status
	&pass=(&pass)&&(&status)
	GOSUB DATA_INIT "ddr" &sil_ver
	ENTRY &status
	&pass=(&pass)&&(&status)
	GOSUB DATA_INIT "peripherals" &sil_ver
	ENTRY &status
	&pass=(&pass)&&(&status)
	
	IF &pass==TRUE()
	(
		PRINT "ps7_init: Initialization succeeded!"
	)
	ELSE
	(
		PRINT %ERROR "ps7_init: Initialization failed!"
	)
	RETURN &pass
	
PS7_POST_CONFIG:
	LOCAL &sil_ver &status &pass
	ENTRY &sil_ver 
	
	GOSUB POST_CONFIG &sil_ver 
	ENTRY &pass
	
	IF &pass==FALSE()
	(
		PRINT "ps7_init: Trying Post-Configuration CUSTOM-Method!!!"
		GOSUB PS7_POST_CONFIG_CUSTOM
		ENTRY &pass
	)
	
	IF &pass==TRUE()
	(
		PRINT "ps7_init: Post-Configuration succeeded!"
	)
	ELSE
	(
		PRINT %ERROR "ps7_init: Post-Configuration failed!"
	)
	RETURN &pass
	
PS7_POST_CONFIG_CUSTOM:
	; EXAMPLE POST INITIALIZATION 
	; ONLY USED IF NOT INCLUDED IN THE TCL SCRIPT
	; RETURN TRUE() if implemented
	; RETURN FALSE() if NOT
	; Example:
	;   UNLOCK SLCR, ENABLE PS->PL and PL->PS Level Shifters
	;   ASSERT RESET PL, DEASSERT RESET PL, LOCK SLCR
	
	GOSUB MASK_WRITE 0xf8000008 0x0000ffff 0x0000df0d
	GOSUB MASK_WRITE 0xf8000900 0x0000000f 0x0000000f
	GOSUB MASK_WRITE 0xf8000240 0xffffffff 0xffffffff
	GOSUB MASK_WRITE 0xf8000240 0xffffffff 0x00000000
	GOSUB MASK_WRITE 0xf8000004 0x0000ffff 0x0000767b
	
	RETURN TRUE()
	
; --------------------------------------------------------------------------------
; Helper Routines
; --------------------------------------------------------------------------------

DATA_INIT:
	LOCAL &function_name &sil_ver &valid &my_line
	ENTRY &function_name &sil_ver
	&valid=FALSE()
	PRINT "&function_name"
	OPEN #1  &file_name /Read
	READ #1 %LINE &myline
	WHILE !FILE.EOF(1)
	(
		IF STRing.SCAN("&myline","proc",0)!=-1
		(
			; check for with/without revision argument; 
			; w/o revision data_X_Y is not present
			; w   revision data_X_Y must match the silicon revision
			IF (STRing.SCAN("&myline","data_",0)==-1)||(STRing.SCAN("&myline","data_"+FORMAT.Decimal(1,&sil_ver)+"_0",0)!=-1)
			(
				&valid=TRUE()
				IF STRing.SCAN("&myline",&function_name,0)!=-1
				(
					PRINT "&myline"
					READ #1 %LINE &myline
					WHILE STRing.SCAN("&myline","}",0)==-1
					(
						PRINT "&myline"
						IF STRing.SCAN("&myline","mask_write",0)!=-1
						(
							&myline=STRing.LoWeR("&myline")
							&index=STRing.SCAN("&myline","0x",0)
							&address=STRing.MID("&myline",&index,10.)
							&index=STRing.SCAN("&myline","0x",&index+2)
							&mask=STRing.MID("&myline",&index,10.)
							&index=STRing.SCAN("&myline","0x",&index+2)
							&value=STRing.MID("&myline",&index,10.)
							GOSUB MASK_WRITE &address &mask &value
						)
						IF STRing.SCAN("&myline","mask_poll",0)!=-1
						(
							&myline=STRing.LoWeR("&myline")
							&index=STRing.SCAN("&myline","0x",0)
							&address=STRing.MID("&myline",&index,10.)
							&index=STRing.SCAN("&myline","0x",&index+2)
							&value=STRing.MID("&myline",&index,10.)
							GOSUB MASK_POLL &address &value
						)
						IF STRing.SCAN("&myline","mwr -force",0)!=-1
						(
							&myline=STRing.LoWeR("&myline")
							&index=STRing.SCAN("&myline","0x",0)
							&address=STRing.MID("&myline",&index,10.)
							&index=STRing.SCAN("&myline","0x",&index+2)
							&value=STRing.MID("&myline",&index,10.)
							Data.Set ZSD:&address %Long &value
							PRINT "&address" 	
							PRINT "&value"
						)
						READ #1 %LINE &myline
					)
				)
			)
		)
		READ #1 %LINE &myline
	)
	CLOSE #1
	RETURN &valid
	
POST_CONFIG:
	LOCAL &sil_ver &valid &myline
	ENTRY &sil_ver
	&valid=FALSE()
	PRINT "&function_name"
	OPEN #1  &file_name /Read
	READ #1 %LINE &myline
	WHILE !FILE.EOF(1)
	(
		IF STRing.SCAN("&myline","proc",0)!=-1
		(
			; check for with/without revision argument; 
			; w/o revision post_config_X_Y is not present
			; w   revision post_config_X_Y must match the silicon revision
			IF (STRing.SCAN("&myline","post_config",0)!=-1)||(STRing.SCAN("&myline","post_config_"+FORMAT.Decimal(1,&sil_ver)+"_0",0)!=-1)
			(
				&valid=TRUE()

				PRINT "&myline"
				READ #1 %LINE &myline
				WHILE STRing.SCAN("&myline","}",0)==-1
				(
					PRINT "&myline"
					IF STRing.SCAN("&myline","mask_write",0)!=-1
					(
						&myline=STRing.LoWeR("&myline")
						&index=STRing.SCAN("&myline","0x",0)
						&address=STRing.MID("&myline",&index,10.)
						&index=STRing.SCAN("&myline","0x",&index+2)
						&mask=STRing.MID("&myline",&index,10.)
						&index=STRing.SCAN("&myline","0x",&index+2)
						&value=STRing.MID("&myline",&index,10.)
						GOSUB MASK_WRITE &address &mask &value
					)
					IF STRing.SCAN("&myline","mask_poll",0)!=-1
					(
						&myline=STRing.LoWeR("&myline")
						&index=STRing.SCAN("&myline","0x",0)
						&address=STRing.MID("&myline",&index,10.)
						&index=STRing.SCAN("&myline","0x",&index+2)
						&value=STRing.MID("&myline",&index,10.)
						GOSUB MASK_POLL &address &value
					)
					IF STRing.SCAN("&myline","mwr -force",0)!=-1
					(
						&myline=STRing.LoWeR("&myline")
						&index=STRing.SCAN("&myline","0x",0)
						&address=STRing.MID("&myline",&index,10.)
						&index=STRing.SCAN("&myline","0x",&index+2)
						&value=STRing.MID("&myline",&index,10.)
						Data.Set ZSD:&address %Long &value
						PRINT "&address" 	
						PRINT "&value"
					)
					READ #1 %LINE &myline
				)
			)
		)
		READ #1 %LINE &myline
	)
	CLOSE #1
	RETURN &valid

MASK_WRITE:
	LOCAL &read &write
	ENTRY &address &mask &value
	&read=Data.Long(ZSD:&address)
	&write=(&read&~&mask)|(&value&&mask)
	Data.Set ZSD:&address %Long &write
	PRINT "&address" 	
	PRINT "&write"
	RETURN

MASK_POLL:
	LOCAL &read &match
	ENTRY &address &value
	&read=Data.Long(ZSD:&address)
	&match=&read&&value
	PRINT "&read"
	PRINT "&value"
	PRINT "&match"
	WHILE &match==0
	(
		&read=Data.Long(ZSD:&address)
		&match=&read&&value
	)
	RETURN

SILICON_VERSION:
	LOCAL &PS_VERSION &sil_ver
	&PS_VERSION=(Data.Long(ZSD:0xf8007080)>>28.)&0xf
	
	IF &PS_VERSION==0.
	(
		&sil_ver=1.
	)
	ELSE IF &PS_VERSION==1.
	(
		&sil_ver=2.
	)
	ELSE IF &PS_VERSION==2.
	(
		&sil_ver=3.
	)
	ELSE
	(
		&sil_ver=3.
	)

	RETURN &sil_ver

