; --------------------------------------------------------------------------------
; @Title: Demo script for RM57L843-ZWT on HERCULES RM57 with Offchip-Trace (RAM)
; @Description:
;   Loads the sieve demo application into RAM and sets up a demo debug
;   scenario.
;   The program flow is traced using the Offchip-Trace. Pinmuxing and Clock
;   setup is handled in the script.
;   Use this script to test the Offchip-Trace.
;   Prerequisites:
;    * Debug Cable is connected to J4
;    * J13 SDRAM_OFF is shorted
;    *   AutoFocus II MIPI60 is connected to J19
;      or
;        AutoFocus II Mictor is connected to J19
;        using LA-3818 converter
; @Keywords: ARM, Cortex-R5, ETM
; @Author: AME
; @Board: HERCULES RM57
; @Chip: RM57L843-ZWT
; @Copyright: (C) 1989-2019 Lauterbach GmbH, licensed for use with TRACE32(R) only
; --------------------------------------------------------------------------------
; $Id: hercules_rm57_sieve_offchip_trace_sram.cmm 15217 2019-11-04 16:17:15Z bschroefel $


WinCLEAR

; --------------------------------------------------------------------------------
; check prerequisites
IF VERSION.BUILD.BASE()<76594.
(
  PRINT %ERROR "Please use more recent Software! Contact support@lauterbach.com."
  ENDDO
)

; --------------------------------------------------------------------------------
; initialize and start the debugger
RESet
SYStem.RESet
SYStem.CPU RM57L843-ZWT
IF VERSION.BUILD()<61236.
(
  SYStem.CONFIG.FUNNEL1.Base DAP:0x8000B000
  SYStem.CONFIG.FUNNEL1.ATBSource ETM 0
  SYStem.CONFIG.TPIU ATBSource FUNNEL1
)
; these settings stop the CPU at the RESET Vector
SYStem.Option EnReset OFF
SYStem.Option ICEPICK SystemReset.ON
SYStem.Option ICEPICK WaitInReset.ON
SYStem.MemAccess DAP
SYStem.JtagClock CTCK 10MHz
SYStem.Up

; --------------------------------------------------------------------------------
; Setup CTI to freeze peripherals while debugging
GOSUB CtiSetup

; --------------------------------------------------------------------------------
; initialize offchip-trace (ETM ON)
IF Analyzer()
(
  ; Enable TPIU, by setting input clock to VCLK
  Data.Set APB:0x80003404 %Long 0x00000001

  TPIU.PortSize 16
  TPIU.PortMode Continuous
  ETM.Trace ON
  ETM.ON
  Trace.METHOD Analyzer
  Trace.AutoFocus
)

; Init ECC - via CPU
Data.Set 0x08000000++0x7ffff %Quad 0x0

; --------------------------------------------------------------------------------
; load demo program (uses internal RAM only)
Data.LOAD.Elf "~~~~/sieve_ram_arm_v7r_le.elf"

; --------------------------------------------------------------------------------
; start program execution
Go.direct main
WAIT !STATE.RUN()

; --------------------------------------------------------------------------------
; open some windows
WinCLEAR
Mode.Hll
WinPOS 0. 0.
List.auto
WinPOS 120. 0. 100. 8.
Frame.view
WinPOS 120. 14.
Var.Watch
Var.AddWatch %SpotLight ast flags
WinPOS 120. 25.
Trace.List
WinPOS 0. 32.
Var.DRAW %DEFault sinewave
ENDDO

; --------------------------------------------------------------------------------

CtiSetup: ;()
(
  &CoreCtiBase=COMPonent.BASE("CTI",0.)
  &CoreCtiBase=CONVert.ADDRESSTODUALPORT(&CoreCtiBase)
  &PeriphCtiBase=EDAP:0x8000a000
  &TPIUCtiBase=EDAP:0x80009000

  ; <do not change>
  ; MAP CR5-"Core-Stopped" (CTITRIGIN7) to CTM Channel 2
  Data.Set &CoreCtiBase+0x3c %Long 0x4
  ; ensure CTM2 is not GATED
  Data.Set &CoreCtiBase+0x40 %Long Data.Long(&CoreCtiBase+0x40)|0x4
  ; enable CR5-CTI
  Data.Set &CoreCtiBase+0x00 %Long 0x1
  ; </do not change>

  ; <user config>
  ; the following Data.Set's connect "Core-Stopped" signal to the
  ; listed peripherals
  ; L2FMC, CCMR5, CRCx, and SYS modules
  Data.Set &PeriphCtiBase+0xa0 %Long 0x4
  ; DMA, RTIx, AWMx, HTUx, SCIx, LINx, I2Cx, EMAC, EQEP, ECAP, DMM and DCCx modules
  Data.Set &PeriphCtiBase+0xa4 %Long 0x4
  ; DCANx
  Data.Set &PeriphCtiBase+0xa8 %Long 0x4
  ; ETPWMx
  Data.Set &PeriphCtiBase+0xac %Long 0x4
  ; </user config>
  ; <do not change>
  ; ensure CTM2 is not GATED
  Data.Set &PeriphCtiBase+0x40 %Long Data.Long(&CoreCtiBase+0x40)|0x4
  ; enable PERIPH-CTI
  Data.Set &PeriphCtiBase+0x00 %Long 0x1
  ; </do not change>
  
  
  ; Enable Trace Triggering via CTI channel 3

  ; Configure ETM trigger to channel 3
  Data.Set &CoreCtiBase       %Long 1
  Data.Set &CoreCtiBase+0x038 %Long Data.Long(&CoreCtiBase+0x038)|0x8
  
  Data.Set &TPIUCtiBase       %Long 1
  Data.Set &TPIUCtiBase+0x0A0 %Long Data.Long(&TPIUCtiBase+0x0A0)|0x8

  RETURN
)