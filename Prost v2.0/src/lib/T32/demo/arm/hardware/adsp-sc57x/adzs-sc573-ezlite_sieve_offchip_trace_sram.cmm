; --------------------------------------------------------------------------------
; @Title: Demo script for ADSP-SC573 on ADZS-SC573-EZLITE with Offchip-Trace (RAM)
; @Description:
;   Loads the sieve demo application into RAM and sets up a demo debug
;   scenario.
;   The program flow is traced using the Offchip-Trace. Pinmuxing and Clock
;   setup is handled in the script.
;   Use this script to test the Offchip-Trace.
;   Prerequisites:
;    * Debug cable is connected to preprocessor LA-7992
;    * AutoFocus Preprocessor LA-7992 is connected using Mictor38 cable
;    * Please short pins 12-14 on Mictor-38 (VREF-DEBUG <-> VREF-TRACE)
;    * Set SW6[1..6]=0y101010, SW7[1..6]=0y101000
;    * Set BOOT_MODE rotary switch SW1 to 0
;
; @Keywords: ARM, Cortex-A5, ETM
; @Author: AME
; @Board: ADZS-SC573-EZLITE
; @Chip: ADSP-SC57*
; @Copyright: (C) 1989-2019 Lauterbach GmbH, licensed for use with TRACE32(R) only
; --------------------------------------------------------------------------------
; $Id: adzs-sc573-ezlite_sieve_offchip_trace_sram.cmm 15217 2019-11-04 16:17:15Z bschroefel $


WinCLEAR

; --------------------------------------------------------------------------------
; initialize and start the debugger
RESet
SYStem.RESet
SYStem.CPU ADSP-SC573
; first connection attempt 16ms after de-asserting nRESET
; adapt this time if necessary
SYStem.Option ResBreak OFF
SYStem.Option WaitReset 16ms
SYStem.JtagClock CTCK 10MHz
SYStem.Up

; --------------------------------------------------------------------------------
; device initialization
;  disable watchdog
Data.Set AD:0x31008000 %LE %Long 0xAD0
;  ensure MMU is disabled
Data.Set C15:0x1 %Long Data.Long(C15:0x1)&~0x1

; --------------------------------------------------------------------------------
; load demo program (uses internal RAM only)
Data.LOAD.Elf "~~~~/sieve_ram_arm_v7.elf"

; --------------------------------------------------------------------------------
; start program execution
Go.direct main
WAIT !STATE.RUN()

; --------------------------------------------------------------------------------
; initialize OFFCHIP trace if Analyzer is plugged (ETM)
IF Analyzer()
(
  ; set PinMux and enable Clocks
  Data.Set AD:0x31004184 %Long 0x00003C00
  Data.Set AD:0x310041B0 %Long 0yxxxx10101010xxxxxxxxxxxxxxxxxxxx    ; PD04-PD07
  Data.Set AD:0x31004284 %Long 0x0000004F
  Data.Set AD:0x310042B0 %Long 0yxxxxxxxxxxxxxxxxxx01xxxx01010101    ; PF00-PD03, PF06
  
  Trace.Method Analyzer
  TPIU.PortSize 8
  TPIU.PortMode Continuous
  ETM.Trace ON
  ETM.ON
  ; use Autofocus based calibration
  Analyzer.AutoFocus
)

; --------------------------------------------------------------------------------
; open some windows
WinCLEAR
Mode.Hll
WinPOS 0. 0.
List.auto
WinPOS 120. 0. 100. 8.
Frame.view
WinPOS 120. 14.
Var.Watch
Var.AddWatch %SpotLight ast flags
WinPOS 120. 25.
Trace.List
WinPOS 0. 32.
Var.DRAW %DEFault sinewave

ENDDO
