; --------------------------------------------------------------------------------
; @Props: NoMetaTags
; @Copyright: (C) 1989-2019 Lauterbach GmbH, licensed for use with TRACE32(R) only
; --------------------------------------------------------------------------------
; $Id: calculateresponse.cmm 15217 2019-11-04 16:17:15Z bschroefel $


ENTRY &challenge
&response=0x0
ENDDO &response
