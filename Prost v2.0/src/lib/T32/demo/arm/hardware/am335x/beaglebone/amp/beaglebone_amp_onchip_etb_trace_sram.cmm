; --------------------------------------------------------------------------------
; @Title: AMP-Demo script for AM3359 with Onchip-Trace (AMP, RAM, ETB)
; @Description:
;   Setup a AMP debug session using a single script approach.
;   Loads the sieve demo application into RAM and sets up a demo debug
;   scenario.
;   As not all cores are accessible after Reset (SYStem.Up) we handle the start
;   of the secondary CortexM3 core in the script.
;   The program flow is traced using the Onchip-Trace (ETB).
;   Prerequisites Beaglebone:
;    * Connect Debug Cable/Combiprobe to P7 using Adapter LA-3780
;    * TRACE32 is started using the .bat/.sh file in this directory
;   Prerequisites Beaglebone Black:
;    * Connect Debug Cable/Combiprobe to P2 using Adapter LA-3780
;    * TRACE32 is started using the .bat/.sh file in this directory
; @Keywords: ARM, ETB, ETM
; @Author: AME
; @Board: Beaglebone, Beaglebone Black
; @Chip: AM3359
; @Copyright: (C) 1989-2019 Lauterbach GmbH, licensed for use with TRACE32(R) only
; --------------------------------------------------------------------------------
; $Id: beaglebone_amp_onchip_etb_trace_sram.cmm 15362 2019-12-03 14:50:48Z mschleinkofer $

PRIVATE &currPath &rclPort &remoteCmd
&currPath=OS.PPD()
&rclPort=FORMAT.DecimalU(1.,RCL.PORT(0))+"."

WinCLEAR

; --------------------------------------------------------------------------------
; check prerequisites
IF SYStem.INSTANCE()<1.
(
  PRINT %ERROR "TRACE32 is not running in AMP mode! Use .bat/.sh file in this directory."
  ENDDO
)

; --------------------------------------------------------------------------------
; enable INTERCOM if not already specified and prepare related variables
IF (INTERCOM.PORT()==0)
(
  InterCom.ENable CORE0
)
&remoteCmd="InterCom.execute CM3"

; --------------------------------------------------------------------------------
; close any existing REMOTE GUI
INTERCOM.execute OTHERS QUIT

; --------------------------------------------------------------------------------
; open SLAVE GUI with or without enabled remote API
IF (RCL.PORT(0)!=0)
(
  TargetSystem.NewInstance CM3 /ARCHitecture ARM /ChipIndex 2. /APIPORT &rclPort+1. /ONCE
)
ELSE
(
  TargetSystem.NewInstance CM3 /ARCHitecture ARM /ChipIndex 2. /ONCE
)

TITLE "TRACE32 for ARM - AM3359 - MASTER"
&remoteCmd TITLE "TRACE32 for ARM - AM3359-CM3 - SLAVE1"

; --------------------------------------------------------------------------------
; common SYStem settings
RESet
&remoteCmd RESet
SYStem.RESet
&remoteCmd SYStem.RESet
SYStem.CPU AM3359
SYStem.CONFIG CORE 1. 1.
SYStem.CONFIG SLAVE OFF
&remoteCmd SYStem.CPU AM3359-CM3
&remoteCmd SYStem.CONFIG CORE 2. 1.
&remoteCmd SYStem.CONFIG SLAVE ON
SYStem.Up

GOSUB DisableWatchdog
; enable SRAM - CM_PER_OCMRAM
Data.Set AD:0x44E0002C %Long 0x2
; --------------------------------------------------------------------------------
; kick secondary cores
GOSUB EnableM3

; --------------------------------------------------------------------------------
; attach to all cores on all sessions
&remoteCmd SYStem.Mode.Up

; --------------------------------------------------------------------------------
; load demo program on all sessions (use internal RAM only)
Data.LOAD.Elf ~~~~/master/sieve_ram_arm_v7.elf
&remoteCmd ChDir &currPath
&remoteCmd Data.LOAD.Elf ./slave1/sieve_ram_thumb_ii_v7m.elf

; --------------------------------------------------------------------------------
; initialize ONCHIP trace (ETB)
Trace.METHOD ONCHIP
Trace.TraceCONNECT ETB
&remoteCmd Trace.DISable

ETM.Trace ON
ETM.ON

; --------------------------------------------------------------------------------
; start program execution
Go.direct main\1
WAIT !STATE.RUN()
&remoteCmd Go.direct main\1
&remoteCmd WAIT !STATE.RUN()

; --------------------------------------------------------------------------------
; open some windows
WinCLEAR
Mode.Hll
WinPOS 0. 0.
List.auto
WinPOS 0. 32.
Trace.List
&remoteCmd WinCLEAR
&remoteCmd Mode.Hll
&remoteCmd WinPOS 0. 0.
&remoteCmd List.auto

ENDDO

DisableWatchdog:
(
  ; disable the Watchdog
  Data.Set AD:0x44E35048 %LE %Long 0x0000AAAA   ;write magic1 to WDT_WSPR
  Data.Set AD:0x44E35048 %LE %Long 0x00005555   ;write magic2 to WDT_WSPR
  RETURN
)

EnableM3:
(
  ; set initial stack, pc, waiting loop
  Data.Set AD:0x44d00000 %L 0x20004000 0x9 0xe7fee7fe

  ; kick CM3
  Data.Set AD:0x44E00D00 %Long 0x0
  RETURN
)