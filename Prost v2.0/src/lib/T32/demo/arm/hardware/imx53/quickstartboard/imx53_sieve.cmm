; --------------------------------------------------------------------------------
; @Title: Startup script for Freescale i.MX535 Quick Start Board
; @Description:
;   This demo demonstrates the debugging of the Freescale i.MX535
;   by loading a simple sieve demo into the SRAM.
;   (JTAG-MOD signal needs to be low to select the JTAG chain configuration
;    the debugger expects.
;    This is done by not populating R38 which is default on this board.)
;   (There is no chance to connect an off-chip trace probe to this board.)
;   Connect the Debug Cable to J15.
;   Provide 5V power at J1 and push power switch SW2.
; @Keywords: Cortex-A8, Freescale, sieve
; @Author: PEG
; @Board: QuickStart
; @Chip: IMX53?
; @Copyright: (C) 1989-2019 Lauterbach GmbH, licensed for use with TRACE32(R) only
; --------------------------------------------------------------------------------
; $Id: imx53_sieve.cmm 15217 2019-11-04 16:17:15Z bschroefel $


  WinCLEAR

  SYStem.RESet
  SYStem.CPU IMX535
  SYStem.Option ResBreak OFF
  SYStem.Option WaitReset 100ms
  SYStem.Up

  Data.LOAD.ELF ~~~~/demo.axf
  Register.Set PC main
  Register.Set CPSR 0x1d3
  Register.Set R13 0xF801FF54

  ; open some windows
  WinCLEAR
  WinPOS 0% 0% 100% 50%
  List.auto
  WinPOS 0% 50% 50% 50%
  Register /SpotLight

  ENDDO
