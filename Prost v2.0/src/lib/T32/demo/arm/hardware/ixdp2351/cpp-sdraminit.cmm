; --------------------------------------------------------------------------------
; @Title: Example CPP SDRAM initialization for IXP2350
; @Description: 
;   This script initializes the CPP SDRAM for the IXP2350 using
;   Data.Set commands.
;   It assumes that the connection to the target is already
;   established (SYStem.Up)
; @Keywords: XSCALE
; @Author: WRD
; @Board: IXDP2351
; @Chip: IXP2350
; @Copyright: (C) 1989-2019 Lauterbach GmbH, licensed for use with TRACE32(R) only
; --------------------------------------------------------------------------------
; $Id: cpp-sdraminit.cmm 15217 2019-11-04 16:17:15Z bschroefel $


; 

Data.Set ASD:1:0xD0000200 %Long 0x000000C0
Data.Set ASD:1:0xD0000230 %Long 0x339CE739
Data.Set ASD:1:0xD0000238 %Long 0x00000001
Data.Set ASD:1:0xD0000240 %Long 0x00000001
Data.Set ASD:1:0xD0000248 %Long 0x00000001
Data.Set ASD:1:0xD0000250 %Long 0x00000001
Data.Set ASD:1:0xD0000258 %Long 0x00000001
Data.Set ASD:1:0xD0000260 %Long 0x00000001
Data.Set ASD:1:0xD0000268 %Long 0x00000001
Data.Set ASD:1:0xD0000270 %Long 0x00000001
Data.Set ASD:1:0xD0000280 %Long 0x00000001
Data.Set ASD:1:0xD0000288 %Long 0x00007643
Data.Set ASD:1:0xD0000290 %Long 0x0000AA97
Data.Set ASD:1:0xD0000298 %Long 0x0000AAAA
Data.Set ASD:1:0xD00002A0 %Long 0x00004444
Data.Set ASD:1:0xD00002A8 %Long 0x00007444
Data.Set ASD:1:0xD00002B0 %Long 0x0000EEB8
Data.Set ASD:1:0xD00002B8 %Long 0x0000EEEE
Data.Set ASD:1:0xD00002C0 %Long 0x00003333
Data.Set ASD:1:0xD00002C8 %Long 0x00007643
Data.Set ASD:1:0xD00002D0 %Long 0x0000AA97
Data.Set ASD:1:0xD00002D8 %Long 0x0000AAAA
Data.Set ASD:1:0xD00002E0 %Long 0x00004444
Data.Set ASD:1:0xD00002E8 %Long 0x00007444
Data.Set ASD:1:0xD00002F0 %Long 0x0000EEB8
Data.Set ASD:1:0xD00002F8 %Long 0x0000EEEE
Data.Set ASD:1:0xD0000300 %Long 0x00003333
Data.Set ASD:1:0xD0000308 %Long 0x00007643
Data.Set ASD:1:0xD0000310 %Long 0x0000AA97
Data.Set ASD:1:0xD0000318 %Long 0x0000AAAA
Data.Set ASD:1:0xD0000320 %Long 0x00004444
Data.Set ASD:1:0xD0000328 %Long 0x00007444
Data.Set ASD:1:0xD0000330 %Long 0x0000EEB8
Data.Set ASD:1:0xD0000338 %Long 0x0000EEEE
Data.Set ASD:1:0xD0000340 %Long 0x00003333
Data.Set ASD:1:0xD0000348 %Long 0x00007643
Data.Set ASD:1:0xD0000350 %Long 0x0000AA97
Data.Set ASD:1:0xD0000358 %Long 0x0000AAAA
Data.Set ASD:1:0xD0000360 %Long 0x00004444
Data.Set ASD:1:0xD0000368 %Long 0x00007444
Data.Set ASD:1:0xD0000370 %Long 0x0000EEB8
Data.Set ASD:1:0xD0000378 %Long 0x0000EEEE
Data.Set ASD:1:0xD0000380 %Long 0x00003333
Data.Set ASD:1:0xD0000388 %Long 0x00007643
Data.Set ASD:1:0xD0000390 %Long 0x0000AA97
Data.Set ASD:1:0xD0000398 %Long 0x0000AAAA
Data.Set ASD:1:0xD00003A0 %Long 0x00004444
Data.Set ASD:1:0xD00003A8 %Long 0x00007444
Data.Set ASD:1:0xD00003B0 %Long 0x0000EEB8
Data.Set ASD:1:0xD00003B8 %Long 0x0000EEEE
Data.Set ASD:1:0xD00003C0 %Long 0x00003333
Data.Set ASD:1:0xD00003C8 %Long 0x00007643
Data.Set ASD:1:0xD00003D0 %Long 0x0000AA97
Data.Set ASD:1:0xD00003D8 %Long 0x0000AAAA
Data.Set ASD:1:0xD00003E0 %Long 0x00004444
Data.Set ASD:1:0xD00003E8 %Long 0x00007444
Data.Set ASD:1:0xD00003F0 %Long 0x0000EEB8
Data.Set ASD:1:0xD00003F8 %Long 0x0000EEEE
Data.Set ASD:1:0xD0000478 %Long 0x00000001
Data.Set ASD:1:0xD0000480 %Long 0x00000001
Data.Set ASD:1:0xD0000488 %Long 0x00000001
Data.Set ASD:1:0xD0000490 %Long 0x00000001
Data.Set ASD:1:0xD00004A8 %Long 0x00000006
Data.Set ASD:1:0xD0000650 %Long 0x00000000
Data.Set ASD:1:0xD0000688 %Long 0x0000000F
Data.Set ASD:1:0xD0000690 %Long 0x00000005
Data.Set ASD:1:0xD0000000 %Long 0x05814004
Data.Set ASD:1:0xD0000018 %Long 0x00000100
Data.Set ASD:1:0xD0000020 %Long 0x00010000
Data.Set ASD:1:0xD0000020 %Long 0x2000C400
Data.Set ASD:1:0xD0000020 %Long 0x8000D000
Data.Set ASD:1:0xD0000020 %Long 0x8000C062
Data.Set ASD:1:0xD0000020 %Long 0x2000C400
Data.Set ASD:1:0xD0000020 %Long 0x4000C000
Data.Set ASD:1:0xD0000020 %Long 0x4000C000
Data.Set ASD:1:0xD0000020 %Long 0x8000C162

ENDDO
