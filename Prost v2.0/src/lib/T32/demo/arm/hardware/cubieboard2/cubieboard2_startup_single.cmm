; --------------------------------------------------------------------------------
; @Title: Startup first core for Allwinner A20 on Cubieboard2
; @Description:
;   The script shows how to setup a debug session on first core of
;   Allwinner A20 Cubieboard2.
; @Keywords: CortexA7MPCore, debug
; @Author: HDA
; @Board: Cubieboard2
; @Chip: A20
; @Copyright: (C) 1989-2019 Lauterbach GmbH, licensed for use with TRACE32(R) only
; --------------------------------------------------------------------------------
; $Id: cubieboard2_startup_single.cmm 15217 2019-11-04 16:17:15Z bschroefel $

  SYStem.CPU A20
  CORE.ASSIGN 1
  SYStem.Mode Attach
  Break.direct

  ; open some windows
  WinCLEAR

  WinPOS 0% 0% 50% 50%
  List.auto

  WinPOS 0% 50% 50% 50%
  Register.view

