; --------------------------------------------------------------------------------
; @Title: Startup SMP debug session for Allwinner A20 on Cubieboard2
; @Description:
;   The script shows how to setup an smp debug session on dual core 
;   Allwinner A20 Cubieboard2.
;   The script suppose that the second core of the A20 is activated by the user
;   application (i.e bootloader)
; @Keywords: CortexA7MPCore, debug, SMP
; @Author: HDA
; @Board: Cubieboard2
; @Chip: A20
; @Copyright: (C) 1989-2019 Lauterbach GmbH, licensed for use with TRACE32(R) only
; --------------------------------------------------------------------------------
; $Id: cubieboard2_startup_dual.cmm 15217 2019-11-04 16:17:15Z bschroefel $

  SYStem.CPU A20
  CORE.ASSIGN 1 2
  SYStem.Mode Attach
  Break.direct

  ; open some windows
  WinCLEAR

  WinPOS 0% 0% 50% 50%
  List.auto /CORE 0.

  WinPOS 0% 50% 50% 50%
  Register.view /CORE 0.
  
  WinPOS 50% 0% 50% 50%
  List.auto /CORE 1.

  WinPOS 50% 50% 50% 50%
  Register.view /CORE 1.