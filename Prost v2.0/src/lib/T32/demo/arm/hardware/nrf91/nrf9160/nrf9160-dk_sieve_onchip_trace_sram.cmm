; --------------------------------------------------------------------------------
; @Title: Demo script for NRF9160SICA on NRF9160-DK with On-chip-Trace (RAM)
; @Description:
;   Loads the sieve demo application into RAM and sets up a demo debug
;   scenario. The On-chip-Program-Trace is set up.
;   Use this script for testing the On-chip-Trace.
;   Prerequisites:
;    * Connect Debug Cable to P1 using Adapter LA-3770
;      or
;      Connect Combiprobe/uTrace to P4
; @Keywords: ARM, Cortex-M33, ETM, ITM
; @Author: CMO
; @Board: NRF9160-DK
; @Chip: NRF9160SI*
; @Copyright: (C) 1989-2020 Lauterbach GmbH, licensed for use with TRACE32(R) only
; --------------------------------------------------------------------------------
; $Id: nrf9160-dk_sieve_onchip_trace_sram.cmm 16491 2020-09-02 08:30:52Z cmorgenstern $


WinCLEAR

; --------------------------------------------------------------------------------
; initialize and start the debugger
RESet
SYStem.RESet
SYStem.CPU NRF9160SICA
SYStem.CONFIG.DEBUGPORTTYPE SWD
IF COMBIPROBE()||UTRACE()
(
	SYStem.CONFIG.CONNECTOR MIPI20T
)
SYStem.Option DUALPORT ON
SYStem.MemAccess DAP
SYStem.JtagClock 10MHz
Trace.DISable
SYStem.Up

; --------------------------------------------------------------------------------
; set core into secure mode and disable MPU
Register.Set NS 0
Data.Set ZSD:0xE000ED94 %Long (Data.Long(ZSD:0xE000ED94)&(~0x1)) ; disable MPU

; --------------------------------------------------------------------------------
; load demo program (uses internal RAM only)
Data.LOAD.Elf "~~~~/sieve_ram_thumb_ii_v8m_base.elf"

; --------------------------------------------------------------------------------
; initialize ONCHIP trace (ETM, ITM)

GOSUB CONFIGURE_ONCHIPTRACE

Trace.METHOD Onchip
ITM.OFF    ; trace buffer is to small for meaningful data trace
ETM.Trace ON
ETM.ON

; --------------------------------------------------------------------------------
; start program execution
Go.direct main
WAIT !STATE.RUN()


; --------------------------------------------------------------------------------
; open some windows
WinCLEAR
Mode.Hll
WinPOS 0. 0. 116. 51.
List.auto
WinPOS 120. 0. 100. 8.
Frame.view
WinPOS 120. 14.
Var.Watch
Var.AddWatch %SpotLight ast flags
WinPOS 120. 25.
Trace.List


ENDDO


CONFIGURE_ONCHIPTRACE:
(
	PRIVATE &reg

	; Timestamp Generator
	Data.Set EAHB:0xE0053000 %LE %Long 0x00000001

	; GPR Settings (Mandatory to get trace output)
	Data.Set EAHB:0xE005AFB0 %LE %Long 0xC5ACCE55
	Data.Set EAHB:0xE005A000 %LE %Long 0xFFFFFF00
	Data.Set EAHB:0xE005A004 %LE %Long 0x00000009
	Data.Set EAHB:0xE005A000 %LE %Long 0x00000303
	Data.Set EAHB:0xE005AFB0 %LE %Long 0x00000000

	Data.Set EAHB:0xE005BFB0 %LE %Long 0xC5ACCE55
	Data.Set EAHB:0xE005B000 %LE %Long 0xFFFFFF00
	Data.Set EAHB:0xE005B004 %LE %Long 0x00003000
	Data.Set EAHB:0xE005B000 %LE %Long 0x00000308
	Data.Set EAHB:0xE005BFB0 %LE %Long 0x00000000

	Data.Set EAHB:0xE0058FB0 %LE %Long 0xC5ACCE55
	Data.Set EAHB:0xE0058000 %LE %Long 0x00000000
	Data.Set EAHB:0xE0058004 %LE %Long 0x00000000
	Data.Set EAHB:0xE0058FB0 %LE %Long 0x00000000

	RETURN
)

