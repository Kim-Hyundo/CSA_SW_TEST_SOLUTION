; --------------------------------------------------------------------------------
; @Title: Demo script for STM32H755ZI-CM7 on NUCLEO-H755ZI (FLASH)
; @Description:
;   Programs the sieve demo application into the processor internal flash and
;   sets up a demo debug scenario.
;   This script can be used as a template for flashing an application.
;   Prerequisites:
;    * Use this script, if only M7 core is booting (BCM4 = 0)
;    * Connect Debug Cable to CN5 using Adapter LA-3770
;      or
;      Connect Combiprobe/uTrace to CN5
; @Keywords: ARM, Cortex-M7, Flash
; @Author: STK
; @Board: NUCLEO-H755ZI
; @Chip: STM32H755ZI-CM7
; @Copyright: (C) 1989-2020 Lauterbach GmbH, licensed for use with TRACE32(R) only
; --------------------------------------------------------------------------------
; $Id: nucleo-h755zi_sieve_flash.cmm 16602 2020-10-02 08:02:51Z skrausse $


WinCLEAR

; --------------------------------------------------------------------------------
; initialize and start the debugger
RESet
SYStem.CPU STM32H755ZI-CM7
SYStem.CONFIG.DEBUGPORTTYPE SWD
IF COMBIPROBE()||UTRACE()
(
  SYStem.CONFIG.CONNECTOR MIPI20T
)
; Avoid trying to set software breakpoints in the flash area,
; because it generates an error in the flash controller
MAP.BO 0x08000000--0x08FFFFFF
SYStem.Option DUALPORT ON
SYStem.Up

; --------------------------------------------------------------------------------
; Flash programming

; prepare flash programming (declarations)
DO ~~/demo/arm/flash/stm32h7.cmm PREPAREONLY

; ReProgram Flash
FLASH.ReProgram ALL
Data.LOAD.Elf "~~~~/sieve_flash_thumb_ii_v7m.elf"
FLASH.ReProgram OFF

; --------------------------------------------------------------------------------
; Reset the target again
SYStem.Up

; --------------------------------------------------------------------------------
; start program execution
Go.direct main
WAIT !STATE.RUN()

; --------------------------------------------------------------------------------
; open some windows
WinCLEAR
Mode.Hll
WinPOS 0. 0. 116. 26.
List.auto
WinPOS 120. 0. 100. 8.
Frame.view
WinPOS 120. 14.
Var.Watch
Var.AddWatch %SpotLight ast flags
WinPOS 120. 25.
Register.view /SpotLight
WinPOS 0. 32.
Var.DRAW %DEFault sinewave

ENDDO
