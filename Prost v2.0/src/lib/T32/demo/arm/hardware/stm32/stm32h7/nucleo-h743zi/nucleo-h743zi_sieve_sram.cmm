; --------------------------------------------------------------------------------
; @Title: Simple demo script for STM32H743ZI on Nucleo-H743ZI (RAM)
; @Description:
;   Loads the sieve demo application into RAM and sets up a demo debug
;   scenario.
;   Use this script for getting started.
;   The board does not have a standard debug or trace header!
;   Prerequisites:
;    * Connect signals of the Debug Cable/CombiProbe/µTrace as followed:
;         VREF     : CN8 pin 7 (3.3V)
;         GND      : CN6 pin 3
;         TMS/SWDIO: CN4 pin 4
;         TCK/SWCLK: CN4 pin 2
;         TDO/SWO  : CN6 pin 6
;         NSRST    : CN6 pin 5
;    * Disable the STLink on the board by a solder bridge on SB107
;    * If power should be supplied by the STLink USB header, set a
;      solder brigde on SB1. Please take care, that the board
;      does not exceed maximum power supply capabilities of the
;      USB port!
; @Keywords: ARM, Cortex-M7
; @Author: STK
; @Board: Nucleo-H743ZI
; @Chip: STM32H743ZI
; @Copyright: (C) 1989-2019 Lauterbach GmbH, licensed for use with TRACE32(R) only
; --------------------------------------------------------------------------------
; $Id: nucleo-h743zi_sieve_sram.cmm 15217 2019-11-04 16:17:15Z bschroefel $


WinCLEAR

; --------------------------------------------------------------------------------
; check Prerequisites
IF VERSION.BUILD()<95056.
(
  PRINT %ERROR "Please use more recent Software! Contact support@lauterbach.com."
  ENDDO
)

; --------------------------------------------------------------------------------
; initialize and start the debugger
RESet
SYStem.RESet
SYStem.CPU STM32H743ZI
SYStem.CONFIG.DEBUGPORTTYPE SWD
IF COMBIPROBE()||UTRACE()
(
  SYStem.CONFIG.CONNECTOR MIPI20T
)
SYStem.Option DUALPORT ON
SYStem.MemAccess DAP
SYStem.JtagClock CTCK 10MHz
Trace.DISable
SYStem.Up

; --------------------------------------------------------------------------------
; load demo program (uses internal RAM only)
Data.LOAD.Elf "~~~~/sieve_ram_thumb_ii_v7m.elf"

; --------------------------------------------------------------------------------
; start program execution
Go.direct main
WAIT !STATE.RUN()

; --------------------------------------------------------------------------------
; open some windows
WinCLEAR
Mode.Hll
WinPOS 0. 0. 116. 26.
List.auto
WinPOS 120. 0. 100. 8.
Frame.view
WinPOS 120. 14.
Var.Watch
Var.AddWatch %SpotLight ast flags
WinPOS 120. 25.
Register.view /SpotLight
WinPOS 0. 32.
Var.DRAW %DEFault sinewave

ENDDO
