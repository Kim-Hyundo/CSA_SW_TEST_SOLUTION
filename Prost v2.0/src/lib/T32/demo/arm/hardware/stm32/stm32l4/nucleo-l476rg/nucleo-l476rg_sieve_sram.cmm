; --------------------------------------------------------------------------------
; @Title: Simple demo script for STM32L476RG on NUCLEO-L476RG (RAM)
; @Description:
;   Loads the sieve demo application into RAM and sets up a demo debug
;   scenario.
;   Use this script for getting started.
;   Prerequisites:
;    * Connect signals of the Debug Cable/CombiProbe/µTrace as follows:
;         VREF     : CN7 pin 16 (3.3V)
;         GND      : GND
;         TMS/SWDIO: CN2 pin 4
;         TCK/SWDCK: CN2 pin 2
;         TDO/SWO  : CN10 pin 31
;         NSRST    : CN7 pin 14
;    * remove Solder bridge SB15
;    * ensure CN2 jumpers are OPEN
;    * keep trace length as short as possible
;    * ensure proper GND connection
; @Keywords: ARM, Cortex-M4
; @Author: AME
; @Board: NUCLEO-L476RG
; @Chip: STM32L4*
; @Copyright: (C) 1989-2019 Lauterbach GmbH, licensed for use with TRACE32(R) only
; --------------------------------------------------------------------------------
; $Id: nucleo-l476rg_sieve_sram.cmm 15217 2019-11-04 16:17:15Z bschroefel $


WinCLEAR

; --------------------------------------------------------------------------------
; initialize and start the debugger
RESet
SYStem.RESet
SYStem.CPU STM32L476RG
SYStem.CONFIG.DEBUGPORTTYPE SWD
IF COMBIPROBE()||UTRACE()
(
  SYStem.CONFIG.CONNECTOR MIPI20T
)
SYStem.Option DUALPORT ON
SYStem.MemAccess DAP
SYStem.JtagClock CTCK 5MHz
Trace.DISable
SYStem.Up

; --------------------------------------------------------------------------------
; load demo program (uses internal RAM only)
Data.LOAD.Elf "~~~~/sieve_ram_thumb_ii_v7m.elf"

; --------------------------------------------------------------------------------
; start program execution
Go.direct main
WAIT !STATE.RUN()

; --------------------------------------------------------------------------------
; open some windows
WinCLEAR
Mode.Hll
WinPOS 0. 0. 116. 26.
List.auto
WinPOS 120. 0. 100. 8.
Frame.view
WinPOS 120. 14.
Var.Watch
Var.AddWatch %SpotLight ast flags
WinPOS 120. 25.
Register.view /SpotLight
WinPOS 0. 32.
Var.DRAW %DEFault sinewave

ENDDO
