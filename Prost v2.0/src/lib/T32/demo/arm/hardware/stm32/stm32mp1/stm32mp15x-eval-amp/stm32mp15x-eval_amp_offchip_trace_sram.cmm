; --------------------------------------------------------------------------------
; @Title: AMP-Demo script for STM32MP157A with Offchip-Trace (AMP, RAM)
; @Description:
;   Setup a AMP debug session using a single script approach.
;   Loads the sieve demo application into RAM and sets up a demo debug
;   scenario.
;   The program flow is traced using the Offchip-Trace. Pinmuxing and Clock
;   setup is handled in the script.
;   Use this script to test the Offchip-Trace.
;   Prerequisites:
;    * Connect AutoFocus Preprocessor to U10 using Mictor38 cable
;    * Connect Debug Cable/Combiprobe to AutoFocus Preprocessor
;    * The demos are tested in Engineering boot mode:
;      SW1[0..2]=ON,OFF,OFF
; @Keywords: ARM, ETM
; @Author: STK
; @Board: STM32MP15C-EVAL
; @Chip: STM32MP157A
; @Copyright: (C) 1989-2019 Lauterbach GmbH, licensed for use with TRACE32(R) only
; --------------------------------------------------------------------------------
; $Id: stm32mp15x-eval_amp_offchip_trace_sram.cmm 14337 2019-04-26 15:41:57Z skrausse $


WinCLEAR

; --------------------------------------------------------------------------------
; check prerequisites
; IF VERSION.BUILD()<xxxx.
; (
;   PRINT %ERROR "Please use more recent software. Contact support@lauterbach.com."
;   ENDDO
; )
IF SYStem.INSTANCE()!=1.
(
  PRINT %ERROR "This script must be called from MASTER GUI!"
  ENDDO
)

; store current script path in &ppd
PRIVATE &ppd
&ppd=OS.PPD()

; --------------------------------------------------------------------------------
; [optional] close any existing REMOTE GUIs
; IC OTHERS QUIT

; --------------------------------------------------------------------------------
; open all SLAVE GUIs
IF !INTERCOM.PING(CM4)
  TargetSystem.NewInstance CM4 /ARCHitecture ARM

; --------------------------------------------------------------------------------
; set titles for SLAVE GUIs
TITLE "TRACE32 for ARM - STM32MP157A-CA7 - MASTER"
InterCom CM4 TITLE "TRACE32 for ARM - STM32MP157A-CM4 - SLAVE1"

; --------------------------------------------------------------------------------
; common SYStem settings
InterCom ALL RESet
InterCom ALL SYStem.RESet

SYStem.CPU STM32MP157A-CA7
SYStem.CONFIG CORE 1. 1.
SYStem.CONFIG SLAVE OFF

InterCom CM4 SYStem.CPU STM32MP157A-CM4
InterCom CM4 SYStem.CONFIG CORE 2. 1.
InterCom CM4 SYStem.CONFIG SLAVE ON

; disable Trace for connection phase
InterCom ALL Trace.DISable

SYStem.Up

; In Engineering boot mode all cores are active immediatelly
InterCom CM4 SYStem.Up

; --------------------------------------------------------------------------------
; load demo program on all sessions (use internal RAM only)
CORE.select 0.
Data.LOAD.Elf &(ppd)/master/sieve_ram_arm_v7.elf
Register.Set T 0 /CORE 0

InterCom CM4 Data.LOAD.Elf &(ppd)/slave1/sieve_ram_thumb_ii_v7m.elf

Register.Set PC _start_secondary /CORE 1.
Register.Set T 0 /CORE 1

; --------------------------------------------------------------------------------
; initialize OFFCHIP trace if Analyzer is plugged (ETM)
IF Analyzer()
(
  ; Enable Clocks
  Data.Set AD:0x5000080C %Long 0yXXXXxxxxXXXXxxxxXXXXxx1xXXXXxxxx ; Enable trace clock
  Data.Set AD:0x50000AA8 %Long 0yXXXXxxxxXXXXxxxxXXXXx111XXXXxxxx ; Enable GPIO I/J/K
  
  ; Set PinMux
  Data.Set AD:0x5000A000 %Long 0yXX101010XXXXxxxxXXXXxxxxXXXXxxxx
  Data.Set AD:0x5000A024 %Long 0yXXXX000000000000XXXXxxxxXXXXxxxx

  Data.Set AD:0x5000B000 %Long 0yXXXXxxxxXXXX10101010101010101010
  Data.Set AD:0x5000B020 %Long 0y00000000000000000000000000000000
  Data.Set AD:0x5000B024 %Long 0yXXXXxxxxXXXXxxxxXXXXxxxx00000000

  Data.Set AD:0x5000C000 %Long 0yXXXXxxxxXXXXxxxxXX1010xxXX1010xx
  Data.Set AD:0x5000B020 %Long 0yXXXX00000000xxxxXXXX00000000xxxx

  InterCom ALL Trace.Method Analyzer

  TPIU.PortSize 16
  TPIU.PortMode Continuous
  
  ETM.TraceID 1.
  InterCom CM4 ETM.TraceID 3.
  
  InterCom ALL ETM.Trace ON
  InterCom ALL ETM.ON

  ; use Autofocus based calibration
  Analyzer.AutoFocus
)

; --------------------------------------------------------------------------------
; start program execution
Go.direct main\1
WAIT !STATE.RUN()
InterCom CM4 Go.direct main\1
InterCom CM4 WAIT !STATE.RUN()

; --------------------------------------------------------------------------------
; open some windows
InterCom ALL WinCLEAR
InterCom ALL Mode.Hll
InterCom ALL WinPOS 0. 0. 116. 26.
InterCom ALL List.auto
InterCom ALL WinPOS 0. 32.
InterCom ALL Trace.List

; --------------------------------------------------------------------------------
; sync all instances
InterCom ALL SYnch.ON
InterCom ALL SYnch.Connect ALL
InterCom ALL SYnch.MasterBreak ON
InterCom ALL SYnch.MasterGo    ON
InterCom ALL SYnch.SlaveBreak  ON
InterCom ALL SYnch.SlaveGo     ON

ENDDO
