;-----------------------------------------------------------------------------------
; @Title: Off-chip trace demo for IAR STM32F207ZG board
; @Description:
;   This is a small demo how to setup off chip ETM and ITM trace
;   for STM32F2xx derivatives. The sieve demo is loaded on SRAM.
;
; @Keywords: Cortex-M3, debug, ETM, ITM, STM32, SWD
; @Author: HDA
; @Board: IAR STM32F207ZG
; @Chip: STM32F2*
; @Copyright: (C) 1989-2019 Lauterbach GmbH, licensed for use with TRACE32(R) only
; --------------------------------------------------------------------------------
; $Id: iar_stm32f207zg_offchip_trace.cmm 15217 2019-11-04 16:17:15Z bschroefel $

; memory map
; 0x00000000 1024kB FLASH (aliased from 0x08000000)
; 0x20000000  128kB SRAM

; Basic setup
  RESet
  Break.Reset
  SYStem.RESet
  MAP.DENYACCESS 0x20020000--0x3FFFFFFF
  SYStem.CPU STM32F207ZG
  SYStem.CONFIG DEBUGPORTTYPE SWD
  SYStem.CONFIG CONNECTOR MIPI20T
  SYStem.Up

  Data.LOAD.auto ~~~~/demo_sram.axf
  Register.Set PC main
  Register.Set R13 0x2000C000

; Prevent error during power saving states and stop peripherals in debug mode
  Data.Set E:0xE0042004 %Long 0yXXXXxxxxXXX11111XXXXxxxxXXXXx111  ; DBGMCU_CR
; Setup GPIO clock
  Data.Set E:0x40023830 %Long 0yXXXXxxxxXXXXxxxxXXXXxxxxXXX1xxxx  ; RCC_AHB1ENR
; Setup pin multiplexing for using the 4 bit trace
  Data.Set E:0x40021000 %Long 0yXXXXxxxxXXXXxxxxXX1010101010xxxx  ; GPOIE_PORTMODE
  Data.Set E:0x40021008 %Long 0yXXXXxxxxXXXXxxxxXX1111111111xxxx  ; GPOIE_PORTSPEED
  Data.Set E:0x40021020 %Long 0yXXXX00000000000000000000XXXXxxxx  ; GPIOE_AFRL

  ; Turn on ITM and ETM
  ETM.ON
  ITM.ON

  ETM.PortMode Continuous
  ETM.PortSize 4.

  ; Slect the Analyzer (PowerTrace with Preprocessor)
  IF hardware.COMBIPROBE()||hardware.UTRACE()
  (
    Trace.METHOD CAnalyzer   ; Using CombiProbe
  )
  ELSE IF Analyzer()
  (
    Trace.METHOD Analyzer    ; Using ARM preprocessor
    Analyzer.Init
    Analyzer.AutoFocus
  )
  ITM.PCSampler 1/64
  Trace.OFF              ; Enable the trace and turn it off

  Go.direct
  WAIT 5.s
  Break.direct

  ; open some windows
  WinCLEAR


  WinPOS 0% 0% 50% 50%
  List.auto

  WinPOS 50% 0% 50% 50%
  Trace.List

  WinPOS 0% 50% 50% 50%
  ITMTrace.list

  WinPOS 50% 50% 50% 50%
  Trace.Chart.sYmbol

  ENDDO
