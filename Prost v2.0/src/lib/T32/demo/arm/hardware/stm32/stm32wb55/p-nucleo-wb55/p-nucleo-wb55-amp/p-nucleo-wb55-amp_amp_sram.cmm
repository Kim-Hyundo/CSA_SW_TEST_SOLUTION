; --------------------------------------------------------------------------------
; @Title: AMP-Demo script for STM32WB55RG on P-Nucleo-WB55 (AMP, RAM)
; @Description:
;   Setup a AMP debug session using a single script approach.
;   Loads the sieve demo application into RAM and sets up a demo debug
;   scenario.
;   Use this script to test the AMP-Debugging.
;   Prerequisites:
;    * Both USB dongle and Nucleo-Board do not have standard debug header,
;      so the debug dignals need to be connected via pin rows
;    * On the USB dongle connect debug signals to CN1:
;         SWDIO  -> PA13 (CN1 pin 3)
;         SWDCLK -> PA14 (CN1 pin 4)
;         SWO    -> PB3  (CN1 pin 5)
;         nReset -> nRST (CN1 pin 2)
;         VREF   -> 3V3  (CN1 pin 6)
;    * On Nucleo board remove jumper on JP5 and connect
;         SWDIO  -> PA13 (JP5 pin 5)
;         SWDCLK -> PA14 (JP5 pin 7)
;         SWO    -> PB3  (JP5 pin 9)
;         nReset -> nRST (JP5 pin 3)
;         VREF   -> 3V3  (JP5 pin 11)
; @Keywords: ARM
; @Author: STK
; @Board: P-Nucleo-WB55
; @Chip: STM32WB55RG
; @Copyright: (C) 1989-2020 Lauterbach GmbH, licensed for use with TRACE32(R) only
; --------------------------------------------------------------------------------
; $Id: p-nucleo-wb55-amp_amp_sram.cmm 15851 2020-03-19 18:16:50Z skrausse $


WinCLEAR

IF SYStem.INSTANCE()!=1.
(
  PRINT %ERROR "This script must be called from MASTER GUI!"
  ENDDO
)

; store current script path in &ppd
PRIVATE &ppd
&ppd=OS.PPD()

; --------------------------------------------------------------------------------
; [optional] close any existing REMOTE GUIs
; IC OTHERS QUIT

; --------------------------------------------------------------------------------
; open all SLAVE GUIs
IF !INTERCOM.PING(M0P)
  TargetSystem.NewInstance M0P /ARCHitecture ARM

; --------------------------------------------------------------------------------
; set titles for SLAVE GUIs
TITLE "TRACE32 for ARM - STM32WB55RG-CM4 - MASTER"
InterCom M0P TITLE "TRACE32 for ARM - STM32WB55RG-CM0+ - SLAVE1"

; --------------------------------------------------------------------------------
; common SYStem settings
InterCom ALL RESet

SYStem.CPU STM32WB55RG-CM4
SYStem.CONFIG CORE 1. 1.
SYStem.CONFIG SLAVE OFF
SYStem.CONFIG DEBUGPORTTYPE SWD

InterCom M0P SYStem.CPU STM32WB55RG-CM0+
InterCom M0P SYStem.CONFIG CORE 2. 1.
InterCom M0P SYStem.CONFIG SLAVE ON

SYStem.Up

; --------------------------------------------------------------------------------
; Check, if second cores debug interface is accessible
IF (Data.Long(ASD:0x58004080)&0x00001000)==0x00001000
(
  PRINT %ERROR "Cortex-M0 not accessible, debug interface locked!"
  PLIST
  STOP
  ENDDO
)

; --------------------------------------------------------------------------------
; kick secondary cores
Data.Set ASD:0x5800040C %Long 0xXXXXxxxxXXXXxxxx1XXXxxxxXXXXxxxx

; --------------------------------------------------------------------------------
; attach to all cores on all sessions
InterCom M0P SYStem.Mode.Up

; --------------------------------------------------------------------------------
; load demo program on all sessions (use internal RAM only)
Data.LOAD.Elf &(ppd)/master/sieve_ram_thumb_ii_v7m.elf
InterCom M0P Data.LOAD.Elf &(ppd)/slave1/sieve_ram_thumb_v6m.elf

; --------------------------------------------------------------------------------
; start program execution
Go.direct main\1
WAIT !STATE.RUN()
InterCom M0P Go.direct main\1
InterCom M0P WAIT !STATE.RUN()

; --------------------------------------------------------------------------------
; open some windows
InterCom ALL WinCLEAR
InterCom ALL Mode.Hll
InterCom ALL WinPOS 0. 0. 116. 26.
InterCom ALL List.auto

InterCom ALL SYnch.ON
InterCom ALL SYnch.CONNECT OTHERS
InterCom ALL SYnch.MasterBreak ON
InterCom ALL SYnch.SlaveBreak  ON
InterCom ALL SYnch.MasterGo    ON
InterCom ALL SYnch.SlaveGo     ON

ENDDO
