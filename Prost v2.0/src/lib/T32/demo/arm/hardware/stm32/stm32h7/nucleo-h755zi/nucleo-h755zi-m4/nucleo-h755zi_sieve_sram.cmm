; --------------------------------------------------------------------------------
; @Title: Simple demo script for STM32H755ZI-CM4 on NUCLEO-H755ZI (RAM)
; @Description:
;   Loads the sieve demo application into RAM and sets up a demo debug
;   scenario.
;   Use this script for getting started.
;   Prerequisites:
;    * Use this script, if only M4 core is booting (BCM7 = 0, BCM4 = 1)
;    * Connect Debug Cable to CN5 using Adapter LA-3770
;      or
;      Connect Combiprobe/uTrace to CN5
; @Keywords: ARM, Cortex-M4
; @Author: STK
; @Board: NUCLEO-H755ZI
; @Chip: STM32H755ZI-CM4
; @Copyright: (C) 1989-2020 Lauterbach GmbH, licensed for use with TRACE32(R) only
; --------------------------------------------------------------------------------
; $Id: nucleo-h755zi_sieve_sram.cmm 15519 2020-01-14 09:05:23Z skrausse $


WinCLEAR

; --------------------------------------------------------------------------------
; initialize and start the debugger
RESet
SYStem.CPU STM32H755ZI-CM4
SYStem.CONFIG.DEBUGPORTTYPE SWD
IF COMBIPROBE()||UTRACE()
(
  SYStem.CONFIG.CONNECTOR MIPI20T
)
SYStem.Option DUALPORT ON
SYStem.Up

; --------------------------------------------------------------------------------
; load demo program (uses internal RAM only)
Data.LOAD.Elf "~~~~/sieve_ram_thumb_ii_v7m.elf"

; --------------------------------------------------------------------------------
; start program execution
Go.direct main
WAIT !STATE.RUN()

; --------------------------------------------------------------------------------
; open some windows
WinCLEAR
Mode.Hll
WinPOS 0. 0. 116. 26.
List.auto
WinPOS 120. 0. 100. 8.
Frame.view
WinPOS 120. 14.
Var.Watch
Var.AddWatch %SpotLight ast flags
WinPOS 120. 25.
Register.view /SpotLight
WinPOS 0. 32.
Var.DRAW %DEFault sinewave

ENDDO
