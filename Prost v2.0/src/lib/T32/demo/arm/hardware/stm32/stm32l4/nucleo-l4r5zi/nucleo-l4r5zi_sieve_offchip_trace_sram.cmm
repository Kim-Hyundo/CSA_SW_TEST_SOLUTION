; --------------------------------------------------------------------------------
; @Title: Demo script for STM32L4R5ZI on NUCLEO-L4R5ZI with Offchip-Trace (RAM)
; @Description:
;   Loads the sieve demo application into RAM and sets up a demo debug
;   scenario.
;   The Offchip Trace using a Combiprobe/uTrace or PowerTrace is set up.
;   Use this script for testing the Offchip-Trace.
;   Prerequisites:
;    * Connect signals of the Debug Cable/CombiProbe/µTrace as follows:
;         VREF     : CN8 pin 7 (3.3V)
;         GND      : GND
;         TMS/SWDIO: CN4 pin 4
;         TCK/SWDCK: CN4 pin 2
;         TDO/SWO  : CN5 pin 6
;         NSRST    : CN5 pin 5
;         TRACECLK : CN9 pin 14
;         TRACED0  : CN9 pin 22
;         TRACED1  : CN9 pin 16
;         TRACED2  : CN9 pin 18
;         TRACED3  : CN9 pin 20
;    * ensure CN4 jumpers are OPEN
;    * Close JP2
;    * Open JP1
;    * Set JP6 to position 5-6
;    * keep trace length as short as possible
;    * ensure proper GND connection
; @Keywords: ARM, Cortex-M4, ETM, ITM
; @Author: STK
; @Board: NUCLEO-L4R5ZI
; @Chip: STM32L4R5ZI
; @Copyright: (C) 1989-2019 Lauterbach GmbH, licensed for use with TRACE32(R) only
; --------------------------------------------------------------------------------
; $Id: nucleo-l4r5zi_sieve_offchip_trace_sram.cmm 15217 2019-11-04 16:17:15Z bschroefel $


WinCLEAR

; --------------------------------------------------------------------------------
; initialize and start the debugger
RESet
SYStem.RESet
SYStem.CPU STM32L4R5ZI
SYStem.CONFIG.DEBUGPORTTYPE SWD
IF COMBIPROBE()||UTRACE()
(
  SYStem.CONFIG.CONNECTOR MIPI20T
)
SYStem.Option DUALPORT ON
SYStem.MemAccess DAP
SYStem.JtagClock 10MHz
Trace.DISable
SYStem.Up

; --------------------------------------------------------------------------------
; load demo program (uses internal RAM only)
Data.LOAD.Elf "~~~~/sieve_ram_thumb_ii_v7m.elf"

; --------------------------------------------------------------------------------
; initialize OFFCHIP trace (ETM, ITM)
IF COMBIPROBE()||UTRACE()||Analyzer()
(
  ; set PinMux and enable Clocks
    ; set PinMux and enable Clocks
  ; DBGMCU
  Data.Set AD:0xE0042004 %Long Data.Long(AD:0xE0042004)|0xE0
  ; RCC_AHB2ENR.GPIOE_EN
  Data.Set AD:0x4002104c %Long Data.Long(AD:0x4002104c)|0x10
  ; GPIOE[2] = TraceClk
  ; AFRL
  Data.Set AD:0x48001020 %Long (Data.Long(AD:0x48001020)&~(0xf<<(2.*4.)))|(0x0<<(2.*4.))
  ; OSPEED
  Data.Set AD:0x48001008 %Long (Data.Long(AD:0x48001008)&~(0x3<<(2.*2.)))|(0x3<<(2.*2.))
  ; MODE
  Data.Set AD:0x48001000 %Long (Data.Long(AD:0x48001000)&~(0x3<<(2.*2.)))|(0x2<<(2.*2.))
  ; GPIOE[3] = TraceD0
  ; AFRL
  Data.Set AD:0x48001020 %Long (Data.Long(AD:0x48001020)&~(0xf<<(3.*4.)))|(0x0<<(3.*4.))
  ; OSPEED
  Data.Set AD:0x48001008 %Long (Data.Long(AD:0x48001008)&~(0x3<<(3.*2.)))|(0x3<<(3.*2.))
  ; MODE
  Data.Set AD:0x48001000 %Long (Data.Long(AD:0x48001000)&~(0x3<<(3.*2.)))|(0x2<<(3.*2.))
  ; GPIOE[4] = TraceD1
  ; AFRL
  Data.Set AD:0x48001020 %Long (Data.Long(AD:0x48001020)&~(0xf<<(4.*4.)))|(0x0<<(4.*4.))
  ; OSPEED
  Data.Set AD:0x48001008 %Long (Data.Long(AD:0x48001008)&~(0x3<<(4.*2.)))|(0x3<<(4.*2.))
  ; MODE
  Data.Set AD:0x48001000 %Long (Data.Long(AD:0x48001000)&~(0x3<<(4.*2.)))|(0x2<<(4.*2.))
  ; GPIOE[5] = TraceD2
  ; AFRL
  Data.Set AD:0x48001020 %Long (Data.Long(AD:0x48001020)&~(0xf<<(5.*4.)))|(0x0<<(5.*4.))
  ; OSPEED
  Data.Set AD:0x48001008 %Long (Data.Long(AD:0x48001008)&~(0x3<<(5.*2.)))|(0x3<<(5.*2.))
  ; MODE
  Data.Set AD:0x48001000 %Long (Data.Long(AD:0x48001000)&~(0x3<<(5.*2.)))|(0x2<<(5.*2.))
  ; GPIOE[6] = TraceD3
  ; AFRL
  Data.Set AD:0x48001020 %Long (Data.Long(AD:0x48001020)&~(0xf<<(6.*4.)))|(0x0<<(6.*4.))
  ; OSPEED
  Data.Set AD:0x48001008 %Long (Data.Long(AD:0x48001008)&~(0x3<<(6.*2.)))|(0x3<<(6.*2.))
  ; MODE
  Data.Set AD:0x48001000 %Long (Data.Long(AD:0x48001000)&~(0x3<<(6.*2.)))|(0x2<<(6.*2.))

  TPIU.PortSize 4
  TPIU.PortMode Continuous
  ITM.DataTrace CorrelatedData
  ITM.ON
  ETM.Trace ON
  ETM.ON
)
IF COMBIPROBE()||UTRACE()
(
  Trace.METHOD CAnalyzer
  Trace.AutoInit ON
  CAnalyzer.AutoFocus
)
IF Analyzer()
(
  Trace.METHOD Analyzer
  Trace.AutoInit ON
  Trace.AutoFocus
)

; --------------------------------------------------------------------------------
; start program execution
Go.direct main
WAIT !STATE.RUN()

; --------------------------------------------------------------------------------
; setup ITM based datatrace of variable plot1
Var.Break.Set plot1 /Write /TraceData

; --------------------------------------------------------------------------------
; open some windows
WinCLEAR
Mode.Hll
WinPOS 0. 0. 116. 26.
List.auto
WinPOS 120. 0. 100. 8.
Frame.view
WinPOS 120. 14.
Var.Watch
Var.AddWatch %SpotLight ast flags
WinPOS 120. 25.
Trace.List
WinPOS 0. 32.
Trace.DRAW.Var %DEFault plot1

ENDDO
