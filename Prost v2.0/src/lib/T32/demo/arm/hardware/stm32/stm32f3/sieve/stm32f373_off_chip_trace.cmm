; --------------------------------------------------------------------------------
; @Title: Off chip trace demo for STM32373C-EVAL board
; @Description:
;   This is a small demo how to setup off-chip trace on Cortex-M4
;   for STM32373C-EVAL board
;   Prerequisites:
;     - Use CN15 connector
;     - Remove R29, R73, and R89 : In this situation, the touch slider
;       and joystick do not work.
;     - Remove the SD card
; @Keywords: Cortex-M4, ETM, ITM, off-chip, SWD, trace
; @Author: HDA
; @Board: STM32373C-EVAL
; @Chip: STM32F373VC
; @Copyright: (C) 1989-2019 Lauterbach GmbH, licensed for use with TRACE32(R) only
; --------------------------------------------------------------------------------
; $Id: stm32f373_off_chip_trace.cmm 15217 2019-11-04 16:17:15Z bschroefel $

; memory map
; 0x00000000 256kB FLASH (aliased from 0x08000000)
; 0x20000000  32kB SRAM

  Break.Reset
  SYStem.RESet
  MAP.DENYACCESS 0x20020000--0x3FFFFFFF
  SYStem.CPU STM32F373VC
  SYStem.CONFIG DEBUGPORTTYPE SWD
  SYStem.CONFIG CONNECTOR MIPI20T
  SYStem.Up

; Prevent error during power saving states and stop peripherals in debug mode
  Data.Set E:0xE0042004 %Long 0yXXXXxxxxXXX11111XXXXxxxxXXXXx111  ; DBGMCU_CR
; Setup GPIO clock
  Data.Set E:0x40021014  %Long 0yXXXXxxxxXX1XxxxxXXXXxxxxXXXXxxxx  ; RCC_AHBENR
; Setup pin multiplexing for using the 4 bit trace
  Data.Set E:0x48001000 %Long 0yXXXXxxxxXXXXxxxxXX1010101010xxxx  ; GPOIE_PORTMODE
  Data.Set E:0x48001008 %Long 0yXXXXxxxxXXXXxxxxXX1111111111xxxx  ; GPOIE_PORTSPEED
  Data.Set E:0x48001020 %Long 0yXXXX00000000000000000000XXXXxxxx  ; GPIOE_AFRL

; load debug information of demo application on the board
  Data.LOAD.ELF ~~~~/demo_sram.axf
  Register.Set PC main
  Register.Set R13 0x20005000

; Turn on ITM and ETM
  ETM.ON
  ITM.ON

  ETM.PortMode Continuous
  ETM.PortSize 4.

  ;generate some traces on ITM
  ITM.PCSampler 1/128

; Slect the Analyzer (PowerTrace with Preprocessor)
  IF hardware.COMBIPROBE()||hardware.UTRACE()
  (
    Trace.Method CAnalyzer   ; Using CombiProbe
  )
  ELSE IF ANALYZER()
  (
    Trace.Method Analyzer    ; Using ARM preprocessor
  )

  Trace.Off              ; Enable the trace and turn it off

  ; open some windows
  WinCLEAR

  WinPOS 0% 0% 50% 50%
  List.auto

  WinPOS 50% 0% 50% 50%
  Trace.List

  WinPOS 0% 50% 50% 50%
  ITMTrace.list

  WinPOS 50% 50% 50% 50%
  Trace.Chart.sYmbol

  Go.direct
  WAIT 5.s
  Break.direct

  ENDDO

