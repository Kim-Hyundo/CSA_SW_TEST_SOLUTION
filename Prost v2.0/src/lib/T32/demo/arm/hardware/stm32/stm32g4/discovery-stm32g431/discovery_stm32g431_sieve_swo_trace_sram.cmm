; --------------------------------------------------------------------------------
; @Title: Demo script for STM32G431CB on STM32G431 Discovery Kit with SWV (RAM)
; @Description:
;   Loads the sieve demo application into RAM and sets up a demo debug
;   scenario.
;   The SerialWireViewer is set up to trace some data values using the DWT.
;   Prerequisites:
;    * There is no debug header on the board. SWD signals need to be hand wired
;      from J4. SWO can be taken from J3 pin 2.
; @Keywords: ARM, Cortex-M4, ITM, SWV
; @Author: STK
; @Board: STM32G431 Discovery Kit
; @Chip: STM32G431CB
; @Copyright: (C) 1989-2019 Lauterbach GmbH, licensed for use with TRACE32(R) only
; --------------------------------------------------------------------------------
; $Id: discovery_stm32g431_sieve_swo_trace_sram.cmm 15351 2019-12-02 14:12:08Z skrausse $


; Prerequisite: check if a Combiprobe/uTrace is connected
IF !CAnalyzer()
(
  DIALOG.OK "Support for SerialWireViewer requires a Combiprobe or uTrace."
  ENDDO
)

WinCLEAR

; --------------------------------------------------------------------------------
; initialize and start the debugger
RESet
SYStem.RESet
SYStem.CPU STM32G431CB
SYStem.CONFIG.DEBUGPORTTYPE SWD
SYStem.Option DUALPORT ON
SYStem.MemAccess DAP
SYStem.Up

; --------------------------------------------------------------------------------
; load demo program (uses internal RAM only)
Data.LOAD.Elf "~~~~/sieve_ram_thumb_ii_v7m.elf"

; --------------------------------------------------------------------------------
; start program execution
Go.direct main
WAIT !STATE.RUN()

; --------------------------------------------------------------------------------
; initialize SerialWireViewer (clock is stable now)
Trace.METHOD CAnalyzer
Trace.AutoInit ON
TPIU.PortSize SWV
ITM.DataTrace ON
ITM.ON
; use auto-calibration script to find most suitable TPIU.SWVPrescaler <divider>
DO ~~/demo/arm/etc/serial_wire_viewer/swv_autocalibration.cmm

; --------------------------------------------------------------------------------
; setup ITM based datatrace of variable plot1
Var.Break.Set plot1 /Write /TraceData

; --------------------------------------------------------------------------------
; open some windows
WinCLEAR
Mode.Hll
WinPOS 0. 0. 116. 26.
List.auto
WinPOS 120. 0. 100. 8.
Frame.view
WinPOS 120. 14.
Var.Watch
Var.AddWatch %SpotLight ast flags
WinPOS 120. 25.
ITMTrace.List
WinPOS 0. 32.
Trace.DRAW.Var %DEFault plot1

ENDDO
