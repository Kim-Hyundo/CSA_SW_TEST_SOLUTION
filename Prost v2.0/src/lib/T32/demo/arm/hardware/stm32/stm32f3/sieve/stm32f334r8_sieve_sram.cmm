; --------------------------------------------------------------------------------
; @Title: Run a Sieve demo in SRAM for STM32 Nucleo Board.
; @Description: 
;     SRAM: 0x20000000--0x20002FFF
;     jumpers settings:
;       - remove both CN2 jumpers, remove CN12 jumper
;       - put JP1 jumper
;       - set JP5 power jumper to U5V (power by USB)
;     pin connection for AMR 20 debug cable:
;     | ARM20 Debug cable   | Name    | STM32 Nucleo F334RB board |
;
;     | Pin 1               | VREF    | CN7[6]                    |
;     | Pin 4               | GND     | CN7[8]                    |
;     | Pin 7               | SWDIO   | CN2[4]                    |
;     | Pin 9               | SWCLK   | CN2[2]                    |
;     | Pin 15              | NRST    | CN7[14]                   |
;
; @Keywords: Cortex-M4F, SWD, sieve 
; @Author: MSA
; @Board: STM32Nucleo
; @Chip: STM32F334R8
; @Copyright: (C) 1989-2019 Lauterbach GmbH, licensed for use with TRACE32(R) only
; --------------------------------------------------------------------------------
; $Id: stm32f334r8_sieve_sram.cmm 15217 2019-11-04 16:17:15Z bschroefel $

  RESet
  SYStem.RESet
  SYStem.CPU STM32F334R8
;  SYStem.Option.ResBreak OFF
  SYStem.CONFIG.DEBUGPORTTYPE SWD

  SYStem.Up

  Data.LOAD.Elf ~~~~/stm32f334r8/sieve_ram_thumb_ii_v7.elf

  ; open some windows
  WinCLEAR

  WinPOS 0% 0% 50% 50%
  List.auto

  WinPOS 50% 0% 50% 50%
  Register.view /SpotLight

  WinPOS 0% 50% 50% 50%
  Frame /Locals /Caller

  WinPOS 50% 50% 50% 50%
  Var.DRAW sinewave
  
  GO
  WAIT 2.s
  Break
  ENDDO
