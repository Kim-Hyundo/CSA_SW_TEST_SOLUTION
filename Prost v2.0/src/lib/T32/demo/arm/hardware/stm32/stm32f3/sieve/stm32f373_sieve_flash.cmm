; --------------------------------------------------------------------------------
; @Title: Simple sieve demo running from Flash for STM32373C-EVAL board
; @Description: 
;   This is a small demo running from FLASH showing how to setup a debug session 
;   on Cortex-M4 for STM32373C-EVAL board. The sieve demo is loaded on flash  
;   using the board support scripts of the TRACE32 installation.
;   Either CN15 connector or CN17 connector could be used.
;
; @Keywords: Cortex-M4, Debug, FLASH
; @Author: HDA
; @Board: STM32373C-EVAL
; @Chip: STM32F373VC
; @Copyright: (C) 1989-2019 Lauterbach GmbH, licensed for use with TRACE32(R) only
; --------------------------------------------------------------------------------
; $Id: stm32f373_sieve_flash.cmm 15217 2019-11-04 16:17:15Z bschroefel $

; memory map
; 0x00000000 256kB FLASH (aliased from 0x08000000)
; 0x20000000  32kB SRAM


; Basic setup
  RESet
  SYStem.RESet
  SYStem.CPU STM32F373VC
  SYStem.CONFIG.DEBUGPORTTYPE SWD
  SYStem.MemAccess DAP
  SYStem.Option DUALPORT ON
  SYStem.Up

; Flash programming warning
  DIALOG.YESNO "This demo will program flash memory. Do you want to continue?"
  LOCAL &progflash
  ENTRY &progflash
  IF !&progflash
  (
    ENDDO
  )

  ; Setup flash configuration using the board support scripts of the TRACE32 installation
  DO ~~/demo/arm/flash/stm32f3xx.cmm PREPAREONLY DUALPORT=1

  ; Program the internal flash
  FLASH.ReProgram.ALL /Erase
  Data.LOAD.Elf ~~~~/demo_flash.axf /NosYmbol
  FLASH.ReProgram.off

  ; Reset device
  SYStem.Down
  SYStem.Up
  
  ; Loading symbol information
  Data.LOAD.Elf ~~~~/demo_flash.axf /NoCODE

  Go.direct

  ; open some windows
  WinCLEAR

  WinPOS 0% 0% 50% 50%
  List.auto

  WinPOS 50% 0% 50% 50%
  Register.view /SpotLight

  WinPOS 0% 50% 50% 30%
  Frame /Locals /Caller

  WinPOS 0% 80% 50% 20%
  Var.Watch %E %SpotLight.on flags
  Var.AddWatch ast

  WinPOS 50% 50% 50% 50%
  Var.DRAW sinewave

  ENDDO