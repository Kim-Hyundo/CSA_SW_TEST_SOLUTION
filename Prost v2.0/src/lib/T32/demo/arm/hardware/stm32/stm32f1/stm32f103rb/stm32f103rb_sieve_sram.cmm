; --------------------------------------------------------------------------------
; @Title: Run a Sieve demo in SRAM for Olimex STM32-H103
; @Description: 
;     SRAM: 0x20000000--0x20004FFF
;
; @Keywords: Cortex-M3, SWD, STM32-H103, STM32-H405
; @Author: MSA
; @Board: Olimex 
; @Chip: STM32F103RB
; @Copyright: (C) 1989-2019 Lauterbach GmbH, licensed for use with TRACE32(R) only
; --------------------------------------------------------------------------------
; $Id: stm32f103rb_sieve_sram.cmm 15217 2019-11-04 16:17:15Z bschroefel $

  RESet
  SYStem.RESet
  SYStem.CPU STM32F103RB
  SYStem.CONFIG.DEBUGPORTTYPE SWD

  SYStem.Up

  Data.LOAD.Elf ~~~~/sieve_ram_thumb_ii_v7.elf

  ; open some windows
  WinCLEAR

  WinPOS 0% 0% 50% 50%
  List.auto

  WinPOS 50% 0% 50% 50%
  Register.view /SpotLight

  WinPOS 0% 50% 50% 50%
  Frame /Locals /Caller

  WinPOS 50% 50% 50% 50%
  Var.DRAW sinewave
  
  GO
  WAIT 2.s
  Break
  ENDDO
