; --------------------------------------------------------------------------------
; @Title: STM-Demo script for STM32MP157A-CA7 with Onchip-Trace (RAM, ETF, STM)
; @Description:
;   Loads the STM stimulus demo application into RAM and sets up a demo debug
;   scenario.
;   The code will either continuously produce raw STM data or will demonstrate
;   the STM printf trace feature by writing to STIMULUS register 0.
;   The STM data is traced using the Onchip-Trace (ETF).
;   Prerequisites:
;    * Connect Debug Cable/Combiprobe to J14
;    * The demos are tested in Engineering boot mode:
;      SW1[0..2]=ON,OFF,OFF
; @Keywords: ARM, Cortex-A7, ETF, ETM
; @Author: STK
; @Board: STM32MP15X-EVAL
; @Chip: STM32MP157A-CA7
; @Copyright: (C) 1989-2019 Lauterbach GmbH, licensed for use with TRACE32(R) only
; --------------------------------------------------------------------------------
; $Id: stm32mp15x-eval_stm_onchip_etf_trace_sram.cmm 14337 2019-04-26 15:41:57Z skrausse $


WinCLEAR

; --------------------------------------------------------------------------------
; initialize and start the debugger
RESet
SYStem.RESet
SYStem.CPU STM32MP157A-CA7
SYStem.JtagClock 10MHz
CORE.ASSIGN 1.
Trace.DISable
SYStem.Up

; --------------------------------------------------------------------------------
; load demo program (uses internal RAM only)
Data.LOAD.Elf "~~~~/stm_stimulus_ram_arm_v7.elf"

; --------------------------------------------------------------------------------
; start program execution
Go.direct main
WAIT !STATE.RUN()

; --------------------------------------------------------------------------------
; initialize global variables
; set STM STIMULUS base address
Var.Assign pStimulusBase=0x90000000

; --------------------------------------------------------------------------------
; initialize ONCHIP trace (ETF)
(
  Trace.METHOD ONCHIP
  SystemTrace.METHOD ONCHIP
  ETM.Trace OFF
  ETM.ON
  STM.ON
)

; per default demonstrate data trace only
IF TRUE()    // For data trace only
(
  ; some more variable initializations for the example code
  Var.Assign bLongStimulusEnable=1
  Var.Assign nLongStimulus=0x12345678
  Var.Assign bAlternateStimulusEnable=1

  ; --------------------------------------------------------------------------------
  ; open some windows
  WinCLEAR
  Mode.Hll
  WinPOS 0. 0. 116. 26.
  List.auto
  WinPOS 120. 0. 100. 16.
  Var.Watch
  Var.AddWatch %SpotLight %Hex bByteStimulusEnable bWordStimulusEnable bLongStimulusEnable bQuadStimulusEnable
  Var.AddWatch %SpotLight %Hex bAlternateStimulusEnable
  Var.AddWatch %SpotLight %Hex nByteStimulus nWordStimulus nLongStimulus nQuadStimulus
  WinPOS 0. 32.
  SystemTrace.List
)
ELSE         // For STM string printout only
(
  ; some more variable initializations for the example code
  Var.Assign pPrintfString="STM test string"

  ; --------------------------------------------------------------------------------
  ; open some windows
  WinCLEAR
  Mode.Hll
  WinPOS 0. 0. 116. 26.
  List.auto
  WinPOS 120. 0. 100. 16.
  Var.Watch
  Var.AddWatch %SpotLight %String pPrintfString
  WinPOS 0. 32.
  SystemTrace.List
  WinPOS 120. 25.
  PrintfTrace.List MESSAGE
)

ENDDO
