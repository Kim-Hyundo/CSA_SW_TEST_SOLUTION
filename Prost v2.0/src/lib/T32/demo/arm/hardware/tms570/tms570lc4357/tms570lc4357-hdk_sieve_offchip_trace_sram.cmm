; --------------------------------------------------------------------------------
; @Title: Demo script for TMS570LC4357-HDK with Offchip-Trace (RAM)
; @Description:
;   Loads the sieve demo application into RAM and sets up a demo debug
;   scenario.
;   The program flow is traced using the Offchip-Trace. Pinmuxing and Clock
;   setup are using the default settings of the chip after reset.
;   Use this script to test the Offchip-Trace.
;   Prerequisites:
;    * Connect Debug Cable to J4
;    * Connect MIPI Preprocessor using a MIPI60 cable to J19
;    * Because trace pins beyond 8 bit trace of the SOC are shared with the
;      EMIF pins, SDRAM cannot be used, when the trace port is wider than 8 bit.
; @Keywords: ARM, Cortex-R5, ETM
; @Author: STK
; @Board: TMS570LC4357 Hercules Development Board
; @Chip: TMS570LC4357
; @Copyright: (C) 1989-2019 Lauterbach GmbH, licensed for use with TRACE32(R) only
; --------------------------------------------------------------------------------
; $Id: tms570lc4357-hdk_sieve_offchip_trace_sram.cmm 15217 2019-11-04 16:17:15Z bschroefel $


WinCLEAR

; --------------------------------------------------------------------------------
; initialize and start the debugger
RESet
SYStem.RESet
SYStem.CPU TMS570LC4357
SYStem.MemAccess DAP
SYStem.JtagClock CTCK 10MHz
SYStem.Up

; --------------------------------------------------------------------------------
; Setup CTI to freeze peripherals while debugging
GOSUB CtiSetup

; --------------------------------------------------------------------------------
; Init SRAM and ECC checks
GOSUB SramInit

; --------------------------------------------------------------------------------
; load demo program (uses internal RAM only)
Data.LOAD.Elf "~~~~/sieve_ram_arm_v7r_be.elf"

; --------------------------------------------------------------------------------
; initialize OFFCHIP trace (ETM) if Analyzer is plugged
IF Analyzer()
(
  TPIU.PortSize 32.
  TPIU.PortMode Wrapped
  ETM.Trace ON
  ETM.ON
  Trace.METHOD Analyzer
  Trace.AutoFocus
)

; --------------------------------------------------------------------------------
; start program execution
Go.direct main
WAIT !STATE.RUN()

; --------------------------------------------------------------------------------
; open some windows
WinCLEAR
Mode.Hll
WinPOS 0. 0.
List.auto
WinPOS 120. 0. 100. 8.
Frame.view
WinPOS 120. 14.
Var.Watch
Var.AddWatch %SpotLight ast flags
WinPOS 120. 25.
Trace.List
WinPOS 0. 32.
Var.DRAW %DEFault sinewave
ENDDO


CtiSetup:
(
  LOCAL &CoreCtiBase &PeriphCtiBase

  &CoreCtiBase=COMPonent.BASE("CTI",0.)
  &CoreCtiBase=CONVert.ADDRESSTODUALPORT(&CoreCtiBase)
  &PeriphCtiBase=EDAP:0x8000a000
  &TPIUCtiBase=EDAP:0x80009000

  ; <do not change>
  ; MAP CR5-"Core-Stopped" (CTITRIGIN7) to CTM Channel 2
  Data.Set &CoreCtiBase+0x3c %Long 0x4
  ; ensure CTM2 is not GATED
  Data.Set &CoreCtiBase+0x40 %Long Data.Long(&CoreCtiBase+0x40)|0x4
  ; enable CR5-CTI
  Data.Set &CoreCtiBase+0x00 %Long 0x1
  ; </do not change>

  ; <user config>
  ; the following Data.Set's connect "Core-Stopped" signal to the
  ; listed peripherals
  ; L2FMC, CCMR5, CRCx, and SYS modules
  Data.Set &PeriphCtiBase+0xa0 %Long 0x4
  ; DMA, RTIx, AWMx, HTUx, SCIx, LINx, I2Cx, EMAC, EQEP, ECAP, DMM and DCCx modules
  Data.Set &PeriphCtiBase+0xa4 %Long 0x4
  ; DCANx
  Data.Set &PeriphCtiBase+0xa8 %Long 0x4
  ; ETPWMx
  Data.Set &PeriphCtiBase+0xac %Long 0x4
  ; </user config>
  ; <do not change>
  ; ensure CTM2 is not GATED
  Data.Set &PeriphCtiBase+0x40 %Long Data.Long(&CoreCtiBase+0x40)|0x4
  ; enable PERIPH-CTI
  Data.Set &PeriphCtiBase+0x00 %Long 0x1
  ; </do not change>
  
  
  ; Enable Trace Triggering via CTI channel 3

  ; Configure ETM trigger to channel 3
  Data.Set &CoreCtiBase       %Long 1
  Data.Set &CoreCtiBase+0x038 %Long Data.Long(&CoreCtiBase+0x038)|0x8
  
  Data.Set &TPIUCtiBase       %Long 1
  Data.Set &TPIUCtiBase+0x0A0 %Long Data.Long(&TPIUCtiBase+0x0A0)|0x8

  RETURN
)


SramInit:
(
    ; Clear SRAM to prevent ECC faults
    Data.Set 0xFFFFFF5C %BE %Long 0x00000005
    Data.Set 0xFFFFFF5C %BE %Long 0x0000000A
    Data.Set 0xFFFFFF60 %BE %Long 0x00000001    ; init L2 SRAM only
    Data.Set 0xFFFFFF5C %BE %Long 0x00000005
    
    RETURN
)
