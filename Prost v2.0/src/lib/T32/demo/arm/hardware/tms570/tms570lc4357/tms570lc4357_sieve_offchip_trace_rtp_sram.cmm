; --------------------------------------------------------------------------------
; @Title: Demo script for TMS570LC4357 with parallel program and Ram Trace Port trace.
; @Description:
;   Loads the sieve demo application into RAM and sets up a demo debug
;   scenario with parallel program and RTP offchip trace.
;   Pin-Multiplexing and Clock initialization is handled in the script.
;   Prerequisites:
;    * Connect AutoFocus Preprocessor probe "A" to according connector on LA-3816
;    * Connect AutoFocus Preprocessor probe "B" to connector on LA-3835
;    * TPIU and RTP must have the same portwidth.
;      
; @Keywords: ARM, Cortex-R5, ETM, TMS570, RTP
; @Author: STK JBO
; @Board: TMS570LC4357 Hercules Development Board
; @Chip: TMS570LC435*
; @Copyright: (C) 1989-2019 Lauterbach GmbH, licensed for use with TRACE32(R) only
; --------------------------------------------------------------------------------
; $Id: tms570lc4357_sieve_offchip_trace_rtp_sram.cmm 15217 2019-11-04 16:17:15Z bschroefel $


WinCLEAR

; --------------------------------------------------------------------------------
; initialize and start the debugger
RESet
SYStem.RESet
SYStem.CPU TMS570LC4357
SYStem.MemAccess DAP
SYStem.JtagClock CTCK 10MHz
SYStem.Up

; --------------------------------------------------------------------------------
; Setup CTI to freeze peripherals while debugging
GOSUB CtiSetup

; --------------------------------------------------------------------------------
; Init SRAM and ECC checks
GOSUB SramInit

; --------------------------------------------------------------------------------
; load demo program (uses internal RAM only)
Data.LOAD.Elf "~~~~/sieve_ram_arm_v7r_be.elf"

; --------------------------------------------------------------------------------
; initialize OFFCHIP trace (ETM) if Analyzer is plugged
IF Analyzer()
(
  ; set PinMux and enable Clocks

  Analyzer.PortType TPIU+RTP
  TPIU.PortSize 16
  TPIU.PortMode Wrapped
  ETM.Trace ON
  ETM.ON
  Trace.METHOD Analyzer
  
  RTP.PortSize 16R
  RTP.PortClock 1/2
  
  RTP.TM.RAM1.SECT1.ACCESS CPU
  RTP.TM.RAM1.SECT1.SIZE 512B
  RTP.TM.RAM1.SECT1.ADDRESS 0X08002e00
  RTP.TM.RAM1.SECT1.CYCLE WRITE
  RTP.TM.RAM2.SECT1.ACCESS CPU
  RTP.TM.RAM2.SECT1.SIZE 512B
  RTP.TM.RAM2.SECT1.ADDRESS 0X08002e00
  RTP.TM.RAM2.SECT1.CYCLE WRITE
    
  RTP.ON
  GOSUB multiplexRTPpins
)

; --------------------------------------------------------------------------------
; start program execution
Go.direct main
WAIT !STATE.RUN()

; --------------------------------------------------------------------------------
; open some windows
WinCLEAR
Mode.Hll
WinPOS 0. 0.
List.auto
WinPOS 120. 0. 100. 8.
Frame.view
WinPOS 120. 14.
Var.Watch
Var.AddWatch %SpotLight ast flags
WinPOS 120. 25.
Trace.List
RTPA.List
WinPOS 0. 32.
Var.DRAW %DEFault sinewave
ENDDO


CtiSetup:
(
  LOCAL &CoreCtiBase &PeriphCtiBase
	
  &CoreCtiBase=COMPonent.BASE("CTI",0.)
  &CoreCtiBase=CONVert.ADDRESSTODUALPORT(&CoreCtiBase)
  &PeriphCtiBase=EDAP:0x8000a000

  ; <do not change>
  ; MAP CR5-"Core-Stopped" (CTITRIGIN7) to CTM Channel 2
  Data.Set &CoreCtiBase+0x3c %Long 0x4
  ; ensure CTM2 is not GATED
  Data.Set &CoreCtiBase+0x40 %Long Data.Long(&CoreCtiBase+0x40)|0x4
  ; enable CR5-CTI
  Data.Set &CoreCtiBase+0x00 %Long 0x1
  ; </do not change>

  ; <user config>
  ; the following Data.Set's connect "Core-Stopped" signal to the
  ; listed peripherals
  ; L2FMC, CCMR5, CRCx, and SYS modules
  Data.Set &PeriphCtiBase+0xa0 %Long 0x4
  ; DMA, RTIx, AWMx, HTUx, SCIx, LINx, I2Cx, EMAC, EQEP, ECAP, DMM and DCCx modules
  Data.Set &PeriphCtiBase+0xa4 %Long 0x4
  ; DCANx
  Data.Set &PeriphCtiBase+0xa8 %Long 0x4
  ; ETPWMx
  Data.Set &PeriphCtiBase+0xac %Long 0x4
  ; </user config>
  ; <do not change>
  ; ensure CTM2 is not GATED
  Data.Set &PeriphCtiBase+0x40 %Long Data.Long(&CoreCtiBase+0x40)|0x4
  ; enable PERIPH-CTI
  Data.Set &PeriphCtiBase+0x00 %Long 0x1
  ; </do not change>

  RETURN
)


SramInit:
(
    ; Clear SRAM to prevent ECC faults
    Data.Set 0xFFFFFF5C %BE %Long 0x00000005
    Data.Set 0xFFFFFF5C %BE %Long 0x0000000A
    Data.Set 0xFFFFFF60 %BE %Long 0x00000001    ; init L2 SRAM only
    Data.Set 0xFFFFFF5C %BE %Long 0x00000005
    
    RETURN
)


multiplexRTPpins:
	; unlock iomm registers (kick0 & kick 1)
	Data.Set 0xffff1c38 %long 0x83e70b13
	Data.Set 0xffff1c3c %long 0x95a4f1e0

	Data.Set 0xffff1d10 %long 0x02020202	;RTP_DATA[13]
	Data.Set 0xffff1d14 %long 0x02020202 	;RTP_DATA[9-12]
	Data.Set 0xffff1d18 %long 0x02020202	;RTP_DATA[4-6,8]
	Data.Set 0xffff1d1c %long 0x02020202	;RTP_DATA[0-3]
	Data.Set 0xffff1d20 %long 0x02020202	;RTP control

	Data.Set 0xffff1d34 %long 0x01020101	;RTP_DATA[15]
	Data.Set 0xffff1d38 %long 0x01010202	;RTP_DATA[7,14]

	; lock iomm registers
	Data.Set 0xffff1c38 %long 0x83e70b13
	RETURN