; --------------------------------------------------------------------------------
; @Title: Simple demo script for TMS570LC4357-HDK (FLASH)
; @Description:
;   Programs the sieve demo application into the processor internal flash and
;   sets up a demo debug scenario.
;   This script can be used as a template for flashing an application.
;   Prerequisites:
;    * Connect Debug Cable to J4
; @Keywords: ARM, Cortex-R5, Flash
; @Author: STK
; @Board: TMS570LC4357 Hercules Development Board
; @Chip: TMS570LC4357
; @Copyright: (C) 1989-2019 Lauterbach GmbH, licensed for use with TRACE32(R) only
; --------------------------------------------------------------------------------
; $Id: tms570lc4357-hdk_sieve_flash.cmm 15217 2019-11-04 16:17:15Z bschroefel $


WinCLEAR

; --------------------------------------------------------------------------------
; initialize and start the debugger
RESet
SYStem.RESet
SYStem.CPU TMS570LC4357
SYStem.MemAccess DAP
SYStem.JtagClock CTCK 10MHz
SYStem.Up

; --------------------------------------------------------------------------------
; Setup CTI to freeze peripherals while debugging
GOSUB CtiSetup

; --------------------------------------------------------------------------------
; Init SRAM and ECC checks
GOSUB SramInit


; --------------------------------------------------------------------------------
; Flash programming

; prepare flash programming (declarations)
DO ~~/demo/arm/flash/tms570lc435x.cmm PREPAREONLY

; ReProgram Flash
FLASH.ReProgram ALL /Erase /FILL
Data.LOAD.Elf "~~~~/sieve_flash_arm_v7r_be.elf"
FLASH.ReProgram OFF

; --------------------------------------------------------------------------------
; Reset the target again
SYStem.Up

; --------------------------------------------------------------------------------
; start program execution
Go.direct main
WAIT !STATE.RUN()

; --------------------------------------------------------------------------------
; open some windows
WinCLEAR
Mode.Hll
WinPOS 0. 0.
List.auto
WinPOS 120. 0. 100. 8.
Frame.view
WinPOS 120. 14.
Var.Watch
Var.AddWatch %SpotLight ast flags
WinPOS 120. 25.
Register.view /SpotLight
WinPOS 0. 32.
Var.DRAW %DEFault sinewave
ENDDO


CtiSetup:
(
  LOCAL &CoreCtiBase &PeriphCtiBase

  &CoreCtiBase=COMPonent.BASE("CTI",0.)
  &CoreCtiBase=CONVert.ADDRESSTODUALPORT(&CoreCtiBase)
  &PeriphCtiBase=EDAP:0x8000a000

  ; <do not change>
  ; MAP CR5-"Core-Stopped" (CTITRIGIN7) to CTM Channel 2
  Data.Set &CoreCtiBase+0x3c %Long 0x4
  ; ensure CTM2 is not GATED
  Data.Set &CoreCtiBase+0x40 %Long Data.Long(&CoreCtiBase+0x40)|0x4
  ; enable CR5-CTI
  Data.Set &CoreCtiBase+0x00 %Long 0x1
  ; </do not change>

  ; <user config>
  ; the following Data.Set's connect "Core-Stopped" signal to the
  ; listed peripherals
  ; L2FMC, CCMR5, CRCx, and SYS modules
  Data.Set &PeriphCtiBase+0xa0 %Long 0x4
  ; DMA, RTIx, AWMx, HTUx, SCIx, LINx, I2Cx, EMAC, EQEP, ECAP, DMM and DCCx modules
  Data.Set &PeriphCtiBase+0xa4 %Long 0x4
  ; DCANx
  Data.Set &PeriphCtiBase+0xa8 %Long 0x4
  ; ETPWMx
  Data.Set &PeriphCtiBase+0xac %Long 0x4
  ; </user config>
  ; <do not change>
  ; ensure CTM2 is not GATED
  Data.Set &PeriphCtiBase+0x40 %Long Data.Long(&CoreCtiBase+0x40)|0x4
  ; enable PERIPH-CTI
  Data.Set &PeriphCtiBase+0x00 %Long 0x1
  ; </do not change>

  RETURN
)


SramInit:
(
    ; Clear SRAM to prevent ECC faults
    Data.Set 0xFFFFFF5C %BE %Long 0x00000005
    Data.Set 0xFFFFFF5C %BE %Long 0x0000000A
    Data.Set 0xFFFFFF60 %BE %Long 0x00000001    ; init L2 SRAM only
    Data.Set 0xFFFFFF5C %BE %Long 0x00000005
    
    RETURN
)
