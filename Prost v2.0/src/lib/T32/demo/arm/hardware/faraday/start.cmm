; --------------------------------------------------------------------------------
; @Title: Start-up script for Faraday CPE-ASIC Motherboard + FA526 CPU Daughter Board
; @Description: This script connects to the FA526.
; @Keywords: sieve
; @Author: PEG
; @Board: Faraday CPE-ASIC
; @Chip: FA526
; @Copyright: (C) 1989-2019 Lauterbach GmbH, licensed for use with TRACE32(R) only
; --------------------------------------------------------------------------------
; $Id: start.cmm 15217 2019-11-04 16:17:15Z bschroefel $


; PEG, 09.10.03

  SYStem.CPU FA526
  SYStem.JtagClock 4MHz
  SYStem.Up










