; --------------------------------------------------------------------------------
; @Title: Simple demo script for 88Q5050 (RAM)
; @Description:
;   Loads the sieve demo application into RAM and sets up a demo debug
;   scenario.
;   Use this script for getting started.
;   Prerequisites:
;    * Connect Debug Cable to P1103 using Adapter LA-3770
;      or
;      Connect Combiprobe/uTrace to P1103
; @Keywords: ARM, Cortex-M7
; @Author: AME
; @Board: Willow
; @Chip: 88Q5050
; @Copyright: (C) 1989-2019 Lauterbach GmbH, licensed for use with TRACE32(R) only
; --------------------------------------------------------------------------------
; $Id: 88q5050_sieve_sram.cmm 15217 2019-11-04 16:17:15Z bschroefel $


WinCLEAR

; --------------------------------------------------------------------------------
; initialize and start the debugger
RESet
SYStem.RESet
SYStem.CPU 88Q5050
SYStem.JtagClock CTCK 10MHz
SYStem.MemAccess DAP
IF COMBIPROBE()||UTRACE()
  SYStem.CONFIG.CONNECTOR MIPI20T
; we use a 88Q5050 proprietary reset method
; soft-reset using AIRCR register + LBU.SWRESET_EN
SYStem.Option VECTRESET OFF
SYStem.Option EnReset   OFF
SYStem.Option DUALPORT  ON
Trace.DISable
SYStem.Mode Prepare
; set LBU.SWRESET_EN
Data.Set AD:0x5000f144 %Long Data.Long(AD:0x5000f144)|(1.<<20.)
SYStem.Up

; --------------------------------------------------------------------------------
; load demo program (uses internal RAM only)
Data.LOAD.Elf "~~~~/sieve_ram_thumb_ii_v7m.elf"

; --------------------------------------------------------------------------------
; start program execution
Go.direct main
WAIT !STATE.RUN()

; --------------------------------------------------------------------------------
; open some windows
WinCLEAR
Mode.Hll
WinPOS 0. 0. 116. 26.
List.auto
WinPOS 120. 0. 100. 8.
Frame.view
WinPOS 120. 14.
Var.Watch
Var.AddWatch %SpotLight ast flags
WinPOS 120. 25.
Register.view /SpotLight
WinPOS 0. 32.
Var.DRAW %DEFault sinewave

ENDDO
