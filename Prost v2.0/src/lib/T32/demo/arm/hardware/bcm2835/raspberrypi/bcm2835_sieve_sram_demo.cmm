; --------------------------------------------------------------------------------
; @Title: Sieve demo for Raspberry Pi
; @Description: -
; @Author: PEG
; @Keywords: RaspberryPi; BCM2835; BCM2705; ARM11
; @Board: Raspberry Pi
; @Chip: BCM2835
; @Copyright: (C) 1989-2019 Lauterbach GmbH, licensed for use with TRACE32(R) only
; --------------------------------------------------------------------------------
; $Id: bcm2835_sieve_sram_demo.cmm 15217 2019-11-04 16:17:15Z bschroefel $

; The board requires a special adaption and a program running on the target to enable
; the JTAG port. See readme.txt.

  RESet
  SYStem.CPU ARM1176JZF
  SYStem.JtagClock RTCK
  SYStem.Up
  Data.LOAD.Elf ~~~~/sieve.elf 0x8000 /RelPATH

; open some windows
  WinCLEAR
  WinPOS 0% 0% 50% 50%
  List.auto
  WinPOS 0% 50% 50% 50%
  Frame /Locals /Caller
  WinPOS 50% 50% 50% 50%
  Var.Watch
  Var.AddWatch ast; flags;
  WinPOS 50% 0% 50% 50%
  Register.view /SpotLight

  ENDDO