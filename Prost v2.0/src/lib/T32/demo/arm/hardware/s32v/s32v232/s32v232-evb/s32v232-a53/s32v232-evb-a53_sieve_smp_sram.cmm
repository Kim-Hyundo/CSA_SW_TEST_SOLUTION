; --------------------------------------------------------------------------------
; @Title: Simple SMP demo script for S32V232 on S32V234-EVB (RAM, SMP)
; @Description:
;   Loads the sieve demo application into RAM and sets up a demo debug scenario
;   on all cores.
;   Use this script for getting started.
;   As only the Cortex-M4 is started after reset, we start the first A53 using
;   the script. We handle the start of the secondary cores in the script and
;   switch to SMP later.
;   Prerequisites:
;    * Connect Debug Cable/Combiprobe to J17
;    * set Bootmode to SD-Card, remove SD-Card
; @Keywords: ARM, Cortex-A53, SMP
; @Author: AME
; @Board: S32V234-EVB
; @Chip: S32V232
; @Copyright: (C) 1989-2019 Lauterbach GmbH, licensed for use with TRACE32(R) only
; --------------------------------------------------------------------------------
; $Id: s32v232-evb-a53_sieve_smp_sram.cmm 16225 2020-06-25 14:27:47Z bschroefel $


WinCLEAR

; --------------------------------------------------------------------------------
; check prerequisites
IF SYStem.INSTANCE()>1.
(
  PRINT %ERROR "Please start this script in Non-AMP or AMP-Master mode."
  ENDDO
)

; --------------------------------------------------------------------------------
; initialize and start the debugger
RESet
SYStem.RESet
SYStem.CPU S32V232
SYStem.Option AHBHPROT 0x3
SYStem.Option EnReset OFF
SYStem.JtagClock CTCK 10MHz
CORE.ASSIGN 1.    ; select only master core 1 - 1. first core, 2. second core, 1. 2. first + second core (SMP) ...
ETM.OFF
Trace.DISable
SYStem.Mode Prepare

GOSUB DisableWatchdog
DO ~~~~/../../scripts/kick_cores "A53_1"

SYStem.Mode Attach
IF STATE.RUN()
  Break.direct

; --------------------------------------------------------------------------------
; kick secondary cores
DO ~~~~/../../scripts/kick_cores "A53_2"

; disconnect from system and reattach in SMP mode
SYStem.Mode.Down
CORE.ASSIGN 1. 2.
SYStem.Mode.Attach

IF STATE.RUN()
  Break.direct

GOSUB InitEcc

; --------------------------------------------------------------------------------
; load demo program (uses internal RAM only)
CORE.select 0.
Data.LOAD.Elf "~~~~/sieve_ram_aarch64_v8.elf"
; Set PC for all secondary cores
Register.Init /CORE 1.
Register.Set PC _start_secondary /CORE 1.

; --------------------------------------------------------------------------------
; start program execution
Go.direct main
WAIT !STATE.RUN()

; --------------------------------------------------------------------------------
; open some windows
WinCLEAR
Mode.Hll
WinPOS 0. 0.
List.auto
WinPOS 120. 0. 100. 8.
Frame.view
WinPOS 120. 14.
Var.Watch
Var.AddWatch %SpotLight ast flags
WinPOS 120. 25.
Register.view /SpotLight
WinPOS 0. 32.
Var.DRAW %DEFault sinewave

ENDDO

DisableWatchdog:
(
  ; use the AHB access port to disable the WDOG before the actual connection
  Data.Set EAHB:0x40086010 %Long 0xc520
  Data.Set EAHB:0x40086010 %Long 0xd928
  Data.Set EAHB:0x40086000 %Long Data.Long(EAHB:0x40086000)&~0x1
  Data.Set EAHB:0x40086000 %Long Data.Long(EAHB:0x40086000)|0x40
  RETURN
)

InitEcc:
(
  ; ECC init of SRAM with use eDMA TCD1
  Data.Set EAHB:0x40003020 %Long 0x6230
  Data.Set EAHB:0x40003024 %Long 0x03030000
  Data.Set EAHB:0x40003028 %Long 0x00400000
  Data.Set EAHB:0x40003030 %Long 0x3e800000
  Data.Set EAHB:0x40003034 %Long 0x00010008
  Data.Set EAHB:0x4000303C %Long 0x00010001
  WAIT (Data.Word(EAHB:0x4000303C)&0x0080)==0x0080
  RETURN
)

