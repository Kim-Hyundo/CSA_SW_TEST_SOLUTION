; --------------------------------------------------------------------------------
; @Title: Simple demo script for S32V232-CM4 on S32V232-EVB (RAM)
; @Description:
;   Loads the sieve demo application into RAM and sets up a demo debug
;   scenario.
;   Use this script for getting started.
;   Prerequisites:
;    * Connect Debug Cable/Combiprobe to J17
;    * set Bootmode to SD-Card, remove SD-Card
; @Keywords: ARM, Cortex-M4
; @Author: AME
; @Board: S32V234-EVB
; @Chip: S32V232
; @Copyright: (C) 1989-2019 Lauterbach GmbH, licensed for use with TRACE32(R) only
; --------------------------------------------------------------------------------
; $Id: s32v232-evb-cm4_sieve_sram.cmm 16225 2020-06-25 14:27:47Z bschroefel $


WinCLEAR

; --------------------------------------------------------------------------------
; initialize and start the debugger
RESet
SYStem.RESet
SYStem.CPU S32V232-CM4
SYStem.CONFIG.DEBUGPORTTYPE JTAG
IF hardware.COMBIPROBE()||hardware.UTRACE()
(
  SYStem.CONFIG.CONNECTOR MIPI20T
)
SYStem.Option AHBHPROT 0x3
SYStem.Option DUALPORT ON
SYStem.Option ResBreak OFF
SYStem.MemAccess DAP
SYStem.JtagClock CTCK 10MHz
; disable Trace infrastructure for the moment - TPIU may be unclocked!
ETM.OFF
Trace.DISable
SYStem.Up

GOSUB DisableWatchdog

; --------------------------------------------------------------------------------
; init ECC SRAM
Data.Set AD:0x3e000000++0x7fff %Long 0x0

; --------------------------------------------------------------------------------
; load demo program (uses internal RAM only)
Data.LOAD.Elf "~~~~/sieve_ram_thumb_ii_v7m.elf"

; --------------------------------------------------------------------------------
; start program execution
Go.direct main
WAIT !STATE.RUN()

; --------------------------------------------------------------------------------
; open some windows
WinCLEAR
Mode.Hll
WinPOS 0. 0.
List.auto
WinPOS 120. 0. 100. 8.
Frame.view
WinPOS 120. 14.
Var.Watch
Var.AddWatch %SpotLight ast flags
WinPOS 120. 25.
Register.view /SpotLight
WinPOS 0. 32.
Var.DRAW %DEFault sinewave

ENDDO

DisableWatchdog:
(
  Data.Set AD:0x40086010 %Long 0xc520
  Data.Set AD:0x40086010 %Long 0xd928
  Data.Set AD:0x40086000 %Long Data.Long(AD:0x40086000)&~0x1
  Data.Set AD:0x40086000 %Long Data.Long(AD:0x40086000)|0x40
  RETURN
)
