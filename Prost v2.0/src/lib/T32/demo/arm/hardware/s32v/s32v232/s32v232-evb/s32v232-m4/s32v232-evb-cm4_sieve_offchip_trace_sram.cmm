; --------------------------------------------------------------------------------
; @Title: Demo script for S32V232-CM4 on S32V234-EVB with Offchip-Trace (RAM)
; @Description:
;   Loads the sieve demo application into RAM and sets up a demo debug
;   scenario.
;   The Offchip Trace using a PowerTrace is set up.
;   Use this script for testing the Offchip-Trace.
;   Prerequisites:
;    * Connect Debug Cable/Combiprobe to J17
;    * Connect AutoFocus Preprocessor to J57
;    * set Bootmode to SD-Card, remove SD-Card
; @Keywords: ARM, Cortex-M4, ETM, ITM
; @Author: AME
; @Board: S32V234-EVB
; @Chip: S32V232
; @Copyright: (C) 1989-2019 Lauterbach GmbH, licensed for use with TRACE32(R) only
; --------------------------------------------------------------------------------
; $Id: s32v232-evb-cm4_sieve_offchip_trace_sram.cmm 16229 2020-06-26 07:10:40Z bschroefel $


WinCLEAR

; --------------------------------------------------------------------------------
; initialize and start the debugger
RESet
SYStem.RESet
SYStem.CPU S32V232-CM4
SYStem.CONFIG.DEBUGPORTTYPE JTAG
IF hardware.COMBIPROBE()||hardware.UTRACE()
(
  SYStem.CONFIG.CONNECTOR MIPI20T
)
SYStem.Option AHBHPROT 0x3
SYStem.Option DUALPORT ON
SYStem.Option ResBreak OFF
SYStem.MemAccess DAP
SYStem.JtagClock CTCK 10MHz
; disable Trace infrastructure for the moment - TPIU may be unclocked!
ETM.OFF
Trace.DISable
SYStem.Up

GOSUB DisableWatchdog

; --------------------------------------------------------------------------------
; init ECC SRAM
Data.Set AD:0x3e000000++0x7fff %Long 0x0

; --------------------------------------------------------------------------------
; initialize offchip-trace (ETM ON, ITM ON)
IF Analyzer()
(
  ; set PinMux and enable Clocks
  ; enable trace clock and select bus
  Data.set edbg:0x40000504 %LONG 0yxxxxxxxxxxxxxxxxxxxxx11xxxxxxxxx
  ; pinmux
  Data.Set EAHB:0x4006C3DC %Long 0x200701  ; PG7 ; clock
  Data.Set EAHB:0x4006C28C %Long 0x200702  ; PB3 ;control
  Data.Set EAHB:0x4006C3E0 %Long 0x200701  ; PG8
  Data.Set EAHB:0x4006C3E4 %Long 0x200701  ; PG9
  Data.Set EAHB:0x4006C3E8 %Long 0x200701  ; PG10
  Data.Set EAHB:0x4006C3EC %Long 0x200701  ; PG11
  Data.Set EAHB:0x4006C3F0 %Long 0x200701  ; PG12
  Data.Set EAHB:0x4006C3F4 %Long 0x200701  ; PG13
  Data.Set EAHB:0x4006C3F8 %Long 0x200701  ; PG14
  Data.Set EAHB:0x4006C3FC %Long 0x200701  ; PG15
  Data.Set EAHB:0x4006C400 %Long 0x200701  ; PH0
  Data.Set EAHB:0x4006C404 %Long 0x200701  ; PH1
  Data.Set EAHB:0x4006C408 %Long 0x200701  ; PH2
  Data.Set EAHB:0x4006C40C %Long 0x200701  ; PH3
  Data.Set EAHB:0x4006C410 %Long 0x200701  ; PH4
  Data.Set EAHB:0x4006C414 %Long 0x200701  ; PH5
  Data.Set EAHB:0x4006C418 %Long 0x200701  ; PH6
  Data.Set EAHB:0x4006C41C %Long 0x200701  ; PH7

  ; set TPIU to FIRC / 1
  Data.Set EAHB:0x40042880 %Long %LE 0x0
  ; Disable the Effect of SWO on TPIU
  Data.Set EAPB:0x80011EF0 %LE %Long 0x1
  Data.Set EAPB:0x80011F00 %LE %Long 0x1
  ; to select ARM_PLL do
  ; not used as ARM_PLL isn't running!
  ; set TPIU to ARM PLL / 1
  ; Data.Set AD:0x40042888 %Long %LE 0x800F0000
  ; Data.Set AD:0x40042880 %Long %LE 0x2000000
  ; WAIT 0.2s
  ; Data.Set AD:0x40042888 %Long %LE 0x80000000

  TPIU.PortSize 4
  TPIU.PortMode Continuous
  ITM.DataTrace CorrelatedData
  ITM.ON
  ETM.Trace ON
  ETM.ON
  Trace.METHOD Analyzer
  Trace.AutoInit ON
  Trace.AutoFocus
)

; --------------------------------------------------------------------------------
; load demo program (uses internal RAM only)
Data.LOAD.Elf "~~~~/sieve_ram_thumb_ii_v7m.elf"

; --------------------------------------------------------------------------------
; start program execution
Go.direct main
WAIT !STATE.RUN()

; --------------------------------------------------------------------------------
; setup ITM based datatrace of variable plot1
Var.Break.Set plot1 /Write /TraceData

; --------------------------------------------------------------------------------
; open some windows
WinCLEAR
Mode.Hll
WinPOS 0. 0.
List.auto
WinPOS 120. 0. 100. 8.
Frame.view
WinPOS 120. 14.
Var.Watch
Var.AddWatch %SpotLight ast flags
WinPOS 120. 25.
Trace.List
WinPOS 0. 32.
Trace.DRAW.Var %DEFault plot1

ENDDO

DisableWatchdog:
(
  Data.Set AD:0x40086010 %Long 0xc520
  Data.Set AD:0x40086010 %Long 0xd928
  Data.Set AD:0x40086000 %Long Data.Long(AD:0x40086000)&~0x1
  Data.Set AD:0x40086000 %Long Data.Long(AD:0x40086000)|0x40
  RETURN
)
