; --------------------------------------------------------------------------------
; @Title: Simple demo script for S32V234 on SBC-S32V (RAM)
; @Description:
;   Loads the sieve demo application into RAM and sets up a demo debug
;   scenario.
;   As only the Cortex-M4 is started after reset, we start the first A53 using
;   the script.
;   Use this script for getting started.
;   Prerequisites:
;    * Connect Debug Cable/Combiprobe to header JTAG using adapter LA-3770
;    * set Bootmode to SD-Card, switch BOOT[1]=OFF
;    * remove SD-Card (M4 will stop in BootROM)
; @Keywords: ARM, Cortex-A53
; @Author: AME
; @Board: miriac SBC-S32V
; @Chip: S32V234
; @Copyright: (C) 1989-2019 Lauterbach GmbH, licensed for use with TRACE32(R) only
; --------------------------------------------------------------------------------
; $Id: sbc-s32v-a53_sieve_sram.cmm 15576 2020-01-27 10:11:09Z alintner $


WinCLEAR

; --------------------------------------------------------------------------------
; check prerequisites
IF SYStem.INSTANCE()>1.
(
  PRINT %ERROR "Please start this script in Non-AMP or AMP-Master mode."
  ENDDO
)

; --------------------------------------------------------------------------------
; initialize and start the debugger
RESet
SYStem.RESet
SYStem.CPU S32V234
SYStem.Option AHBHPROT 0x3
SYStem.Option ResBreak OFF
SYStem.Option WaitReset 200ms
SYStem.JtagClock CTCK 10MHz
CORE.ASSIGN 1.
; disable Trace infrastructure for the moment - TPIU may be unclocked!
ETM.OFF
Trace.DISable
SYStem.Mode Prepare

GOSUB DisableWatchdog
; DO ~~/demo/arm64/hardware/s32v/s32v234/scripts/kick_cores
DO ~~~~/../../scripts/kick_cores "A53_1"

SYStem.Mode Attach
IF STATE.RUN()
  Break.direct

GOSUB InitEcc

; --------------------------------------------------------------------------------
; load demo program (uses internal RAM only)
Data.LOAD.Elf "~~~~/sieve_ram_aarch64_v8.elf"

; --------------------------------------------------------------------------------
; start program execution
Go.direct main
WAIT !STATE.RUN()

; --------------------------------------------------------------------------------
; open some windows
WinCLEAR
Mode.Hll
WinPOS 0. 0.
List.auto
WinPOS 120. 0. 100. 8.
Frame.view
WinPOS 120. 14.
Var.Watch
Var.AddWatch %SpotLight ast flags
WinPOS 120. 25.
Register.view /SpotLight
WinPOS 0. 32.
Var.DRAW %DEFault sinewave

ENDDO

DisableWatchdog:
(
  ; use the AHB access port to disable the WDOG before the actual connection
  Data.Set EAHB:0x40086010 %Long 0xc520
  Data.Set EAHB:0x40086010 %Long 0xd928
  Data.Set EAHB:0x40086000 %Long Data.Long(EAHB:0x40086000)&~0x1
  Data.Set EAHB:0x40086000 %Long Data.Long(EAHB:0x40086000)|0x40
  RETURN
)

InitEcc:
(
  ; ECC init of SRAM with use eDMA TCD1
  Data.Set EAHB:0x40003020 %Long 0x6230
  Data.Set EAHB:0x40003024 %Long 0x03030000
  Data.Set EAHB:0x40003028 %Long 0x00400000
  Data.Set EAHB:0x40003030 %Long 0x3e800000
  Data.Set EAHB:0x40003034 %Long 0x00010008
  Data.Set EAHB:0x4000303C %Long 0x00010001
  WAIT (Data.Word(EAHB:0x4000303C)&0x0080)==0x0080
  RETURN
)



