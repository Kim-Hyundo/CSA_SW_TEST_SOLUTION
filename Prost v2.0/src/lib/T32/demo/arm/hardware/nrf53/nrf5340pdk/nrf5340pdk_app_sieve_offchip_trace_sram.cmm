; --------------------------------------------------------------------------------
; @Title: Demo script for NRF5340QKAA-APP on NRF5340-PDK with Offchip-Trace (RAM)
; @Description:
;   Loads the sieve demo application into RAM and sets up a demo debug
;   scenario.
;   The Offchip Trace using a Combiprobe/uTrace or PowerTrace is set up.
;   Use this script for testing the Offchip-Trace.
;   Prerequisites:
;    * Connect Combiprobe/uTrace to P25
;      or
;      Connect AutoFocus Preprocessor to P25
;      and connect DebugCable to Preprocessor
; @Keywords: ARM, Cortex-M33, ETM, ITM
; @Author: BWR
; @Board: NRF5340-PDK
; @Chip: NRF5340QKAA
; @Copyright: (C) 1989-2020 Lauterbach GmbH, licensed for use with TRACE32(R) only
; --------------------------------------------------------------------------------
; $Id: nrf5340pdk_app_sieve_offchip_trace_sram.cmm 16418 2020-08-13 11:46:17Z bwright $


WinCLEAR

; --------------------------------------------------------------------------------
; initialize and start the debugger
RESet
SYStem.RESet
SYStem.CPU NRF5340QKAA-APP
SYStem.CONFIG.DEBUGPORTTYPE SWD
IF COMBIPROBE()||UTRACE()
(
  SYStem.CONFIG.CONNECTOR MIPI20T
)

; nReset is likely to be configured as GPIO - use SYSRESETREQ only
SYStem.Option EnReset OFF
SYStem.Option DUALPORT ON
SYStem.MemAccess DAP
SYStem.JtagClock CTCK 10MHz
SYStem.CONFIG.TPIU.ATBSource NONE  ; TODO(BWR): redundant after 124720
Trace.DISable
SYStem.Up

; --------------------------------------------------------------------------------
; load demo program (uses internal RAM only)
Data.LOAD.Elf "~~~~/application/sieve_ram_thumb_ii_v7m.elf"

; --------------------------------------------------------------------------------
; initialize OFFCHIP trace (ETM, ITM)
IF COMBIPROBE()||UTRACE()||Analyzer()
(
  PER.Set.simple AZSD:0xE0080500 %Long 0x00000001  ; Enable debug domain
  PER.Set.simple AZSD:0xE0080004 %Long 0x00000001  ; Start debug clock

  ; Allow trace through SPU firewall
  PER.Set.simple AZSD:0x500034C0 %Long 0yXXXXxxxxXXXXxxxxXXX00000XXXXxxxx

  ; Trace configuration: each pin mux set to debug with high-powered output
  PER.Set.simple AZSD:0x50842720 %Long 0x70000301  ; Configure pin  8 for trace
  PER.Set.simple AZSD:0x50842724 %Long 0x70000301  ; Configure pin  9 for trace
  PER.Set.simple AZSD:0x50842728 %Long 0x70000301  ; Configure pin 10 for trace
  PER.Set.simple AZSD:0x5084272C %Long 0x70000301  ; Configure pin 11 for trace
  PER.Set.simple AZSD:0x50842730 %Long 0x70000301  ; Configure pin 12 for trace

  PER.Set.simple AZSD:0xE0080504 %Long 0x0000000C  ; PSEL pin 12 as TRACE_CLK
  PER.Set.simple AZSD:0xE0080508 %Long 0x0000000B  ; PSEL pin 11 as TRACE_D0
  PER.Set.simple AZSD:0xE008050C %Long 0x0000000A  ; PSEL pin 10 as TRACE_D1
  PER.Set.simple AZSD:0xE0080510 %Long 0x00000009  ; PSEL pin  9 as TRACE_D2
  PER.Set.simple AZSD:0xE0080514 %Long 0x00000008  ; PSEL pin  8 as TRACE_D3

  PER.Set.simple AZSD:0xE0080518 %Long 0x00000002  ; Trace clock 8 MHz

  TPIU.PortSize 4
  TPIU.PortMode Continuous
  ITM.DataTrace CorrelatedData
  ITM.ON
  ETM.Trace ON
  ETM.COND ALL
  ETM.ON
)
IF Analyzer()
(
  Trace.METHOD Analyzer
  Trace.AutoInit ON
  IF CAnalyzer.FEATURE(TPIU.TERMINATION)
  (
    ; Pins have limited output current and low voltage, so disable termination
    Trace.TERMination OFF
  )
  Trace.AutoFocus
)
ELSE IF COMBIPROBE()||UTRACE()
(
  Trace.METHOD CAnalyzer
  Trace.AutoInit ON
  CAnalyzer.AutoFocus
)

; --------------------------------------------------------------------------------
; start program execution
Go.direct main
WAIT !STATE.RUN()

; --------------------------------------------------------------------------------
; setup ITM based datatrace of variable plot1
Var.Break.Set plot1 /Write /TraceData

; --------------------------------------------------------------------------------
; open some windows
WinCLEAR
Mode.Hll
WinPOS 0. 0. 116. 26.
List.auto
WinPOS 120. 0. 100. 8.
Frame.view
WinPOS 120. 14.
Var.Watch
Var.AddWatch %SpotLight ast flags
WinPOS 120. 25.
Trace.List
WinPOS 0. 32.
Trace.DRAW.Var %DEFault plot1

ENDDO
