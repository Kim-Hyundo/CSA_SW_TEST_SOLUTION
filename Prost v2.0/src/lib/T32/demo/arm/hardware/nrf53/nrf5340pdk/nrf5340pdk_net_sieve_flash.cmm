; --------------------------------------------------------------------------------
; @Title: Demo script for NRF5340QKAA-NET on NRF5340-PDK (FLASH)
; @Description:
;   Programs the sieve demo application into the processor internal flash and
;   sets up a demo debug scenario.
;   This script can be used as a template for flashing an application.
;   Prerequisites:
;    * Connect Debug Cable to P18/P25 using Adapter LA-3770
;      or
;      Connect Combiprobe/uTrace to P18/P25
; @Keywords: ARM, Cortex-M33, Flash
; @Author: BWR
; @Board: NRF5340-PDK
; @Chip: NRF5340QKAA
; @Copyright: (C) 1989-2020 Lauterbach GmbH, licensed for use with TRACE32(R) only
; --------------------------------------------------------------------------------
; $Id: nrf5340pdk_net_sieve_flash.cmm 16468 2020-08-28 17:56:41Z bwright $


WinCLEAR

; --------------------------------------------------------------------------------
; initialize and start the debugger using the application core
RESet
SYStem.RESet
SYStem.CPU NRF5340QKAA-APP  ; the app core controls reset for the net core
SYStem.CONFIG.DEBUGPORTTYPE SWD
IF COMBIPROBE()||UTRACE()
(
  SYStem.CONFIG.CONNECTOR MIPI20T
)
SYStem.Option.DUALPORT ON
SYStem.Option.EnReset OFF
SYStem.MemAccess DAP
SYStem.JtagClock 10MHz
ETM.OFF        ; network core does not have these trace mechanisms
ITM.OFF        ;  ^  ^
Trace.DISable  ;  ^  ^
SYStem.Mode.Prepare

; --------------------------------------------------------------------------------
; start and switch to the network core
PER.Set.simple AZSD:0x50005614 %Long 0x0
SYStem.CPU NRF5340QKAA-NET
SYStem.Attach
Break
SYStem.CONFIG Slave ON

; --------------------------------------------------------------------------------
; Flash programming

; prepare flash programming (declarations)
DO ~~/demo/arm/flash/nrf5340net.cmm PREPAREONLY

; ReProgram Flash
FLASH.ReProgram ALL
Data.LOAD.Elf "~~~~/network/sieve_flash_thumb_ii_v7m.elf"
FLASH.ReProgram OFF

; --------------------------------------------------------------------------------
; Reset the target again
SYStem.Up

; --------------------------------------------------------------------------------
; start program execution
Go.direct main
WAIT !STATE.RUN()

; --------------------------------------------------------------------------------
; open some windows
WinCLEAR
Mode.Hll
WinPOS 0. 0. 116. 26.
List.auto
WinPOS 120. 0. 100. 8.
Frame.view
WinPOS 120. 14.
Var.Watch
Var.AddWatch %SpotLight ast flags
WinPOS 120. 25.
Register.view /SpotLight
WinPOS 0. 32.
Var.DRAW %DEFault sinewave

ENDDO
