; --------------------------------------------------------------------------------
; @Title: Demo script for ATSAMDA1J16A (FLASH)
; @Description:
;   Programs the sieve demo application into the processor internal flash and
;   sets up a demo debug scenario.
;   This script can be used as a template for flashing an application.
;   Prerequisites:
;    * SWD Debug lines are connected
; @Keywords: ARM, Cortex-M0+, Flash
; @Author: AME
; @Board: -
; @Chip: ATSAMDA*
; @Copyright: (C) 1989-2019 Lauterbach GmbH, licensed for use with TRACE32(R) only
; --------------------------------------------------------------------------------
; $Id: atsamda1_sieve_flash.cmm 15217 2019-11-04 16:17:15Z bschroefel $


WinCLEAR

; --------------------------------------------------------------------------------
; initialize and start the debugger
RESet
SYStem.RESet
SYStem.CPU ATSAMDA1J16A
SYStem.CONFIG.DEBUGPORTTYPE SWD
IF hardware.COMBIPROBE()||hardware.UTRACE()
(
  SYStem.CONFIG.CONNECTOR MIPI20T
)
SYStem.Option DUALPORT ON
SYStem.MemAccess DAP
SYStem.JtagClock CTCK 10MHz
SYStem.Up

; --------------------------------------------------------------------------------
; Flash programming

; prepare flash programming (declarations)
DO ~~/demo/arm/flash/atsamd.cmm PREPAREONLY

; ReProgram Flash
FLASH.ReProgram ALL
Data.LOAD.Elf "~~~~/sieve_flash_thumb_v6m.elf"
FLASH.ReProgram OFF

; --------------------------------------------------------------------------------
; Reset the target again
SYStem.Up

; --------------------------------------------------------------------------------
; start program execution
Go.direct main
WAIT !STATE.RUN()

; --------------------------------------------------------------------------------
; open some windows
WinCLEAR
Mode.Hll
WinPOS 0. 0.
List.auto
WinPOS 120. 0. 100. 8.
Frame.view
WinPOS 120. 14.
Var.Watch
Var.AddWatch %SpotLight ast flags
WinPOS 120. 25.
Register.view /SpotLight
WinPOS 0. 32.
Var.DRAW %DEFault sinewave

ENDDO
