; --------------------------------------------------------------------------------
; @Title: Demo script for NRF52840QI on NRF52840-PDK with Offchip-Trace (RAM)
; @Description:
;   Loads the sieve demo application into RAM and sets up a demo debug
;   scenario.
;   The Offchip Trace using a Combiprobe/uTrace or PowerTrace is set up.
;   Use this script for testing the Offchip-Trace.
;   Prerequisites:
;    * Connect Combiprobe/uTrace to P25
;      or
;      Connect AutoFocus Preprocessor to P25 using adapter LA-3809
;      and connect DebugCable to Preprocessor
;    * set SW7 to Alt/Trace
; @Keywords: ARM, Cortex-M4, ETM, ITM
; @Author: AME
; @Board: NRF52840-PDK
; @Chip: NRF52840QI
; @Copyright: (C) 1989-2019 Lauterbach GmbH, licensed for use with TRACE32(R) only
; --------------------------------------------------------------------------------
; $Id: nrf52840-pdk_sieve_offchip_trace_sram.cmm 15217 2019-11-04 16:17:15Z bschroefel $


WinCLEAR

; --------------------------------------------------------------------------------
; initialize and start the debugger
RESet
SYStem.RESet
SYStem.CPU NRF52840QI
SYStem.CONFIG.DEBUGPORTTYPE SWD
IF COMBIPROBE()||UTRACE()
(
  SYStem.CONFIG.CONNECTOR MIPI20T
)
; nReset is likely to be configured as GPIO - use SYSRESETREQ only
SYStem.Option EnReset OFF
SYStem.Option DUALPORT ON
SYStem.MemAccess DAP
SYStem.JtagClock CTCK 10MHz
Trace.DISable
SYStem.Up

; --------------------------------------------------------------------------------
; load demo program (uses internal RAM only)
Data.LOAD.Elf "~~~~/sieve_ram_thumb_ii_v7m.elf"

; --------------------------------------------------------------------------------
; initialize OFFCHIP trace (ETM, ITM)
IF COMBIPROBE()||UTRACE()||Analyzer()
(
  ; set PinMux and enable Clocks
  ; CLOCK.TRACECONFIG.TRACEMUX = Parallel, 32MHz
  Data.Set AD:0x4000055C %Long 0x00020000
  ; TraceClk P0.07 - Output, H0D1
  Data.Set AD:0x5000071C %Long 0x00000303
  ; TraceData[0] P1.00 - Output, H0D1
  Data.Set AD:0x50000A00 %Long 0x00000303
  ; TraceData[1] P0.11 - Output, H0D1
  Data.Set AD:0x5000072C %Long 0x00000303
  ; TraceData[2] P0.12 - Output, H0D1
  Data.Set AD:0x50000730 %Long 0x00000303
  ; TraceData[3] P1.09 - Output, H0D1
  Data.Set AD:0x50000A24 %Long 0x00000303

  TPIU.PortSize 4
  TPIU.PortMode Continuous
  ITM.DataTrace CorrelatedData
  ITM.ON
  ETM.Trace ON
  ETM.ON
)
IF COMBIPROBE()||UTRACE()
(
  Trace.METHOD CAnalyzer
  Trace.AutoInit ON
  IF CAnalyzer.FEATURE(TPIU.TERMINATION)
  (
    ; pins have limited output current with low supply voltage -> disable Termination
    Trace.TERMination OFF
  )
  Trace.AutoFocus
)
IF Analyzer()
(
  Trace.METHOD Analyzer
  Trace.AutoInit ON
  Trace.AutoFocus
)

; --------------------------------------------------------------------------------
; start program execution
Go.direct main
WAIT !STATE.RUN()

; --------------------------------------------------------------------------------
; setup ITM based datatrace of variable plot1
Var.Break.Set plot1 /Write /TraceData

; --------------------------------------------------------------------------------
; open some windows
WinCLEAR
Mode.Hll
WinPOS 0. 0. 116. 26.
List.auto
WinPOS 120. 0. 100. 8.
Frame.view
WinPOS 120. 14.
Var.Watch
Var.AddWatch %SpotLight ast flags
WinPOS 120. 25.
Trace.List
WinPOS 0. 32.
Trace.DRAW.Var %DEFault plot1

ENDDO
