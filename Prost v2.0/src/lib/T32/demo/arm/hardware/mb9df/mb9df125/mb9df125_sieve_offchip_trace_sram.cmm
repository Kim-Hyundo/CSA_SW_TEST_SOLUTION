; --------------------------------------------------------------------------------
; @Title: Demo script for MB9DF125 with Offchip-Trace (RAM)
; @Description:
;   Loads the sieve demo application into RAM and sets up a demo debug
;   scenario.
;   The program flow is traced using the Offchip-Trace. Pinmuxing and Clock
;   setup is handled in the script.
;   Use this script to test the Offchip-Trace.
;   Prerequisites:
;    * Connect Debug Cable/Combiprobe
;    * Connect AutoFocus Preprocessor using Mictor38 cable
; @Keywords: ARM, Cortex-R4, ETM
; @Author: AME
; @Board: MB9DF125
; @Chip: MB9DF125
; @Copyright: (C) 1989-2019 Lauterbach GmbH, licensed for use with TRACE32(R) only
; --------------------------------------------------------------------------------
; $Id: mb9df125_sieve_offchip_trace_sram.cmm 15217 2019-11-04 16:17:15Z bschroefel $


WinCLEAR

; --------------------------------------------------------------------------------
; initialize and start the debugger
RESet
SYStem.RESet
SYStem.CPU MB9DF125
SYStem.Option ResBreak OFF
SYStem.Option WaitReset 2.ms
SYStem.MemAccess DAP
SYStem.JtagClock CTCK 10MHz
; manually force ONCHIP Breakpoints in FLASH (write buffer problem)
MAP.BOnchip 0x00800000++0x7fffff
MAP.BOnchip 0x01000000++0x7fffff
; fix RUNTIME memory accesses in TCM
IF VERSION.BUILD()<85819.
(
  SYStem.Option DAPREMAP 0x0++0x00FFFFFF 0x05000000
)
; --------------------------------------------------------------------------------
; connect and handle watchdog
; <timing critical>
SYStem.Up

&val=Data.Long(AD:0xB0608048)
IF (&val&0x01000000)==0
(
  ; disable watchdog
  Data.Set AD:0xB0608000 %Long 0xEDACCE55
  Data.Set AD:0xB0608048 %Long 0x01000000
)
ELSE IF (&val&0xb)==(0x1||0x2||0x3)
(
  ; watchdog already locked - bug DBGEN not set
  DIALOG.OK "Watchdog enabled BUT DBGEN not set!"
  STOP
)
; </timing critical>

; --------------------------------------------------------------------------------
; initialize ECC TCM SRAM
;Data.Set AD:0x0++0x1ffff %Long 0x0
Data.Set AD:0x0++0xbfff %Long 0x0

; --------------------------------------------------------------------------------
; load demo program (uses internal RAM only)
Data.LOAD.Elf "~~~~/sieve_ram_arm_v7r_le.elf"

; --------------------------------------------------------------------------------
; initialize OFFCHIP trace (ETM) if Analyzer is plugged
IF Analyzer()
(
  ; set PinMux and enable Clocks
  ; pin configuration: 0x7f=32bit, 0x6f=16bit, 0x67=8bit
  Data.Set APB:0x80009404 %Long 0x7f

  TPIU.PortSize 32
  TPIU.PortMode Continuous
  ETM.Trace ON
  ETM.ON
  Trace.METHOD Analyzer
  Trace.AutoFocus
)

; --------------------------------------------------------------------------------
; start program execution
Go.direct main
WAIT !STATE.RUN()

; --------------------------------------------------------------------------------
; open some windows
WinCLEAR
Mode.Hll
WinPOS 0. 0. 116. 26.
List.auto
WinPOS 120. 0. 100. 8.
Frame.view
WinPOS 120. 14.
Var.Watch
Var.AddWatch %SpotLight ast flags
WinPOS 120. 25.
Trace.List
WinPOS 0. 32.
Var.DRAW %DEFault sinewave
ENDDO

