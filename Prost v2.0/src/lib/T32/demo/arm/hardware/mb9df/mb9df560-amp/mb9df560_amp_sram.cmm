; --------------------------------------------------------------------------------
; @Title: AMP-Demo script for MB9DF566MAE (AMP, RAM)
; @Description:
;   Setup a AMP debug session using a single script approach. Loads the sieve
;   demo application into RAM and sets up a demo debug scenario.
;   Use this script to test the AMP-Debugging.
; @Keywords: ARM
; @Author: AME
; @Board: MB9D560 Evaluation Board
; @Chip: MB9DF56*
; @Copyright: (C) 1989-2019 Lauterbach GmbH, licensed for use with TRACE32(R) only
; --------------------------------------------------------------------------------
; $Id: mb9df560_amp_sram.cmm 15362 2019-12-03 14:50:48Z mschleinkofer $

PRIVATE &currPath &rclPort &remoteCmd
&currPath=OS.PPD()
&rclPort=FORMAT.DecimalU(1.,RCL.PORT(0))+"."

WinCLEAR

; Configure whether the watchdog reset shall be masked by a special debug register bit
&DBG_MASK_WDG_RESET=TRUE()
; Configure whether the Fake Power On mode shall be enabled by a special debug register bit
&DBG_ENABLE_FAKEPOWERON=FALSE()
; Configure whether the Fake Clock On mode shall be enabled by a special debug register bit
; and which value (0-3) should be used, refer SCSCU_CNTL_FAKE_CLKON description
&DBG_ENABLE_FAKECLOCKON=FALSE()
; 0..3
&DBG_FAKECLOCK_ON_SETTING=0x3
&DBG_FAKECLOCK_ON_SETTING=&DBG_FAKECLOCK_ON_SETTING&0x3

GOSUB DefineGlobals
; --------------------------------------------------------------------------------
; enable INTERCOM if not already specified and prepare related variables
IF (INTERCOM.PORT()==0)
(
  InterCom.ENable MASTER
)
&remoteCmd="InterCom.execute SLAVE1"

; --------------------------------------------------------------------------------
; close any existing REMOTE GUI
INTERCOM.execute OTHERS QUIT
; --------------------------------------------------------------------------------
; open SLAVE GUI with or without enabled remote API
IF (RCL.PORT(0)!=0)
(
  TargetSystem.NewInstance SLAVE1 /ARCHitecture ARM /ChipIndex 2. /APIPORT &rclPort+1. /ONCE
)
ELSE
(
  TargetSystem.NewInstance SLAVE1 /ARCHitecture ARM /ChipIndex 2. /ONCE
)

TITLE "TRACE32 for ARM - MB9DF566MQE-CORE0 - MASTER"
&remoteCmd TITLE "TRACE32 for ARM - MB9DF566MQE-CORE1 - SLAVE1"

; --------------------------------------------------------------------------------
; common SYStem settings
RESet
&remoteCmd RESet
SYStem.RESet
&remoteCmd SYStem.RESet
SYStem.CPU MB9DF566MQE
SYStem.CONFIG CORE 1. 1.
SYStem.CONFIG SLAVE OFF
CORE.ASSIGN 1.
&remoteCmd SYStem.CPU MB9DF566MQE
&remoteCmd SYStem.CONFIG CORE 2. 1.
&remoteCmd SYStem.CONFIG SLAVE ON

SYStem.Up

TrOnchip.Set RESET OFF
GOSUB DisableWatchdog

; --------------------------------------------------------------------------------
PRINT "Wait till device reaches BOOTROM end"
Go 0xFFFF0FAC /Onchip
WAIT !STATE.RUN() 0.5s
IF STATE.RUN()
  Break

GOSUB DisableWatchdog

; --------------------------------------------------------------------------------
; kick secondary cores
; Data.Set ....

; --------------------------------------------------------------------------------
; attach to all cores on all sessions
&remoteCmd CORE.ASSIGN 2.
&remoteCmd SYStem.Mode.Up

; --------------------------------------------------------------------------------
; initialize ECC SRAM
Data.Set 0x0--0x1ffff %Long 0x0
&remoteCmd Data.Set 0x0--0x1ffff %Long 0x0

; --------------------------------------------------------------------------------
; load demo program on all cores (use internal RAM only)
Data.LOAD.Elf ~~~~/master/sieve_ram_arm_v7r_le.elf
&remoteCmd ChDir &currPath
&remoteCmd Data.LOAD.Elf ./slave1/sieve_ram_arm_v7r_le.elf

; --------------------------------------------------------------------------------
; start program execution
Go.direct main\1
WAIT !STATE.RUN()
&remoteCmd Go.direct main\1
&remoteCmd WAIT !STATE.RUN()

; --------------------------------------------------------------------------------
; open some windows
WinCLEAR
Mode.Hll
WinPOS 0. 0.
List.auto
&remoteCmd WinCLEAR
&remoteCmd Mode.Hll
&remoteCmd WinPOS 0. 0.
&remoteCmd List.auto

ENDDO

DisableWatchdog:
(
  GOSUB SetSpecialDebugFeatures &DBG_MASK_WDG_RESET &DBG_ENABLE_FAKEPOWERON &DBG_ENABLE_FAKECLOCKON &DBG_FAKECLOCK_ON_SETTING
  RETURN
)

DefineGlobals: ;()
(
  GLOBAL &MASK__SCSCU_CNTL_JTAGCON
  GLOBAL &MASK__SCSCU_CNTL_FAKE_PDON
  GLOBAL &MASK__SCSCU_CNTL_WDGRSTMASK
  GLOBAL &KEY__SCCFG_UNLOCK
  GLOBAL &KEY__SCCFG_LOCK
  GLOBAL &REG_APB__SCCFG_UNLCK
  GLOBAL &REG_APB__SCSCU_CNTL
  &MASK__SCSCU_CNTL_JTAGCON=0x00010000
  &MASK__SCSCU_CNTL_FAKE_PDON=0x00000010
  &MASK__SCSCU_CNTL_WDGRSTMASK=0x00000100
  &KEY__SCCFG_UNLOCK=0x5ecacce5
  &KEY__SCCFG_LOCK=0xa135331a
  &REG_APB__SCCFG_UNLCK=0x000c01a4
  &REG_APB__SCSCU_CNTL=0x000c01b4

  GLOBAL &REG_AHB__SYSC0_PROTKEYR
  GLOBAL &REG_AHB__SYSC0_SPECFGR
  GLOBAL &MASK__SYSC0_SPECFGR_IOxRSTC
  GLOBAL &KEY__SYSC0_UNLOCK
  &REG_AHB__SYSC0_PROTKEYR=0xb0600000
  &REG_AHB__SYSC0_SPECFGR=0xb0600680
  &MASK__SYSC0_SPECFGR_IOxRSTC=0x00600000
  &KEY__SYSC0_UNLOCK=0x5cacce55
  RETURN
)

SetSpecialDebugFeatures: ;(wdogrstmask, fakepoweron, fakeclockon, fakeclockon_setting)
(
  PRIVATE &SCSCU_CNTL &wdogrstmask &fakepoweron &fakeclockon &fakeclockon_setting
  ENTRY &wdogrstmask &fakepoweron &fakeclockon &fakeclockon_setting
  &SCSCU_CNTL=&MASK__SCSCU_CNTL_JTAGCON
  IF &wdogrstmask
  (
    PRINT "SCSCU_CNTL: HW/SW Watchdog Reset Mask"
    &SCSCU_CNTL=&SCSCU_CNTL|&MASK__SCSCU_CNTL_WDGRSTMASK
  )
  IF &fakepoweron
  (
    PRINT "SCSCU_CNTL: Fake Power On Mode"
    &SCSCU_CNTL=&SCSCU_CNTL|&MASK__SCSCU_CNTL_FAKE_PDON
  )
  IF &fakeclockon
  (
    PRINT "SCSCU_CNTL: Fake Clock On Mode &fakeclockon_setting "
    &SCSCU_CNTL=&SCSCU_CNTL|(&fakeclockon_setting&0x3)
  )
  Data.Set APB:&REG_APB__SCCFG_UNLCK %Long &KEY__SCCFG_UNLOCK ; Unlock register write access
  Data.Set APB:&REG_APB__SCSCU_CNTL %Long &SCSCU_CNTL         ; Make user configuration (SCSCU_CNTL_JTAGCON bit and others)
  Data.Set APB:&REG_APB__SCCFG_UNLCK %Long &KEY__SCCFG_LOCK   ; Lock register write access again
  RETURN
)