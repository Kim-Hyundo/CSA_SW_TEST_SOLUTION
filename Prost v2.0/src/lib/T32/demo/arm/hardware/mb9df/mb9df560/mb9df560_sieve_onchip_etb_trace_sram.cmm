; --------------------------------------------------------------------------------
; @Title: Demo script for MB9DF566MAE with Onchip-Trace (RAM, ETB)
; @Description:
;   Loads the sieve demo application into RAM and sets up a demo debug
;   scenario.
;   The program flow is traced using the Onchip-Trace (ETB).
;   Prerequisites:
;    * Connect Debug Cable/Combiprobe to CN6
; @Keywords: ARM, Cortex-R5, ETB, ETM
; @Author: AME
; @Board: MB9D560 Evaluation Board
; @Chip: MB9DF56*
; @Copyright: (C) 1989-2019 Lauterbach GmbH, licensed for use with TRACE32(R) only
; --------------------------------------------------------------------------------
; $Id: mb9df560_sieve_onchip_etb_trace_sram.cmm 15223 2019-11-05 16:29:45Z bschroefel $


WinCLEAR

; Configure whether the watchdog reset shall be masked by a special debug register bit
&DBG_MASK_WDG_RESET=TRUE()
; Configure whether the Fake Power On mode shall be enabled by a special debug register bit
&DBG_ENABLE_FAKEPOWERON=FALSE()
; Configure whether the Fake Clock On mode shall be enabled by a special debug register bit
; and which value (0-3) should be used, refer SCSCU_CNTL_FAKE_CLKON description
&DBG_ENABLE_FAKECLOCKON=FALSE()
; 0..3
&DBG_FAKECLOCK_ON_SETTING=0x3
&DBG_FAKECLOCK_ON_SETTING=&DBG_FAKECLOCK_ON_SETTING&0x3

GOSUB DefineGlobals
; --------------------------------------------------------------------------------
; initialize and start the debugger
RESet
SYStem.RESet
SYStem.CPU MB9DF566MAE
SYStem.MemAccess DAP
SYStem.JtagClock CTCK 10MHz
CORE.ASSIGN 1.
SYStem.Up

TrOnchip.Set RESET OFF
GOSUB DisableWatchdog

; --------------------------------------------------------------------------------
PRINT "Wait till device reaches BOOTROM end"
Go 0xFFFF0FAC /Onchip
WAIT !STATE.RUN() 0.5s
IF STATE.RUN()
  Break

GOSUB DisableWatchdog

; --------------------------------------------------------------------------------
; initialize ECC SRAM
Data.Set 0x0--0x1ffff %Long 0x0

; --------------------------------------------------------------------------------
; initialize offchip-trace (ETM ON)
Trace.METHOD Onchip
ETM.Trace ON
ETM.ON

; --------------------------------------------------------------------------------
; load demo program (uses internal RAM only)
Data.LOAD.Elf "~~~~/sieve_ram_arm_v7r_le.elf"

; --------------------------------------------------------------------------------
; start program execution
Go.direct main
WAIT !STATE.RUN()

; --------------------------------------------------------------------------------
; open some windows
WinCLEAR
Mode.Hll
WinPOS 0. 0.
List.auto
WinPOS 120. 0. 100. 8.
Frame.view
WinPOS 120. 14.
Var.Watch
Var.AddWatch %SpotLight ast flags
WinPOS 120. 25.
Trace.List
WinPOS 0. 32.
Var.DRAW %DEFault sinewave
ENDDO

DisableWatchdog:
(
  GOSUB SetSpecialDebugFeatures &DBG_MASK_WDG_RESET &DBG_ENABLE_FAKEPOWERON &DBG_ENABLE_FAKECLOCKON &DBG_FAKECLOCK_ON_SETTING
  RETURN
)

DefineGlobals: ;()
(
  GLOBAL &MASK__SCSCU_CNTL_JTAGCON
  GLOBAL &MASK__SCSCU_CNTL_FAKE_PDON
  GLOBAL &MASK__SCSCU_CNTL_WDGRSTMASK
  GLOBAL &KEY__SCCFG_UNLOCK
  GLOBAL &KEY__SCCFG_LOCK
  GLOBAL &REG_APB__SCCFG_UNLCK
  GLOBAL &REG_APB__SCSCU_CNTL
  &MASK__SCSCU_CNTL_JTAGCON=0x00010000
  &MASK__SCSCU_CNTL_FAKE_PDON=0x00000010
  &MASK__SCSCU_CNTL_WDGRSTMASK=0x00000100
  &KEY__SCCFG_UNLOCK=0x5ecacce5
  &KEY__SCCFG_LOCK=0xa135331a
  &REG_APB__SCCFG_UNLCK=0x000c01a4
  &REG_APB__SCSCU_CNTL=0x000c01b4

  GLOBAL &REG_AHB__SYSC0_PROTKEYR
  GLOBAL &REG_AHB__SYSC0_SPECFGR
  GLOBAL &MASK__SYSC0_SPECFGR_IOxRSTC
  GLOBAL &KEY__SYSC0_UNLOCK
  &REG_AHB__SYSC0_PROTKEYR=0xb0600000
  &REG_AHB__SYSC0_SPECFGR=0xb0600680
  &MASK__SYSC0_SPECFGR_IOxRSTC=0x00600000
  &KEY__SYSC0_UNLOCK=0x5cacce55
  RETURN
)

SetSpecialDebugFeatures: ;(wdogrstmask, fakepoweron, fakeclockon, fakeclockon_setting)
(
  PRIVATE &SCSCU_CNTL &wdogrstmask &fakepoweron &fakeclockon &fakeclockon_setting
  ENTRY &wdogrstmask &fakepoweron &fakeclockon &fakeclockon_setting
  &SCSCU_CNTL=&MASK__SCSCU_CNTL_JTAGCON
  IF &wdogrstmask
  (
    PRINT "SCSCU_CNTL: HW/SW Watchdog Reset Mask"
    &SCSCU_CNTL=&SCSCU_CNTL|&MASK__SCSCU_CNTL_WDGRSTMASK
  )
  IF &fakepoweron
  (
    PRINT "SCSCU_CNTL: Fake Power On Mode"
    &SCSCU_CNTL=&SCSCU_CNTL|&MASK__SCSCU_CNTL_FAKE_PDON
  )
  IF &fakeclockon
  (
    PRINT "SCSCU_CNTL: Fake Clock On Mode &fakeclockon_setting "
    &SCSCU_CNTL=&SCSCU_CNTL|(&fakeclockon_setting&0x3)
  )
  Data.Set APB:&REG_APB__SCCFG_UNLCK %Long &KEY__SCCFG_UNLOCK ; Unlock register write access
  Data.Set APB:&REG_APB__SCSCU_CNTL %Long &SCSCU_CNTL         ; Make user configuration (SCSCU_CNTL_JTAGCON bit and others)
  Data.Set APB:&REG_APB__SCCFG_UNLCK %Long &KEY__SCCFG_LOCK   ; Lock register write access again
  RETURN
)