; --------------------------------------------------------------------------------
; @Title: Example script file for ARM Integrator CM1136JF-S
; @Description:
;   Example script file for ARM Integrator CM1136JF-S
; @Author: PEG
; @Board: Innovator CM1136JF-S
; @Chip: ARM1136JF-S
; @Copyright: (C) 1989-2019 Lauterbach GmbH, licensed for use with TRACE32(R) only
; --------------------------------------------------------------------------------
; $Id: demo.cmm 15217 2019-11-04 16:17:15Z bschroefel $

;   07.01.04, PEG

; The following settings assume that jumper J7 (CFGEN) is removed.

; start-up debugger
  SYStem.CPU ARM1136JF
  SYStem.Option ResBreak OFF
; deprecated   SYStem.MultiCore IRPRE     4
; deprecated   SYStem.MultiCore DRPRE     1
; deprecated   SYStem.MultiCore ETBIRPOST 5
; deprecated   SYStem.MultiCore ETBDRPOST 1
  SYStem.CONFIG IRPRE     4
  SYStem.CONFIG DRPRE     1
  SYStem.CONFIG ETBIRPOST 5
  SYStem.CONFIG ETBDRPOST 1
  SYStem.Up

; load demo application
  Data.LOAD.AIF ~~~~/armla.axf
  Data.Assemble 0 b 2078
  Register.Set R13 0x1000

; open some windows
  WinCLEAR
  WinPOS 0% 0% 100% 50%
  List.auto
  WinPOS 0% 50% 50% 50%
  Frame /Locals /Caller
  WinPOS 50% 50% 50% 50%
  Var.Watch
  Var.AddWatch ast; flags;

  ENDDO
