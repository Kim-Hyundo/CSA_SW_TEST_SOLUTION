; --------------------------------------------------------------------------------
; @Title: Simple demo script for AR1443 on AR1443EVM (RAM)
; @Description:
;   Loads the sieve demo application into RAM and sets up a demo debug
;   scenario.
;   Use this script for getting started.
;   Prerequisites:
;    * Connect Debug Cable/Combiprobe to 14-PIN_JTAG_CONN on AR1xxxEVM-012
;      using adapter LA-
;    * Connect PowerSupply to AR1443EVM-010 and AR1xxxEVM-012
; @Keywords: ARM, Cortex-R4, AR1443
; @Author: AME
; @Board: AR1443EVM
; @Chip: AWR1443
; @Copyright: (C) 1989-2019 Lauterbach GmbH, licensed for use with TRACE32(R) only
; --------------------------------------------------------------------------------
; $Id: ar1443evm_sieve_sram.cmm 15217 2019-11-04 16:17:15Z bschroefel $


WinCLEAR

; --------------------------------------------------------------------------------
; initialize and start the debugger
RESet
SYStem.RESet
SYStem.CPU AR1443
SYStem.MemAccess DAP
SYStem.JtagClock CTCK 10MHz
SYStem.Up

; try to cleanup the cores state - Supervisor, MPU off
Register.Init
Data.Set C15:0x1 %Long 0xE70878

; --------------------------------------------------------------------------------
; load demo program (uses internal RAM only)
Data.LOAD.Elf "~~~~/sieve_ram_arm_v7r_le.elf"

; --------------------------------------------------------------------------------
; start program execution
Go.direct main
WAIT !STATE.RUN()

; --------------------------------------------------------------------------------
; open some windows
WinCLEAR
Mode.Hll
WinPOS 0. 0. 116. 26.
List.auto
WinPOS 120. 0. 100. 8.
Frame.view
WinPOS 120. 14.
Var.Watch
Var.AddWatch %SpotLight ast flags
WinPOS 120. 25.
Register.view /SpotLight
WinPOS 0. 32.
Var.DRAW %DEFault sinewave
ENDDO
