; --------------------------------------------------------------------------------
; @Title: Demo script for CY8C6347BZI-BLD53 CortexM4 (FLASH)
; @Description:
;   Please flash using the M0+ core.
; @Keywords: ARM, Cortex-M4, Flash
; @Author: AME
; @Board: CY8CKIT-062-BLE, PSoC6 BLE Pioneer Kit
; @Chip: CY8C6*-BLD* CY8C6*-D*
; @Copyright: (C) 1989-2019 Lauterbach GmbH, licensed for use with TRACE32(R) only
; --------------------------------------------------------------------------------
; $Id: psoc6dual-m4_sieve_flash.cmm 15217 2019-11-04 16:17:15Z bschroefel $

DIALOG.OK "Please flash using the M0+ core."

ENDDO