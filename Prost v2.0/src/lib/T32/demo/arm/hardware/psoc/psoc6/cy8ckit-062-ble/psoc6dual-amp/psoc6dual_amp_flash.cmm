; --------------------------------------------------------------------------------
; @Title: AMP-Demo script for CY8C6347BZI-BLD53 (AMP, FLASH)
; @Description:
;   Setup a AMP debug session using a single script approach.
;   Loads the sieve demo application into FLASH and sets up a demo debug
;   scenario.
;   Use this script to test the AMP-Debugging and Flash Programming.
;   Prerequisites:
;    * Connect Debug Cable/Combiprobe to P6 using LA-3770
;    * TRACE32 is started using the .bat/.sh file in this directory
; @Keywords: ARM, PSOC6
; @Author: AME
; @Board: CY8CKIT-062-BLE, PSoC6 BLE Pioneer Kit
; @Chip: CY8C6*-BLD* CY8C6*-D*
; @Copyright: (C) 1989-2019 Lauterbach GmbH, licensed for use with TRACE32(R) only
; --------------------------------------------------------------------------------
; $Id: psoc6dual_amp_flash.cmm 15362 2019-12-03 14:50:48Z mschleinkofer $

PRIVATE &currPath &rclPort &remoteCmd
&currPath=OS.PPD()
&rclPort=FORMAT.DecimalU(1.,RCL.PORT(0))+"."

WinCLEAR

; --------------------------------------------------------------------------------
; check prerequisites
IF SYStem.INSTANCE()<1.
(
  PRINT %ERROR "TRACE32 is not running in AMP mode! Use .bat/.sh file in this directory."
  ENDDO
)

; --------------------------------------------------------------------------------
; enable INTERCOM if not already specified and prepare related variables
IF (INTERCOM.PORT()==0)
(
  InterCom.ENable CM0
)
&remoteCmd="InterCom.execute CM4"

; --------------------------------------------------------------------------------
; close any existing REMOTE GUI
INTERCOM.execute OTHERS QUIT
; --------------------------------------------------------------------------------
; open SLAVE GUI with or without enabled remote API
IF (RCL.PORT(0)!=0)
(
  TargetSystem.NewInstance CM4 /ARCHitecture ARM /ChipIndex 2. /APIPORT &rclPort+1. /ONCE
)
ELSE
(
  TargetSystem.NewInstance CM4 /ARCHitecture ARM /ChipIndex 2. /ONCE
)

; --------------------------------------------------------------------------------
; set titles for SLAVE GUIs
TITLE "TRACE32 for ARM - CY8C6347BZI-BLD53-M0+ - MASTER"
&remoteCmd TITLE "TRACE32 for ARM - CY8C6347BZI-BLD53-M4 - SLAVE1"

; --------------------------------------------------------------------------------
; common SYStem settings
RESet
&remoteCmd RESet
SYStem.RESet
&remoteCmd SYStem.RESet
SYStem.CPU CY8C6347BZI-BLD53-M0+
SYStem.CONFIG CORE 1. 1.
SYStem.CONFIG SLAVE OFF
SYStem.CONFIG DEBUGPORTTYPE SWD
IF hardware.COMBIPROBE()||hardware.UTRACE()
(
  SYStem.CONFIG.CONNECTOR MIPI20T
)
&remoteCmd SYStem.CPU CY8C6347BZI-BLD53-M4
&remoteCmd SYStem.CONFIG CORE 2. 1.
&remoteCmd SYStem.CONFIG SLAVE ON
&remoteCmd SYStem.CONFIG DEBUGPORTTYPE SWD
IF hardware.COMBIPROBE()||hardware.UTRACE()
(
  &remoteCmd SYStem.CONFIG.CONNECTOR MIPI20T
)

; disable Trace for connection phase
Trace.DISable
&remoteCmd Trace.DISable

SYStem.Up

GOSUB WatchdogDisable

; DO ~~/demo/arm/hardware/psoc/psoc6/scripts/disable_m4
DO ~~~~/../../scripts/disable_m4

; --------------------------------------------------------------------------------
; Flash programming

; prepare flash programming (declarations)
DO ~~/demo/arm/flash/psoc6 PREPAREONLY

; ReProgram Flash - load M0+ and M4 code
FLASH.ReProgram ALL
Data.LOAD.Elf ~~~~/master/sieve_flash_thumb_v6m.elf
Data.LOAD.Elf ~~~~/slave1/sieve_flash_thumb_ii_v7m.elf /NosYmbol
FLASH.ReProgram OFF

; --------------------------------------------------------------------------------
; Reset the target again
SYStem.Up
IF Register(PC)>=0x16000000
(
  ; we stopped in the BootROM/Supervisory Flash
  ; Ensure VectorCatch on CORERESET is activated and boot into lower BootROM
  TrOnchip.Set CORERESET ON
  Go
  WAIT !STATE.RUN()
)
; --------------------------------------------------------------------------------
; attach to secondary core
&remoteCmd SYStem.Mode.Attach

GOSUB WatchdogDisable

; --------------------------------------------------------------------------------
; let the code kick the secondary core
Go enable_m4_finished
WAIT !STATE.RUN()

&remoteCmd WAIT !STATE.RUN()

; --------------------------------------------------------------------------------
; load debug symbols only
Data.LOAD.Elf ~~~~/master/sieve_flash_thumb_v6m.elf /NoCODE
&remoteCmd ChDir &currPath
&remoteCmd Data.LOAD.Elf ./slave1/sieve_flash_thumb_ii_v7m.elf /NoCODE

; --------------------------------------------------------------------------------
; start program execution
Go main\8
WAIT !STATE.RUN()
&remoteCmd Go.direct main\8
&remoteCmd WAIT !STATE.RUN()

; --------------------------------------------------------------------------------
; open some windows
WinCLEAR
Mode.Hll
WinPOS 0. 0. 116. 26.
List.auto
&remoteCmd WinCLEAR
&remoteCmd Mode.Hll
&remoteCmd WinPOS 0. 0. 116. 26.
&remoteCmd List.auto

ENDDO

WatchdogDisable: ;()
(
  ; Unlock and disable WDT
  ; SRSS->WDT_CTL = ((SRSS->WDT_CTL & (uint32_t)(~SRSS_WDT_CTL_WDT_LOCK_Msk)) | CY_WDT_LOCK_BIT0);
  ; SRSS->WDT_CTL = (SRSS->WDT_CTL | CY_WDT_LOCK_BIT1);
  ; SRSS->WDT_CTL &= (~ (uint32_t) SRSS_WDT_CTL_WDT_EN_Msk);

  Data.Set A:0x40260180 %Long (Data.Long(A:0x40260180)&~0xC0000000)|0x40000000
  Data.Set A:0x40260180 %Long Data.Long(A:0x40260180)|0x80000000
  Data.Set A:0x40260180 %Long Data.Long(A:0x40260180)&~0x1
  RETURN
)