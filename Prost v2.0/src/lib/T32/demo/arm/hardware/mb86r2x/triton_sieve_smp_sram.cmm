; --------------------------------------------------------------------------------
; @Title: Simple SMP demo script for MB86R24 (RAM, SMP)
; @Description:
;   Loads the sieve demo application into RAM and sets up a demo debug scenario
;   on all cores.
;   Use this script for getting started.
;   Prerequisites:
;    * Connect Debug Cable/Combiprobe to J1 using adapter LA-3722
;    * Set Bootmode: NOR-Flash
;        SW4[6]=0y0        - SELFL=0y0
;        SW4[3..1] = 0y100 - MPXMODE[2..0]=0y100
;    * Set SW4[7] = 0y0 (ARM DAP)
;    * Set SW4[5] = 0y0 (TESTMODE=0)
; @Keywords: ARM, Cortex-A9, SMP
; @Author: AME
; @Board: TRITON-C Promotion Board
; @Chip: MB86R24
; @Copyright: (C) 1989-2019 Lauterbach GmbH, licensed for use with TRACE32(R) only
; --------------------------------------------------------------------------------
; $Id: triton_sieve_smp_sram.cmm 15217 2019-11-04 16:17:15Z bschroefel $


WinCLEAR

; --------------------------------------------------------------------------------
; initialize and start the debugger
RESet
SYStem.RESet
SYStem.CPU MB86R24
SYStem.JtagClock CTCK 10MHz
;CORE.ASSIGN 1. 2.
SYStem.Up

; --------------------------------------------------------------------------------
; load demo program (uses internal RAM only)
CORE.select 0.
Data.LOAD.Elf "~~~~/sieve_ram_arm_v7.elf"
; Set PC for all secondary cores
Register.Set T 0 /CORE 1.
Register.Set PC _start /CORE 1.

; --------------------------------------------------------------------------------
; start program execution
Go.direct main
WAIT !STATE.RUN()

; --------------------------------------------------------------------------------
; open some windows
WinCLEAR
Mode.Hll
WinPOS 0. 0.
List.auto
WinPOS 120. 0. 100. 8.
Frame.view
WinPOS 120. 14.
Var.Watch
Var.AddWatch %SpotLight ast flags
WinPOS 120. 25.
Register.view /SpotLight
WinPOS 0. 32.
Var.DRAW %DEFault sinewave

ENDDO
