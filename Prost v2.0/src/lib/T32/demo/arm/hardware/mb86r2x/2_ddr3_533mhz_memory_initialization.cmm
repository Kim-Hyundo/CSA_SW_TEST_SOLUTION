; --------------------------------------------------------------------------------
; @Title: Chip initialization for MB86R24 on TritonC
; @Description:
;   converted from 2_DDR3_533MHz_MemoryInitialization.par
;   not tested successfully - left as reference
; @Props: NoMetaTags NoErrors
; @Author: converted by AME
; @Board: TRITON-C Promotion Board
; @Chip: MB86R24
; --------------------------------------------------------------------------------
; $Id: 2_ddr3_533mhz_memory_initialization.cmm 10197 2016-11-22 16:28:01Z amerkle $

; MB86R24
; TritonC

;;;;;;;;;;;;
;DDR Bank 0;
;;;;;;;;;;;;
Data.Set AD:0x38400800 %Long 0x00000001                    ;mId:-;                   ;rId:User Defined Element;
Data.Set AD:0x38400804 %Long 0x0000000F                    ;mId:-;                   ;rId:User Defined Element;
Data.Set AD:0x38400808 %Long 0x00000000                    ;mId:-;                   ;rId:User Defined Element;
Data.Set AD:0x3840080C %Long 0x00000000                    ;mId:-;                   ;rId:User Defined Element;
Data.Set AD:0x38400810 %Long 0x00000000                    ;mId:-;                   ;rId:User Defined Element;
Data.Set AD:0x38400814 %Long 0x00000000                    ;mId:-;                   ;rId:User Defined Element;
Data.Set AD:0x38400818 %Long 0x00000000                    ;mId:-;                   ;rId:User Defined Element;
Data.Set AD:0x3840081C %Long 0x0000000F                    ;mId:-;                   ;rId:User Defined Element;
Data.Set AD:0x38400820 %Long 0x00000000                    ;mId:-;                   ;rId:User Defined Element;
Data.Set AD:0x38400824 %Long 0x00000000                    ;mId:-;                   ;rId:User Defined Element;
Data.Set AD:0x38400828 %Long 0x00000000                    ;mId:-;                   ;rId:User Defined Element;
Data.Set AD:0x3840082C %Long 0x55020001                    ;mId:-;                   ;rId:User Defined Element;
Data.Set AD:0x38400830 %Long 0x03C92222                    ;mId:-;                   ;rId:User Defined Element;
Data.Set AD:0x38400834 %Long 0x08080808                    ;mId:-;                   ;rId:User Defined Element;
Data.Set AD:0x38400838 %Long 0x0000AA00                    ;mId:-;                   ;rId:User Defined Element;
Data.Set AD:0x3840083C %Long 0x000F2008                    ;mId:-;                   ;rId:User Defined Element;
Data.Set AD:0x38400840 %Long 0x000F2008                    ;mId:-;                   ;rId:User Defined Element;
Data.Set AD:0x38400844 %Long 0x000F2508                    ;mId:-;                   ;rId:User Defined Element;
Data.Set AD:0x38400848 %Long 0x000F2508                    ;mId:-;                   ;rId:User Defined Element;
Data.Set AD:0x3840084C %Long 0x00000000                    ;mId:-;                   ;rId:User Defined Element;
Data.Set AD:0x38400850 %Long 0x00000001                    ;mId:-;                   ;rId:User Defined Element;

Data.Set AD:0x38400000 %Long 0x00000600                    ;mId:-;                   ;rId:User Defined Element;
Data.Set AD:0x38400004 %Long 0x00000000                    ;mId:-;                   ;rId:User Defined Element;
Data.Set AD:0x38400008 %Long 0x00000006                    ;mId:-;                   ;rId:User Defined Element;
Data.Set AD:0x3840000C %Long 0x0001A0AB                    ;mId:-;                   ;rId:User Defined Element;
Data.Set AD:0x38400010 %Long 0x000411AB                    ;mId:-;                   ;rId:User Defined Element;
Data.Set AD:0x38400014 %Long 0x00000000                    ;mId:-;                   ;rId:User Defined Element;
Data.Set AD:0x38400018 %Long 0x0E000200                    ;mId:-;                   ;rId:User Defined Element;
Data.Set AD:0x3840001C %Long 0x06040406                    ;mId:-;                   ;rId:User Defined Element;
Data.Set AD:0x38400020 %Long 0x0704141B                    ;mId:-;                   ;rId:User Defined Element;
Data.Set AD:0x38400024 %Long 0x0C04041B                    ;mId:-;                   ;rId:User Defined Element;
Data.Set AD:0x38400028 %Long 0x03009240                    ;mId:-;                   ;rId:User Defined Element;
Data.Set AD:0x3840002C %Long 0x08070004                    ;mId:-;                   ;rId:User Defined Element;
Data.Set AD:0x38400030 %Long 0x0F010100                    ;mId:-;                   ;rId:User Defined Element;
Data.Set AD:0x38400034 %Long 0x00000703                    ;mId:-;                   ;rId:User Defined Element;
Data.Set AD:0x38400038 %Long 0x00010100                    ;mId:-;                   ;rId:User Defined Element;
Data.Set AD:0x3840003C %Long 0x10400056                    ;mId:-;                   ;rId:User Defined Element;
Data.Set AD:0x38400040 %Long 0x00000000                    ;mId:-;                   ;rId:User Defined Element;
Data.Set AD:0x38400044 %Long 0x000D0004                    ;mId:-;                   ;rId:User Defined Element;
Data.Set AD:0x38400048 %Long 0x005B01F9                    ;mId:-;                   ;rId:User Defined Element;
Data.Set AD:0x3840004C %Long 0x00000000                    ;mId:-;                   ;rId:User Defined Element;
Data.Set AD:0x38400050 %Long 0x00000000                    ;mId:-;                   ;rId:User Defined Element;
Data.Set AD:0x38400054 %Long 0x00000000                    ;mId:-;                   ;rId:User Defined Element;
Data.Set AD:0x38400058 %Long 0x00083000                    ;mId:-;                   ;rId:User Defined Element;
Data.Set AD:0x3840005C %Long 0x00080006                    ;mId:-;                   ;rId:User Defined Element;
Data.Set AD:0x38400060 %Long 0x00000000                    ;mId:-;                   ;rId:User Defined Element;
Data.Set AD:0x38400064 %Long 0x00000000                    ;mId:-;                   ;rId:User Defined Element;
Data.Set AD:0x38400068 %Long 0x00000000                    ;mId:-;                   ;rId:User Defined Element;
Data.Set AD:0x3840006C %Long 0x00000000                    ;mId:-;                   ;rId:User Defined Element;
Data.Set AD:0x38400070 %Long 0x00000000                    ;mId:-;                   ;rId:User Defined Element;
Data.Set AD:0x38400074 %Long 0x00000000                    ;mId:-;                   ;rId:User Defined Element;
Data.Set AD:0x38400078 %Long 0x00000000                    ;mId:-;                   ;rId:User Defined Element;
Data.Set AD:0x3840007C %Long 0x00000000                    ;mId:-;                   ;rId:User Defined Element;
Data.Set AD:0x38400080 %Long 0x02000000                    ;mId:-;                   ;rId:User Defined Element;
Data.Set AD:0x38400084 %Long 0x00400100                    ;mId:-;                   ;rId:User Defined Element;
Data.Set AD:0x38400088 %Long 0x00000200                    ;mId:-;                   ;rId:User Defined Element;
Data.Set AD:0x3840008C %Long 0x00000040                    ;mId:-;                   ;rId:User Defined Element;
Data.Set AD:0x38400090 %Long 0x02000000                    ;mId:-;                   ;rId:User Defined Element;
Data.Set AD:0x38400094 %Long 0xFFFF0A01                    ;mId:-;                   ;rId:User Defined Element;
Data.Set AD:0x38400098 %Long 0x01010101                    ;mId:-;                   ;rId:User Defined Element;
Data.Set AD:0x3840009C %Long 0x00000101                    ;mId:-;                   ;rId:User Defined Element;
Data.Set AD:0x384000A0 %Long 0x00010003                    ;mId:-;                   ;rId:User Defined Element;
Data.Set AD:0x384000A4 %Long 0x000C0000                    ;mId:-;                   ;rId:User Defined Element;
Data.Set AD:0x384000A8 %Long 0x00000000                    ;mId:-;                   ;rId:User Defined Element;
Data.Set AD:0x384000AC %Long 0x00000001                    ;mId:-;                   ;rId:User Defined Element;
Data.Set AD:0x384000B0 %Long 0x00000000                    ;mId:-;                   ;rId:User Defined Element;
Data.Set AD:0x384000B4 %Long 0x000027C9                    ;mId:-;                   ;rId:User Defined Element;
Data.Set AD:0x384000B8 %Long 0x00000000                    ;mId:-;                   ;rId:User Defined Element;
Data.Set AD:0x384000BC %Long 0x00000000                    ;mId:-;                   ;rId:User Defined Element;
Data.Set AD:0x384000C0 %Long 0x00000000                    ;mId:-;                   ;rId:User Defined Element;
Data.Set AD:0x384000C4 %Long 0x00000000                    ;mId:-;                   ;rId:User Defined Element;
Data.Set AD:0x384000C8 %Long 0x00000000                    ;mId:-;                   ;rId:User Defined Element;
Data.Set AD:0x384000CC %Long 0x00000000                    ;mId:-;                   ;rId:User Defined Element;
Data.Set AD:0x384000D0 %Long 0x00000000                    ;mId:-;                   ;rId:User Defined Element;
Data.Set AD:0x384000D4 %Long 0x00000500                    ;mId:-;                   ;rId:User Defined Element;
Data.Set AD:0x384000D8 %Long 0x00000000                    ;mId:-;                   ;rId:User Defined Element;
Data.Set AD:0x384000DC %Long 0x00000000                    ;mId:-;                   ;rId:User Defined Element;
Data.Set AD:0x384000E0 %Long 0x00000004                    ;mId:-;                   ;rId:User Defined Element;
Data.Set AD:0x384000E4 %Long 0x00000000                    ;mId:-;                   ;rId:User Defined Element;
Data.Set AD:0x384000E8 %Long 0x00000000                    ;mId:-;                   ;rId:User Defined Element;
Data.Set AD:0x384000EC %Long 0x00000000                    ;mId:-;                   ;rId:User Defined Element;
Data.Set AD:0x384000F0 %Long 0x00000000                    ;mId:-;                   ;rId:User Defined Element;
Data.Set AD:0x384000F4 %Long 0x00281900                    ;mId:-;                   ;rId:User Defined Element;
Data.Set AD:0x384000F8 %Long 0x00000000                    ;mId:-;                   ;rId:User Defined Element;
Data.Set AD:0x384000FC %Long 0x00000000                    ;mId:-;                   ;rId:User Defined Element;
Data.Set AD:0x38400100 %Long 0x00100010                    ;mId:-;                   ;rId:User Defined Element;
Data.Set AD:0x38400104 %Long 0x00150015                    ;mId:-;                   ;rId:User Defined Element;
Data.Set AD:0x38400108 %Long 0x00000000                    ;mId:-;                   ;rId:User Defined Element;
Data.Set AD:0x3840010C %Long 0x00000000                    ;mId:-;                   ;rId:User Defined Element;
Data.Set AD:0x38400110 %Long 0x00000000                    ;mId:-;                   ;rId:User Defined Element;
Data.Set AD:0x38400114 %Long 0x00000000                    ;mId:-;                   ;rId:User Defined Element;
Data.Set AD:0x38400118 %Long 0x00000000                    ;mId:-;                   ;rId:User Defined Element;
Data.Set AD:0x3840011C %Long 0x00000000                    ;mId:-;                   ;rId:User Defined Element;
Data.Set AD:0x38400120 %Long 0x00000000                    ;mId:-;                   ;rId:User Defined Element;
Data.Set AD:0x38400124 %Long 0x00000023                    ;mId:-;                   ;rId:User Defined Element;
Data.Set AD:0x38400128 %Long 0x00000000                    ;mId:-;                   ;rId:User Defined Element;
Data.Set AD:0x3840012C %Long 0x00000000                    ;mId:-;                   ;rId:User Defined Element;
Data.Set AD:0x38400130 %Long 0x00230000                    ;mId:-;                   ;rId:User Defined Element;
Data.Set AD:0x38400134 %Long 0x00000000                    ;mId:-;                   ;rId:User Defined Element;
Data.Set AD:0x38400138 %Long 0x00000000                    ;mId:-;                   ;rId:User Defined Element;
Data.Set AD:0x3840013C %Long 0x00000000                    ;mId:-;                   ;rId:User Defined Element;
Data.Set AD:0x38400140 %Long 0x00000027                    ;mId:-;                   ;rId:User Defined Element;
Data.Set AD:0x38400144 %Long 0x00000000                    ;mId:-;                   ;rId:User Defined Element;
Data.Set AD:0x38400148 %Long 0x00000000                    ;mId:-;                   ;rId:User Defined Element;
Data.Set AD:0x3840014C %Long 0x00270000                    ;mId:-;                   ;rId:User Defined Element;
Data.Set AD:0x38400150 %Long 0x00000000                    ;mId:-;                   ;rId:User Defined Element;
Data.Set AD:0x38400154 %Long 0x00000000                    ;mId:-;                   ;rId:User Defined Element;
Data.Set AD:0x38400158 %Long 0x00000000                    ;mId:-;                   ;rId:User Defined Element;
Data.Set AD:0x3840015C %Long 0x00000000                    ;mId:-;                   ;rId:User Defined Element;
Data.Set AD:0x38400160 %Long 0x00000000                    ;mId:-;                   ;rId:User Defined Element;
Data.Set AD:0x38400164 %Long 0x00000000                    ;mId:-;                   ;rId:User Defined Element;
Data.Set AD:0x38400168 %Long 0x00000000                    ;mId:-;                   ;rId:User Defined Element;
Data.Set AD:0x3840016C %Long 0x00000000                    ;mId:-;                   ;rId:User Defined Element;
Data.Set AD:0x38400170 %Long 0x00000000                    ;mId:-;                   ;rId:User Defined Element;
Data.Set AD:0x38400174 %Long 0x00000000                    ;mId:-;                   ;rId:User Defined Element;
Data.Set AD:0x38400178 %Long 0x00000000                    ;mId:-;                   ;rId:User Defined Element;
Data.Set AD:0x3840017C %Long 0x00000000                    ;mId:-;                   ;rId:User Defined Element;
Data.Set AD:0x38400180 %Long 0x00000000                    ;mId:-;                   ;rId:User Defined Element;
Data.Set AD:0x38400184 %Long 0x00000000                    ;mId:-;                   ;rId:User Defined Element;
Data.Set AD:0x38400188 %Long 0x02000202                    ;mId:-;                   ;rId:User Defined Element;
Data.Set AD:0x3840018C %Long 0x02020002                    ;mId:-;                   ;rId:User Defined Element;
Data.Set AD:0x38400190 %Long 0x00020200                    ;mId:-;                   ;rId:User Defined Element;
Data.Set AD:0x38400194 %Long 0x00000000                    ;mId:-;                   ;rId:User Defined Element;
Data.Set AD:0x38400198 %Long 0x01000000                    ;mId:-;                   ;rId:User Defined Element;
Data.Set AD:0x3840019C %Long 0x00010101                    ;mId:-;                   ;rId:User Defined Element;
Data.Set AD:0x384001A0 %Long 0x010103FF                    ;mId:-;                   ;rId:User Defined Element;
Data.Set AD:0x384001A4 %Long 0x00010101                    ;mId:-;                   ;rId:User Defined Element;
Data.Set AD:0x384001A8 %Long 0x010103FF                    ;mId:-;                   ;rId:User Defined Element;
Data.Set AD:0x384001AC %Long 0x00020101                    ;mId:-;                   ;rId:User Defined Element;
Data.Set AD:0x384001B0 %Long 0x010103FF                    ;mId:-;                   ;rId:User Defined Element;
Data.Set AD:0x384001B4 %Long 0x00030101                    ;mId:-;                   ;rId:User Defined Element;
Data.Set AD:0x384001B8 %Long 0x000003FF                    ;mId:-;                   ;rId:User Defined Element;
Data.Set AD:0x384001BC %Long 0x00000000                    ;mId:-;                   ;rId:User Defined Element;
Data.Set AD:0x384001C0 %Long 0x00000000                    ;mId:-;                   ;rId:User Defined Element;
Data.Set AD:0x384001C4 %Long 0x00000000                    ;mId:-;                   ;rId:User Defined Element;
Data.Set AD:0x384001C8 %Long 0x00000900                    ;mId:-;                   ;rId:User Defined Element;
Data.Set AD:0x384001CC %Long 0x00104000                    ;mId:-;                   ;rId:User Defined Element;
Data.Set AD:0x384001D0 %Long 0x00000000                    ;mId:-;                   ;rId:User Defined Element;
Data.Set AD:0x384001D4 %Long 0x00000000                    ;mId:-;                   ;rId:User Defined Element;
Data.Set AD:0x384001D8 %Long 0x00000000                    ;mId:-;                   ;rId:User Defined Element;
Data.Set AD:0x384001DC %Long 0x00000000                    ;mId:-;                   ;rId:User Defined Element;
Data.Set AD:0x384001E0 %Long 0x00020605                    ;mId:-;                   ;rId:User Defined Element;
Data.Set AD:0x384001E4 %Long 0x060F0000                    ;mId:-;                   ;rId:User Defined Element;
Data.Set AD:0x384001E8 %Long 0x001A1401                    ;mId:-;                   ;rId:User Defined Element;
Data.Set AD:0x384001EC %Long 0x00000000                    ;mId:-;                   ;rId:User Defined Element;
Data.Set AD:0x384001F0 %Long 0x00000000                    ;mId:-;                   ;rId:User Defined Element;
Data.Set AD:0x384001F4 %Long 0x00000000                    ;mId:-;                   ;rId:User Defined Element;
Data.Set AD:0x384001F8 %Long 0x1101020F                    ;mId:-;                   ;rId:User Defined Element;
Data.Set AD:0x384001FC %Long 0x00000013                    ;mId:-;                   ;rId:User Defined Element;
Data.Set AD:0x38400200 %Long 0x00000000                    ;mId:-;                   ;rId:User Defined Element;
Data.Set AD:0x38400204 %Long 0x00000000                    ;mId:-;                   ;rId:User Defined Element;
Data.Set AD:0x38400208 %Long 0x00000000                    ;mId:-;                   ;rId:User Defined Element;
Data.Set AD:0x3840020C %Long 0x00000000                    ;mId:-;                   ;rId:User Defined Element;
Data.Set AD:0x38400210 %Long 0x00000000                    ;mId:-;                   ;rId:User Defined Element;
Data.Set AD:0x38400214 %Long 0x00000000                    ;mId:-;                   ;rId:User Defined Element;
Data.Set AD:0x38400218 %Long 0x00000000                    ;mId:-;                   ;rId:User Defined Element;
Data.Set AD:0x3840021C %Long 0x00000000                    ;mId:-;                   ;rId:User Defined Element;
Data.Set AD:0x38400220 %Long 0x00000000                    ;mId:-;                   ;rId:User Defined Element;
Data.Set AD:0x38400224 %Long 0x00000000                    ;mId:-;                   ;rId:User Defined Element;
Data.Set AD:0x38400228 %Long 0x06000000                    ;mId:-;                   ;rId:User Defined Element;
Data.Set AD:0x3840022C %Long 0x00000001                    ;mId:-;                   ;rId:User Defined Element;
WAIT 100ms                                              ;mId:-;                   ;rId:Software Delay Element;

Data.Set AD:0x38400808 %Long 0x0000000F                    ;mId:-;                   ;rId:User Defined Element;
WAIT 100ms                                              ;mId:-;                   ;rId:Software Delay Element;
Data.Set AD:0x3840080C %Long 0x00000003                    ;mId:-;                   ;rId:User Defined Element;
WAIT 100ms                                              ;mId:-;                   ;rId:Software Delay Element;
Data.Set AD:0x38400810 %Long 0x00000001                    ;mId:-;                   ;rId:User Defined Element;
WAIT 100ms                                              ;mId:-;                   ;rId:Software Delay Element;
Data.Set AD:0x38400850 %Long 0x00000000                    ;mId:-;                   ;rId:User Defined Element;
WAIT 100ms                                              ;mId:-;                   ;rId:Software Delay Element;
Data.Set AD:0x38400818 %Long 0x00000001                    ;mId:-;                   ;rId:User Defined Element;
WAIT 100ms                                              ;mId:-;                   ;rId:Software Delay Element;
Data.Set AD:0x3840084C %Long 0x01010101                    ;mId:-;                   ;rId:User Defined Element;
WAIT 100ms                                              ;mId:-;                   ;rId:Software Delay Element;
Data.Set AD:0x3840084C %Long 0x00000000                    ;mId:-;                   ;rId:User Defined Element;
WAIT 100ms                                              ;mId:-;                   ;rId:Software Delay Element;
Data.Set AD:0x38400000 %Long 0x00000601                    ;mId:-;                   ;rId:User Defined Element;
WAIT 100ms                                              ;mId:-;                   ;rId:Software Delay Element;
Data.Set AD:0x384000B0 %Long 0x00000010                    ;mId:-;                   ;rId:User Defined Element;

;;;;;;;;;;;;
;DDR Bank 1;
;;;;;;;;;;;;
Data.Set AD:0x38410800 %Long 0x00000001                    ;mId:-;                   ;rId:User Defined Element;
Data.Set AD:0x38410804 %Long 0x0000000F                    ;mId:-;                   ;rId:User Defined Element;
Data.Set AD:0x38410808 %Long 0x00000000                    ;mId:-;                   ;rId:User Defined Element;
Data.Set AD:0x3841080C %Long 0x00000000                    ;mId:-;                   ;rId:User Defined Element;
Data.Set AD:0x38410810 %Long 0x00000000                    ;mId:-;                   ;rId:User Defined Element;
Data.Set AD:0x38410814 %Long 0x00000000                    ;mId:-;                   ;rId:User Defined Element;
Data.Set AD:0x38410818 %Long 0x00000000                    ;mId:-;                   ;rId:User Defined Element;
Data.Set AD:0x3841081C %Long 0x0000000F                    ;mId:-;                   ;rId:User Defined Element;
Data.Set AD:0x38410820 %Long 0x00000000                    ;mId:-;                   ;rId:User Defined Element;
Data.Set AD:0x38410824 %Long 0x00000000                    ;mId:-;                   ;rId:User Defined Element;
Data.Set AD:0x38410828 %Long 0x00000000                    ;mId:-;                   ;rId:User Defined Element;
Data.Set AD:0x3841082C %Long 0x55020001                    ;mId:-;                   ;rId:User Defined Element;
Data.Set AD:0x38410830 %Long 0x03C92222                    ;mId:-;                   ;rId:User Defined Element;
Data.Set AD:0x38410834 %Long 0x08080808                    ;mId:-;                   ;rId:User Defined Element;
Data.Set AD:0x38410838 %Long 0x0000AA00                    ;mId:-;                   ;rId:User Defined Element;
Data.Set AD:0x3841083C %Long 0x000F2108                    ;mId:-;                   ;rId:User Defined Element;
Data.Set AD:0x38410840 %Long 0x000F2108                    ;mId:-;                   ;rId:User Defined Element;
Data.Set AD:0x38410844 %Long 0x000F2608                    ;mId:-;                   ;rId:User Defined Element;
Data.Set AD:0x38410848 %Long 0x000F2608                    ;mId:-;                   ;rId:User Defined Element;
Data.Set AD:0x3841084C %Long 0x00000000                    ;mId:-;                   ;rId:User Defined Element;
Data.Set AD:0x38410850 %Long 0x00000001                    ;mId:-;                   ;rId:User Defined Element;

Data.Set AD:0x38410000 %Long 0x00000600                    ;mId:-;                   ;rId:User Defined Element;
Data.Set AD:0x38410004 %Long 0x00000000                    ;mId:-;                   ;rId:User Defined Element;
Data.Set AD:0x38410008 %Long 0x00000006                    ;mId:-;                   ;rId:User Defined Element;
Data.Set AD:0x3841000C %Long 0x0001A0AB                    ;mId:-;                   ;rId:User Defined Element;
Data.Set AD:0x38410010 %Long 0x000411AB                    ;mId:-;                   ;rId:User Defined Element;
Data.Set AD:0x38410014 %Long 0x00000000                    ;mId:-;                   ;rId:User Defined Element;
Data.Set AD:0x38410018 %Long 0x0E000200                    ;mId:-;                   ;rId:User Defined Element;
Data.Set AD:0x3841001C %Long 0x06040406                    ;mId:-;                   ;rId:User Defined Element;
Data.Set AD:0x38410020 %Long 0x0704141B                    ;mId:-;                   ;rId:User Defined Element;
Data.Set AD:0x38410024 %Long 0x0C04041B                    ;mId:-;                   ;rId:User Defined Element;
Data.Set AD:0x38410028 %Long 0x03009240                    ;mId:-;                   ;rId:User Defined Element;
Data.Set AD:0x3841002C %Long 0x08070004                    ;mId:-;                   ;rId:User Defined Element;
Data.Set AD:0x38410030 %Long 0x0F010100                    ;mId:-;                   ;rId:User Defined Element;
Data.Set AD:0x38410034 %Long 0x00000703                    ;mId:-;                   ;rId:User Defined Element;
Data.Set AD:0x38410038 %Long 0x00010100                    ;mId:-;                   ;rId:User Defined Element;
Data.Set AD:0x3841003C %Long 0x10400056                    ;mId:-;                   ;rId:User Defined Element;
Data.Set AD:0x38410040 %Long 0x00000000                    ;mId:-;                   ;rId:User Defined Element;
Data.Set AD:0x38410044 %Long 0x000D0004                    ;mId:-;                   ;rId:User Defined Element;
Data.Set AD:0x38410048 %Long 0x005B01F9                    ;mId:-;                   ;rId:User Defined Element;
Data.Set AD:0x3841004C %Long 0x00000000                    ;mId:-;                   ;rId:User Defined Element;
Data.Set AD:0x38410050 %Long 0x00000000                    ;mId:-;                   ;rId:User Defined Element;
Data.Set AD:0x38410054 %Long 0x00000000                    ;mId:-;                   ;rId:User Defined Element;
Data.Set AD:0x38410058 %Long 0x00083000                    ;mId:-;                   ;rId:User Defined Element;
Data.Set AD:0x3841005C %Long 0x00080006                    ;mId:-;                   ;rId:User Defined Element;
Data.Set AD:0x38410060 %Long 0x00000000                    ;mId:-;                   ;rId:User Defined Element;
Data.Set AD:0x38410064 %Long 0x00000000                    ;mId:-;                   ;rId:User Defined Element;
Data.Set AD:0x38410068 %Long 0x00000000                    ;mId:-;                   ;rId:User Defined Element;
Data.Set AD:0x3841006C %Long 0x00000000                    ;mId:-;                   ;rId:User Defined Element;
Data.Set AD:0x38410070 %Long 0x00000000                    ;mId:-;                   ;rId:User Defined Element;
Data.Set AD:0x38410074 %Long 0x00000000                    ;mId:-;                   ;rId:User Defined Element;
Data.Set AD:0x38410078 %Long 0x00000000                    ;mId:-;                   ;rId:User Defined Element;
Data.Set AD:0x3841007C %Long 0x00000000                    ;mId:-;                   ;rId:User Defined Element;
Data.Set AD:0x38410080 %Long 0x02000000                    ;mId:-;                   ;rId:User Defined Element;
Data.Set AD:0x38410084 %Long 0x00400100                    ;mId:-;                   ;rId:User Defined Element;
Data.Set AD:0x38410088 %Long 0x00000200                    ;mId:-;                   ;rId:User Defined Element;
Data.Set AD:0x3841008C %Long 0x00000040                    ;mId:-;                   ;rId:User Defined Element;
Data.Set AD:0x38410090 %Long 0x02000000                    ;mId:-;                   ;rId:User Defined Element;
Data.Set AD:0x38410094 %Long 0xFFFF0A01                    ;mId:-;                   ;rId:User Defined Element;
Data.Set AD:0x38410098 %Long 0x01010101                    ;mId:-;                   ;rId:User Defined Element;
Data.Set AD:0x3841009C %Long 0x00000101                    ;mId:-;                   ;rId:User Defined Element;
Data.Set AD:0x384100A0 %Long 0x00010003                    ;mId:-;                   ;rId:User Defined Element;
Data.Set AD:0x384100A4 %Long 0x000C0000                    ;mId:-;                   ;rId:User Defined Element;
Data.Set AD:0x384100A8 %Long 0x00000000                    ;mId:-;                   ;rId:User Defined Element;
Data.Set AD:0x384100AC %Long 0x00000001                    ;mId:-;                   ;rId:User Defined Element;
Data.Set AD:0x384100B0 %Long 0x00000000                    ;mId:-;                   ;rId:User Defined Element;
Data.Set AD:0x384100B4 %Long 0x000027C9                    ;mId:-;                   ;rId:User Defined Element;
Data.Set AD:0x384100B8 %Long 0x00000000                    ;mId:-;                   ;rId:User Defined Element;
Data.Set AD:0x384100BC %Long 0x00000000                    ;mId:-;                   ;rId:User Defined Element;
Data.Set AD:0x384100C0 %Long 0x00000000                    ;mId:-;                   ;rId:User Defined Element;
Data.Set AD:0x384100C4 %Long 0x00000000                    ;mId:-;                   ;rId:User Defined Element;
Data.Set AD:0x384100C8 %Long 0x00000000                    ;mId:-;                   ;rId:User Defined Element;
Data.Set AD:0x384100CC %Long 0x00000000                    ;mId:-;                   ;rId:User Defined Element;
Data.Set AD:0x384100D0 %Long 0x00000000                    ;mId:-;                   ;rId:User Defined Element;
Data.Set AD:0x384100D4 %Long 0x00000500                    ;mId:-;                   ;rId:User Defined Element;
Data.Set AD:0x384100D8 %Long 0x00000000                    ;mId:-;                   ;rId:User Defined Element;
Data.Set AD:0x384100DC %Long 0x00000000                    ;mId:-;                   ;rId:User Defined Element;
Data.Set AD:0x384100E0 %Long 0x00000004                    ;mId:-;                   ;rId:User Defined Element;
Data.Set AD:0x384100E4 %Long 0x00000000                    ;mId:-;                   ;rId:User Defined Element;
Data.Set AD:0x384100E8 %Long 0x00000000                    ;mId:-;                   ;rId:User Defined Element;
Data.Set AD:0x384100EC %Long 0x00000000                    ;mId:-;                   ;rId:User Defined Element;
Data.Set AD:0x384100F0 %Long 0x00000000                    ;mId:-;                   ;rId:User Defined Element;
Data.Set AD:0x384100F4 %Long 0x00281900                    ;mId:-;                   ;rId:User Defined Element;
Data.Set AD:0x384100F8 %Long 0x00000000                    ;mId:-;                   ;rId:User Defined Element;
Data.Set AD:0x384100FC %Long 0x00000000                    ;mId:-;                   ;rId:User Defined Element;
Data.Set AD:0x38410100 %Long 0x00110011                    ;mId:-;                   ;rId:User Defined Element;
Data.Set AD:0x38410104 %Long 0x00160016                    ;mId:-;                   ;rId:User Defined Element;
Data.Set AD:0x38410108 %Long 0x00000000                    ;mId:-;                   ;rId:User Defined Element;
Data.Set AD:0x3841010C %Long 0x00000000                    ;mId:-;                   ;rId:User Defined Element;
Data.Set AD:0x38410110 %Long 0x00000000                    ;mId:-;                   ;rId:User Defined Element;
Data.Set AD:0x38410114 %Long 0x00000000                    ;mId:-;                   ;rId:User Defined Element;
Data.Set AD:0x38410118 %Long 0x00000000                    ;mId:-;                   ;rId:User Defined Element;
Data.Set AD:0x3841011C %Long 0x00000000                    ;mId:-;                   ;rId:User Defined Element;
Data.Set AD:0x38410120 %Long 0x00000000                    ;mId:-;                   ;rId:User Defined Element;
Data.Set AD:0x38410124 %Long 0x00000023                    ;mId:-;                   ;rId:User Defined Element;
Data.Set AD:0x38410128 %Long 0x00000000                    ;mId:-;                   ;rId:User Defined Element;
Data.Set AD:0x3841012C %Long 0x00000000                    ;mId:-;                   ;rId:User Defined Element;
Data.Set AD:0x38410130 %Long 0x00220000                    ;mId:-;                   ;rId:User Defined Element;
Data.Set AD:0x38410134 %Long 0x00000000                    ;mId:-;                   ;rId:User Defined Element;
Data.Set AD:0x38410138 %Long 0x00000000                    ;mId:-;                   ;rId:User Defined Element;
Data.Set AD:0x3841013C %Long 0x00000000                    ;mId:-;                   ;rId:User Defined Element;
Data.Set AD:0x38410140 %Long 0x00000028                    ;mId:-;                   ;rId:User Defined Element;
Data.Set AD:0x38410144 %Long 0x00000000                    ;mId:-;                   ;rId:User Defined Element;
Data.Set AD:0x38410148 %Long 0x00000000                    ;mId:-;                   ;rId:User Defined Element;
Data.Set AD:0x3841014C %Long 0x00280000                    ;mId:-;                   ;rId:User Defined Element;
Data.Set AD:0x38410150 %Long 0x00000000                    ;mId:-;                   ;rId:User Defined Element;
Data.Set AD:0x38410154 %Long 0x00000000                    ;mId:-;                   ;rId:User Defined Element;
Data.Set AD:0x38410158 %Long 0x00000000                    ;mId:-;                   ;rId:User Defined Element;
Data.Set AD:0x3841015C %Long 0x00000000                    ;mId:-;                   ;rId:User Defined Element;
Data.Set AD:0x38410160 %Long 0x00000000                    ;mId:-;                   ;rId:User Defined Element;
Data.Set AD:0x38410164 %Long 0x00000000                    ;mId:-;                   ;rId:User Defined Element;
Data.Set AD:0x38410168 %Long 0x00000000                    ;mId:-;                   ;rId:User Defined Element;
Data.Set AD:0x3841016C %Long 0x00000000                    ;mId:-;                   ;rId:User Defined Element;
Data.Set AD:0x38410170 %Long 0x00000000                    ;mId:-;                   ;rId:User Defined Element;
Data.Set AD:0x38410174 %Long 0x00000000                    ;mId:-;                   ;rId:User Defined Element;
Data.Set AD:0x38410178 %Long 0x00000000                    ;mId:-;                   ;rId:User Defined Element;
Data.Set AD:0x3841017C %Long 0x00000000                    ;mId:-;                   ;rId:User Defined Element;
Data.Set AD:0x38410180 %Long 0x00000000                    ;mId:-;                   ;rId:User Defined Element;
Data.Set AD:0x38410184 %Long 0x00000000                    ;mId:-;                   ;rId:User Defined Element;
Data.Set AD:0x38410188 %Long 0x02000202                    ;mId:-;                   ;rId:User Defined Element;
Data.Set AD:0x3841018C %Long 0x02020002                    ;mId:-;                   ;rId:User Defined Element;
Data.Set AD:0x38410190 %Long 0x00020200                    ;mId:-;                   ;rId:User Defined Element;
Data.Set AD:0x38410194 %Long 0x00000000                    ;mId:-;                   ;rId:User Defined Element;
Data.Set AD:0x38410198 %Long 0x01000000                    ;mId:-;                   ;rId:User Defined Element;
Data.Set AD:0x3841019C %Long 0x00010101                    ;mId:-;                   ;rId:User Defined Element;
Data.Set AD:0x384101A0 %Long 0x010103FF                    ;mId:-;                   ;rId:User Defined Element;
Data.Set AD:0x384101A4 %Long 0x00010101                    ;mId:-;                   ;rId:User Defined Element;
Data.Set AD:0x384101A8 %Long 0x010103FF                    ;mId:-;                   ;rId:User Defined Element;
Data.Set AD:0x384101AC %Long 0x00020101                    ;mId:-;                   ;rId:User Defined Element;
Data.Set AD:0x384101B0 %Long 0x010103FF                    ;mId:-;                   ;rId:User Defined Element;
Data.Set AD:0x384101B4 %Long 0x00030101                    ;mId:-;                   ;rId:User Defined Element;
Data.Set AD:0x384101B8 %Long 0x000003FF                    ;mId:-;                   ;rId:User Defined Element;
Data.Set AD:0x384101BC %Long 0x00000000                    ;mId:-;                   ;rId:User Defined Element;
Data.Set AD:0x384101C0 %Long 0x00000000                    ;mId:-;                   ;rId:User Defined Element;
Data.Set AD:0x384101C4 %Long 0x00000000                    ;mId:-;                   ;rId:User Defined Element;
Data.Set AD:0x384101C8 %Long 0x00000900                    ;mId:-;                   ;rId:User Defined Element;
Data.Set AD:0x384101CC %Long 0x00104000                    ;mId:-;                   ;rId:User Defined Element;
Data.Set AD:0x384101D0 %Long 0x00000000                    ;mId:-;                   ;rId:User Defined Element;
Data.Set AD:0x384101D4 %Long 0x00000000                    ;mId:-;                   ;rId:User Defined Element;
Data.Set AD:0x384101D8 %Long 0x00000000                    ;mId:-;                   ;rId:User Defined Element;
Data.Set AD:0x384101DC %Long 0x00000000                    ;mId:-;                   ;rId:User Defined Element;
Data.Set AD:0x384101E0 %Long 0x00020605                    ;mId:-;                   ;rId:User Defined Element;
Data.Set AD:0x384101E4 %Long 0x060F0000                    ;mId:-;                   ;rId:User Defined Element;
Data.Set AD:0x384101E8 %Long 0x001A1401                    ;mId:-;                   ;rId:User Defined Element;
Data.Set AD:0x384101EC %Long 0x00000000                    ;mId:-;                   ;rId:User Defined Element;
Data.Set AD:0x384101F0 %Long 0x00000000                    ;mId:-;                   ;rId:User Defined Element;
Data.Set AD:0x384101F4 %Long 0x00000000                    ;mId:-;                   ;rId:User Defined Element;
Data.Set AD:0x384101F8 %Long 0x1101020F                    ;mId:-;                   ;rId:User Defined Element;
Data.Set AD:0x384101FC %Long 0x00000013                    ;mId:-;                   ;rId:User Defined Element;
Data.Set AD:0x38410200 %Long 0x00000000                    ;mId:-;                   ;rId:User Defined Element;
Data.Set AD:0x38410204 %Long 0x00000000                    ;mId:-;                   ;rId:User Defined Element;
Data.Set AD:0x38410208 %Long 0x00000000                    ;mId:-;                   ;rId:User Defined Element;
Data.Set AD:0x3841020C %Long 0x00000000                    ;mId:-;                   ;rId:User Defined Element;
Data.Set AD:0x38410210 %Long 0x00000000                    ;mId:-;                   ;rId:User Defined Element;
Data.Set AD:0x38410214 %Long 0x00000000                    ;mId:-;                   ;rId:User Defined Element;
Data.Set AD:0x38410218 %Long 0x00000000                    ;mId:-;                   ;rId:User Defined Element;
Data.Set AD:0x3841021C %Long 0x00000000                    ;mId:-;                   ;rId:User Defined Element;
Data.Set AD:0x38410220 %Long 0x00000000                    ;mId:-;                   ;rId:User Defined Element;
Data.Set AD:0x38410224 %Long 0x00000000                    ;mId:-;                   ;rId:User Defined Element;
Data.Set AD:0x38410228 %Long 0x06000000                    ;mId:-;                   ;rId:User Defined Element;
Data.Set AD:0x3841022C %Long 0x00000001                    ;mId:-;                   ;rId:User Defined Element;
WAIT 100ms                                              ;mId:-;                   ;rId:Software Delay Element;

Data.Set AD:0x38410808 %Long 0x0000000F                    ;mId:-;                   ;rId:User Defined Element;
WAIT 100ms                                              ;mId:-;                   ;rId:Software Delay Element;
Data.Set AD:0x3841080C %Long 0x00000003                    ;mId:-;                   ;rId:User Defined Element;
WAIT 100ms                                              ;mId:-;                   ;rId:Software Delay Element;
Data.Set AD:0x38410810 %Long 0x00000001                    ;mId:-;                   ;rId:User Defined Element;
WAIT 100ms                                              ;mId:-;                   ;rId:Software Delay Element;
Data.Set AD:0x38410850 %Long 0x00000000                    ;mId:-;                   ;rId:User Defined Element;
WAIT 100ms                                              ;mId:-;                   ;rId:Software Delay Element;
Data.Set AD:0x38410818 %Long 0x00000001                    ;mId:-;                   ;rId:User Defined Element;
WAIT 100ms                                              ;mId:-;                   ;rId:Software Delay Element;
Data.Set AD:0x3841084C %Long 0x01010101                    ;mId:-;                   ;rId:User Defined Element;
WAIT 100ms                                              ;mId:-;                   ;rId:Software Delay Element;
Data.Set AD:0x3841084C %Long 0x00000000                    ;mId:-;                   ;rId:User Defined Element;
WAIT 100ms                                              ;mId:-;                   ;rId:Software Delay Element;
Data.Set AD:0x38410000 %Long 0x00000601                    ;mId:-;                   ;rId:User Defined Element;
WAIT 100ms                                              ;mId:-;                   ;rId:Software Delay Element;
Data.Set AD:0x384100B0 %Long 0x00000010                    ;mId:-;                   ;rId:User Defined Element;
Data.Set AD:0x3B200060 %Long 0x00000000                    ;mId:-;                   ;rId:User Defined Element;
WAIT 100ms                                              ;mId:-;                   ;rId:Software Delay Element;

ENDDO
