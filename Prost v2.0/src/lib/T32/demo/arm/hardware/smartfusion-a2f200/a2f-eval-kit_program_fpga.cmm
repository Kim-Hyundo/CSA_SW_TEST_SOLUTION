; --------------------------------------------------------------------------------
; @Title: FPGA Programming example using a STAPL file for A2F200 on A2F-EVAL-Kit
; @Description:
;   This script shows how to program the FPGA on a SMARTFUSION device using a
;   Lauterbach debug probe. In this example a empty FPGA design is used to
;   ensure the CPU boots properly.
;   Prerequisites:
;    * Connect Debug Cable to J3 using Adapter LA-3770
;      or
;      Connect Combiprobe/uTrace to J3
;    * activate J3 (ARM20 header) - short JP7 2-3
;    * activate FPGA programming - short JP10 1-2
;    * remove R14 (TRST pulldown 510 Ohms)
;    * add a pullup ~10k to VCC<->TRST e.g. J3 Pin 1-3
; @Keywords: ARM, Cortex-M3, Actel, Smartfusion, STP, STAPL, FPGA
; @Author: AME
; @Board: A2F-EVAL-Kit
; @Chip: A2F*
; @Copyright: (C) 1989-2019 Lauterbach GmbH, licensed for use with TRACE32(R) only
; --------------------------------------------------------------------------------
; $Id: a2f-eval-kit_program_fpga.cmm 15217 2019-11-04 16:17:15Z bschroefel $


WinCLEAR

; --------------------------------------------------------------------------------
; initialize - select JTAG mode, select JTAG Frequency
RESet
SYStem.RESet
SYStem.CPU A2F200
SYStem.CONFIG.DEBUGPORTTYPE JTAG
SYStem.JtagClock CTCK 10MHz

; --------------------------------------------------------------------------------
; Prerequisite - extract example design
IF OS.FILE("~~~~/a2f200-empty.stp.gz")
  UNZIP "~~~~/a2f200-empty.stp.gz" "~~~~/a2f200-empty.stp"

; --------------------------------------------------------------------------------
; FPGA Programming - execute action "PROGRAM" defined in the STAPL/JAM file
JTAG.PROGRAM.JAM "~~~~/a2f200-empty.stp" /A "PROGRAM"

ENDDO
