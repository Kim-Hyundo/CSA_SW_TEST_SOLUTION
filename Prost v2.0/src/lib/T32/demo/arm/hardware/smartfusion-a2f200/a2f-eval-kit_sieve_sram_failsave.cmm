; --------------------------------------------------------------------------------
; @Title: Simple demo script for A2F200 on A2F-EVAL-Kit (RAM, FAILSAFE)
; @Description:
;   Loads the sieve demo application into RAM and sets up a demo debug
;   scenario.
;   Use this script for getting started.
;   Prerequisites:
;    * Connect Debug Cable to J3 using Adapter LA-3770
;      or
;      Connect Combiprobe/uTrace to J3
;    * activate J3 - short JP7 2-3
;    * activate Cortex debug - short JP10 2-3
;    * remove R14 (TRST pulldown 510 Ohms)
;    * add a pullup ~10k to VCC<->TRST e.g. J3 Pin 1-3
;    * the FPGA must not be loaded
; @Keywords: ARM, Cortex-M3
; @Author: AME
; @Board: A2F-EVAL-Kit
; @Chip: A2F*
; @Copyright: (C) 1989-2019 Lauterbach GmbH, licensed for use with TRACE32(R) only
; --------------------------------------------------------------------------------
; $Id: a2f-eval-kit_sieve_sram_failsave.cmm 15217 2019-11-04 16:17:15Z bschroefel $


WinCLEAR

; --------------------------------------------------------------------------------
; initialize and start the debugger
RESet
SYStem.RESet
SYStem.CPU A2F200
SYStem.CONFIG.DEBUGPORTTYPE SWD
IF hardware.COMBIPROBE()||hardware.UTRACE()
(
  SYStem.CONFIG.CONNECTOR MIPI20T
)
SYStem.Option DUALPORT ON
SYStem.MemAccess DAP
SYStem.JtagClock CTCK 10MHz
; <workaround>
; as the BootROM detects an error the MSS_RESET might be kept asserted by the BootROM
; this workarond de-asserts the MSS_RESET to execute some code in SRAM
SYStem.Mode.Prepare
SYStem.Option EnReset OFF
; clear SOFT_RST_CR.EXT_SR
Data.Set E:0xE0042030 %Long Data.Long(E:0xE0042030)&~0x10000
SYStem.Option EnReset ON
; </temporary workaround>
; finally connect to the core
SYStem.Up

; --------------------------------------------------------------------------------
; load demo program (uses internal RAM only)
Data.LOAD.Elf "~~~~/sieve_ram_thumb_ii_v7m.elf"

; --------------------------------------------------------------------------------
; start program execution
Go.direct main
WAIT !STATE.RUN()

; --------------------------------------------------------------------------------
; open some windows
WinCLEAR
Mode.Hll
WinPOS 0. 0.
List.auto
WinPOS 120. 0. 100. 8.
Frame.view
WinPOS 120. 14.
Var.Watch
Var.AddWatch %SpotLight ast flags
WinPOS 120. 25.
Register.view /SpotLight
WinPOS 0. 32.
Var.DRAW %DEFault sinewave

ENDDO
