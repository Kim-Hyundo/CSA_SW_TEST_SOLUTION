; --------------------------------------------------------------------------------
; @Title: Demo script for A2F200 on A2F-EVAL-Kit (FLASH)
; @Description:
;   Programs the sieve demo application into the processor internal flash and
;   sets up a demo debug scenario.
;   This script can be used as a template for flashing an application.
;   Prerequisites:
;    * Connect Debug Cable to J3 using Adapter LA-3770
;      or
;      Connect Combiprobe/uTrace to J3
;    * activate J3 - short JP7 2-3
;    * activate Cortex debug - short JP10 2-3
;    * remove R14 (TRST pulldown 510 Ohms)
;    * add a pullup ~10k to VCC<->TRST e.g. J3 Pin 1-3
;    * a valid FPGA image is programmed see
;        ./a2f-eval-kit_program_fpga.cmm
;      or e.g.
;        http://soc.microsemi.com/download/rsc/?f=Keil_SmartFusion_tutorial_PF
; @Keywords: ARM, Cortex-M3, Flash
; @Author: AME
; @Board: A2F-EVAL-Kit
; @Chip: A2F*
; @Copyright: (C) 1989-2019 Lauterbach GmbH, licensed for use with TRACE32(R) only
; --------------------------------------------------------------------------------
; $Id: a2f-eval-kit_sieve_flash.cmm 15217 2019-11-04 16:17:15Z bschroefel $


WinCLEAR

; --------------------------------------------------------------------------------
; initialize and start the debugger
RESet
SYStem.RESet
SYStem.CPU A2F200
SYStem.CONFIG.DEBUGPORTTYPE SWD
IF hardware.COMBIPROBE()||hardware.UTRACE()
(
  SYStem.CONFIG.CONNECTOR MIPI20T
)
SYStem.Option DUALPORT ON
SYStem.MemAccess DAP
SYStem.JtagClock CTCK 10MHz
SYStem.Up

; --------------------------------------------------------------------------------
; Flash programming

; prepare flash programming (declarations)
DO ~~/demo/arm/flash/a2f PREPAREONLY

; ReProgram Flash
FLASH.ReProgram ALL
Data.LOAD.Elf "~~~~/sieve_flash_thumb_ii_v7m.elf"
FLASH.ReProgram OFF

; --------------------------------------------------------------------------------
; Reset the target again
SYStem.Up

; --------------------------------------------------------------------------------
; start program execution
Go.direct main
WAIT !STATE.RUN()

; --------------------------------------------------------------------------------
; open some windows
WinCLEAR
Mode.Hll
WinPOS 0. 0.
List.auto
WinPOS 120. 0. 100. 8.
Frame.view
WinPOS 120. 14.
Var.Watch
Var.AddWatch %SpotLight ast flags
WinPOS 120. 25.
Register.view /SpotLight
WinPOS 0. 32.
Var.DRAW %DEFault sinewave

ENDDO
