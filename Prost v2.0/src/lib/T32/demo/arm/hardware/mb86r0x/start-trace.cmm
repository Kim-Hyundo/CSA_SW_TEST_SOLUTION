; --------------------------------------------------------------------------------
; @Title: Start-Up script for MB86R0x Jade with trace.
; @Description: 
;   This script sets up an debug & trace session for
;   MB86R0x. Starts an low-level code afterwards.
;   Set SW901.Pin4 OFF (Big Endian)
;   Set SW901.Pin6 ON (ARM JTAG ENABLE)
;   Set SW901.Pin1 OFF (MPX_MODE_5[0]=0, TRACE Mode)
; @Author: AME
; @Keywords: Jade
; @Board: XXSvideo-D
; @Chip: MB86R01, MB86R02, MB86R03
; @Copyright: (C) 1989-2019 Lauterbach GmbH, licensed for use with TRACE32(R) only
; --------------------------------------------------------------------------------
; $Id: start-trace.cmm 15223 2019-11-05 16:29:45Z bschroefel $


WinCLEAR
RESet
SYStem.RESet
SYStem.CPU MB86R02
SYStem.Option BigEndian OFF
SYStem.JtagClock RTCK
SYStem.Up

IF ANALYZER()
(
	; PINMUX done by hardware switch
	ETM.DataTrace OFF
	ETM.PortSize 4
	ETM.PortMode 1/1
	Trace.METHOD Analyzer
)

; load some code into SRAM
Data.LOAD.Elf ~~/demo/arm/compiler/gnu-pic/midi_arm.elf 0x01001000 /RelPATH

; stop at 'main'
Go main
WAIT !STATE.RUN()

; open some windows
List.auto

IF ANALYZER()
(
	; Clear the Trace
	Analyzer.Init
	
	; selective Trace with TraceON and TraceOFF
	Break.Set main\5 /TraceON
	Break.Set main\9 /TraceOFF
	Analyzer.List
)


