; --------------------------------------------------------------------------------
; @Title: Run a Sieve demo in SRAM for the MCBTMPM395
; @Description:
;   This demo shows how to connect TRACE32 to the MCBTMPM395 Cortex-M3 Keil
;   Board and load a simple sieve demo on SRAM and start a debug session
;     SRAM: 0x20000000--0x20001FFF
;
; @Keywords: Cortex-M3, SWD, Keil
; @Author: MSA
; @Board: MCBTMPM395
; @Chip: TMPM395FW
; @Copyright: (C) 1989-2019 Lauterbach GmbH, licensed for use with TRACE32(R) only
; --------------------------------------------------------------------------------
; $Id: tmpm395fwaxbg_sram_demo.cmm 15217 2019-11-04 16:17:15Z bschroefel $

  RESet
  SYStem.RESet
  SYStem.CPU TMPM395FWAXBG
  SYStem.CONFIG.DEBUGPORTTYPE SWD

  SYStem.Up

  ; initialize SRAM to 0x0
  D.S SD:0x20000000--0x20001FFF %LE %Long 0x0  
  
  Data.LOAD.Elf ~~~~/sieve_ram_thumb_ii_v7.elf
  
  ;disable watchdog
  Data.Set D:0x400F0080 %Long 0x01
  Data.Set D:0x400F0084 %Long 0xB1

  ; open some windows
  WinCLEAR

  WinPOS 0% 0% 50% 50%
  List.auto

  WinPOS 50% 0% 50% 50%
  Register.view /SpotLight

  WinPOS 0% 50% 50% 50%
  Frame /Locals /Caller

  WinPOS 50% 50% 50% 50%
  Var.DRAW sinewave
  
  GO
  WAIT 2.s
  Break
  ENDDO
