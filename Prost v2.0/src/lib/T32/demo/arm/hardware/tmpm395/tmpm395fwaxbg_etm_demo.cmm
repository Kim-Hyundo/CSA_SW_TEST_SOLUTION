; --------------------------------------------------------------------------------
; @Title: Run a sample ETM Trace demo for the MCBTMPM395
; @Description:
;   This demo shows how to connect TRACE32 to the MCBTMPM395 Cortex-M3 Keil
;   Board using the MIPI20 ETM Trace connector and load a simple sieve demo
;   on SRAM and start a Trace demo using the ETM.
;   Use uTrace and connect debugger to the MIPI20 (Cortex Debug + ETM) Board
;   connector or use "Power Debug II + Power Trace II +
;   Mictor38 to MIPI20 Adapter":
;   The JTAG debug Cable should be connected to the board Jtag Connector
;   OR to the used "Mictor38 to MIPI20 Adapter"
;
; @Keywords: Cortex-M3, SWD, Keil, ETM
; @Author: MSA
; @Board: MCBTMPM395
; @Chip: TMPM395FW
; @Copyright: (C) 1989-2019 Lauterbach GmbH, licensed for use with TRACE32(R) only
; --------------------------------------------------------------------------------
; $Id: tmpm395fwaxbg_etm_demo.cmm 15217 2019-11-04 16:17:15Z bschroefel $

  RESet
  SYStem.RESet
  SYStem.CPU TMPM395FWAXBG
  SYStem.CONFIG.DEBUGPORTTYPE SWD

  SYStem.Up
  
  ;disable watchdog
  Data.Set D:0x400F0080 %Long 0x01
  Data.Set D:0x400F0084 %Long 0xB1
  
  ; initialize SRAM to 0x0
  D.S SD:0x20000000--0x20001FFF %LE %Long 0x0
  
  Data.LOAD.Elf ~~~~/sieve_ram_thumb_ii_v7.elf
  
  ; ETM Pin Multiplexing
  Data.Set D:0x400C0008 %Long 0yXXXXxxxxXXXXxxxxXXXXxxxxX11111xx   ;GPIOACR control Register
  Data.Set D:0x400C0004 %Long 0yXXXXxxxxXXXXxxxxXXXXxxxxX11111xx   ;GPIOAFR Fonction Register
  
  ITM.OFF
  
  ETM.ON
  ETM.PortMode CONTINUOUS
  ETM.PortSize 4
  Trace.AutoArm ON
  Trace.Init
  
  IF Analyzer()
  (
    Analyzer.AutoFocus
  )
  ELSE IF hardware.COMBIPROBE()||hardware.UTRACE()
  (
    Trace.THreshold 1.66
  )

  ; open some windows
  WinCLEAR

  WinPOS 0% 0% 50% 50%
  List.auto

  WinPOS 50% 0% 50% 50%
  Register.view /SpotLight

  WinPOS 0% 50% 50% 50%
  Frame /Locals /Caller

  WinPOS 50% 50% 50% 50%
  Trace.List
  
  GO
  WAIT 2.s
  Break
  ENDDO
