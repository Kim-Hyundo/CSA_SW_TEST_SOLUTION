; --------------------------------------------------------------------------------
; @Title: Setup Script for AM572x : am572x_emif_macros.cmm
; @Description: see "am572x_hardware_init.cmm"
; @Keywords: AM57xx
; @Author: YDA
; @Board: AM572x EVM
; @Chip: AM572x
; @Copyright: (C) 1989-2019 Lauterbach GmbH, licensed for use with TRACE32(R) only
; --------------------------------------------------------------------------------
; $Id: am572x_emif_macros.cmm 15217 2019-11-04 16:17:15Z bschroefel $

//DMM
GLOBAL &SOC_DMM_CONF_REGS_BASE
GLOBAL &SOC_MA_MPU_CONF_REGS_BASE
GLOBAL &LISA_MAP_0
GLOBAL &LISA_MAP_1
GLOBAL &LISA_MAP_2
GLOBAL &LISA_MAP_3

//CM WKUP CORE
GLOBAL &SOC_CTRL_MODULE_WKUP_CORE_REGISTERS_BASE
GLOBAL &CTRL_WKUP_EMIF1_SDRAM_CONFIG_EXT
GLOBAL &CTRL_WKUP_EMIF2_SDRAM_CONFIG_EXT

//CM CORE CORE PAD
GLOBAL &SOC_CTRL_MODULE_CORE_CORE_PAD_REGISTERS_BASE
GLOBAL &CTRL_CORE_CONTROL_DDRCACH1_0
GLOBAL &CTRL_CORE_CONTROL_DDRCACH2_0
GLOBAL &CTRL_CORE_CONTROL_DDRCH1_0
GLOBAL &CTRL_CORE_CONTROL_DDRCH1_1
GLOBAL &CTRL_CORE_CONTROL_DDRCH2_0
GLOBAL &CTRL_CORE_CONTROL_DDRCH2_1
GLOBAL &CTRL_CORE_CONTROL_DDRCH1_2
GLOBAL &CTRL_CORE_CONTROL_DDRCH2_2
GLOBAL &CTRL_CORE_CONTROL_DDRIO_0
GLOBAL &CTRL_CORE_CONTROL_DDRIO_1

//CM CORE AON
GLOBAL &SOC_CKGEN_CM_CORE_AON_BASE
GLOBAL &CM_DLL_CTRL

//PRM
GLOBAL &SOC_DEVICE_PRM_BASE
GLOBAL &PRM_RSTST
GLOBAL &PRM_RSTST_GLOBAL_WARM_SW_RST_MASK
GLOBAL &PRM_RSTST_EXTERNAL_WARM_RST_MASK

//EMIF
GLOBAL &SOC_EMIF1_CONF_REGS_BASE
GLOBAL &SOC_EMIF2_CONF_REGS_BASE

GLOBAL &EMIF_STATUS
GLOBAL &EMIF_SDRAM_CONFIG
GLOBAL &EMIF_SDRAM_CONFIG_2
GLOBAL &EMIF_SDRAM_REFRESH_CONTROL
GLOBAL &EMIF_SDRAM_REFRESH_CONTROL_SHADOW
GLOBAL &EMIF_SDRAM_TIMING_1
GLOBAL &EMIF_SDRAM_TIMING_1_SHADOW
GLOBAL &EMIF_SDRAM_TIMING_2
GLOBAL &EMIF_SDRAM_TIMING_2_SHADOW
GLOBAL &EMIF_SDRAM_TIMING_3
GLOBAL &EMIF_SDRAM_TIMING_3_SHADOW
GLOBAL &EMIF_LPDDR2_NVM_TIMING
GLOBAL &EMIF_LPDDR2_NVM_TIMING_SHADOW
GLOBAL &EMIF_POWER_MANAGEMENT_CONTROL
GLOBAL &EMIF_POWER_MANAGEMENT_CONTROL_SHADOW
GLOBAL &EMIF_LPDDR2_MODE_REG_DATA
GLOBAL &EMIF_LPDDR2_MODE_REG_CONFIG
GLOBAL &EMIF_OCP_CONFIG
GLOBAL &EMIF_OCP_CONFIG_VALUE_1
GLOBAL &EMIF_OCP_CONFIG_VALUE_2
GLOBAL &EMIF_IODFT_TLGC
GLOBAL &EMIF_PERFORMANCE_COUNTER_1
GLOBAL &EMIF_PERFORMANCE_COUNTER_2
GLOBAL &EMIF_PERFORMANCE_COUNTER_CONFIG
GLOBAL &EMIF_PERFORMANCE_COUNTER_MASTER_REGION_SELECT
GLOBAL &EMIF_PERFORMANCE_COUNTER_TIME
GLOBAL &EMIF_DLL_CALIB_CTRL
GLOBAL &EMIF_DLL_CALIB_CTRL_SHADOW
GLOBAL &EMIF_SYSTEM_OCP_INTERRUPT_RAW_STATUS
GLOBAL &EMIF_SYSTEM_OCP_INTERRUPT_STATUS
GLOBAL &EMIF_SYSTEM_OCP_INTERRUPT_ENABLE_SET
GLOBAL &EMIF_SYSTEM_OCP_INTERRUPT_ENABLE_CLEAR
GLOBAL &EMIF_SDRAM_OUTPUT_IMPEDANCE_CALIBRATION_CONFIG
GLOBAL &EMIF_TEMPERATURE_ALERT_CONFIG
GLOBAL &EMIF_OCP_ERROR_LOG
GLOBAL &EMIF_READ_WRITE_LEVELING_RAMP_WINDOW
GLOBAL &EMIF_READ_WRITE_LEVELING_RAMP_CONTROL
GLOBAL &EMIF_READ_WRITE_LEVELING_CONTROL
GLOBAL &EMIF_DDR_PHY_CONTROL_1
GLOBAL &EMIF_DDR_PHY_CONTROL_1_SHADOW
GLOBAL &EMIF_DDR_PHY_CONTROL_2
GLOBAL &EMIF_PRIORITY_TO_CLASS_OF_SERVICE_MAPPING
GLOBAL &EMIF_CONNECTION_ID_TO_CLASS_OF_SERVICE_1_MAPPING
GLOBAL &EMIF_CONNECTION_ID_TO_CLASS_OF_SERVICE_2_MAPPING
GLOBAL &EMIF_ECC_CTRL_REG
GLOBAL &EMIF_ECC_ADDRESS_RANGE_1
GLOBAL &EMIF_ECC_ADDRESS_RANGE_2
GLOBAL &EMIF_READ_WRITE_EXECUTION_THRESHOLD
GLOBAL &EMIF_COS_CONFIG
GLOBAL &EMIF_1B_ECC_ERR_CNT
GLOBAL &EMIF_1B_ECC_ERR_THRSH
GLOBAL &EMIF_1B_ECC_ERR_DIST_1
GLOBAL &EMIF_1B_ECC_ERR_ADDR_LOG
GLOBAL &EMIF_2B_ECC_ERR_ADDR_LOG
GLOBAL &EMIF_PHY_STATUS_1
GLOBAL &EMIF_PHY_STATUS_7
GLOBAL &EMIF_PHY_STATUS_8
GLOBAL &EMIF_PHY_STATUS_9
GLOBAL &EMIF_PHY_STATUS_10
GLOBAL &EMIF_PHY_STATUS_11
GLOBAL &EMIF_PHY_STATUS_12
GLOBAL &EMIF_PHY_STATUS_13
GLOBAL &EMIF_PHY_STATUS_14
GLOBAL &EMIF_PHY_STATUS_15
GLOBAL &EMIF_PHY_STATUS_16
GLOBAL &EMIF_PHY_STATUS_17
GLOBAL &EMIF_PHY_STATUS_18
GLOBAL &EMIF_PHY_STATUS_19
GLOBAL &EMIF_PHY_STATUS_20
GLOBAL &EMIF_PHY_STATUS_21
GLOBAL &EMIF_PHY_STATUS_22
GLOBAL &EMIF_PHY_STATUS_23
GLOBAL &EMIF_PHY_STATUS_24
GLOBAL &EMIF_PHY_STATUS_25
GLOBAL &EMIF_PHY_STATUS_26
GLOBAL &EMIF_EXT_PHY_CONTROL_1
GLOBAL &EMIF_EXT_PHY_CONTROL_1_SHADOW
GLOBAL &EMIF_EXT_PHY_CONTROL_2
GLOBAL &EMIF_EXT_PHY_CONTROL_2_SHADOW
GLOBAL &EMIF_EXT_PHY_CONTROL_3
GLOBAL &EMIF_EXT_PHY_CONTROL_3_SHADOW
GLOBAL &EMIF_EXT_PHY_CONTROL_4
GLOBAL &EMIF_EXT_PHY_CONTROL_4_SHADOW
GLOBAL &EMIF_EXT_PHY_CONTROL_5
GLOBAL &EMIF_EXT_PHY_CONTROL_5_SHADOW
GLOBAL &EMIF_EXT_PHY_CONTROL_6
GLOBAL &EMIF_EXT_PHY_CONTROL_6_SHADOW
GLOBAL &EMIF_EXT_PHY_CONTROL_7
GLOBAL &EMIF_EXT_PHY_CONTROL_7_SHADOW
GLOBAL &EMIF_EXT_PHY_CONTROL_8
GLOBAL &EMIF_EXT_PHY_CONTROL_8_SHADOW
GLOBAL &EMIF_EXT_PHY_CONTROL_9
GLOBAL &EMIF_EXT_PHY_CONTROL_9_SHADOW
GLOBAL &EMIF_EXT_PHY_CONTROL_10
GLOBAL &EMIF_EXT_PHY_CONTROL_10_SHADOW
GLOBAL &EMIF_EXT_PHY_CONTROL_11
GLOBAL &EMIF_EXT_PHY_CONTROL_11_SHADOW
GLOBAL &EMIF_EXT_PHY_CONTROL_12
GLOBAL &EMIF_EXT_PHY_CONTROL_12_SHADOW
GLOBAL &EMIF_EXT_PHY_CONTROL_13
GLOBAL &EMIF_EXT_PHY_CONTROL_13_SHADOW
GLOBAL &EMIF_EXT_PHY_CONTROL_14
GLOBAL &EMIF_EXT_PHY_CONTROL_14_SHADOW
GLOBAL &EMIF_EXT_PHY_CONTROL_15
GLOBAL &EMIF_EXT_PHY_CONTROL_15_SHADOW
GLOBAL &EMIF_EXT_PHY_CONTROL_16
GLOBAL &EMIF_EXT_PHY_CONTROL_16_SHADOW
GLOBAL &EMIF_EXT_PHY_CONTROL_17
GLOBAL &EMIF_EXT_PHY_CONTROL_17_SHADOW
GLOBAL &EMIF_EXT_PHY_CONTROL_18
GLOBAL &EMIF_EXT_PHY_CONTROL_18_SHADOW
GLOBAL &EMIF_EXT_PHY_CONTROL_19
GLOBAL &EMIF_EXT_PHY_CONTROL_19_SHADOW
GLOBAL &EMIF_EXT_PHY_CONTROL_20
GLOBAL &EMIF_EXT_PHY_CONTROL_20_SHADOW
GLOBAL &EMIF_EXT_PHY_CONTROL_21
GLOBAL &EMIF_EXT_PHY_CONTROL_21_SHADOW
GLOBAL &EMIF_EXT_PHY_CONTROL_22
GLOBAL &EMIF_EXT_PHY_CONTROL_22_SHADOW
GLOBAL &EMIF_EXT_PHY_CONTROL_23
GLOBAL &EMIF_EXT_PHY_CONTROL_23_SHADOW
GLOBAL &EMIF_EXT_PHY_CONTROL_24
GLOBAL &EMIF_EXT_PHY_CONTROL_24_SHADOW
GLOBAL &EMIF_EXT_PHY_CONTROL_25
GLOBAL &EMIF_EXT_PHY_CONTROL_25_SHADOW
GLOBAL &EMIF_EXT_PHY_CONTROL_26
GLOBAL &EMIF_EXT_PHY_CONTROL_26_SHADOW
GLOBAL &EMIF_EXT_PHY_CONTROL_27
GLOBAL &EMIF_EXT_PHY_CONTROL_27_SHADOW
GLOBAL &EMIF_EXT_PHY_CONTROL_28
GLOBAL &EMIF_EXT_PHY_CONTROL_28_SHADOW
GLOBAL &EMIF_EXT_PHY_CONTROL_29
GLOBAL &EMIF_EXT_PHY_CONTROL_29_SHADOW
GLOBAL &EMIF_EXT_PHY_CONTROL_30
GLOBAL &EMIF_EXT_PHY_CONTROL_30_SHADOW
GLOBAL &EMIF_EXT_PHY_CONTROL_31
GLOBAL &EMIF_EXT_PHY_CONTROL_31_SHADOW
GLOBAL &EMIF_EXT_PHY_CONTROL_32
GLOBAL &EMIF_EXT_PHY_CONTROL_32_SHADOW
GLOBAL &EMIF_EXT_PHY_CONTROL_33
GLOBAL &EMIF_EXT_PHY_CONTROL_33_SHADOW
GLOBAL &EMIF_EXT_PHY_CONTROL_34
GLOBAL &EMIF_EXT_PHY_CONTROL_34_SHADOW
GLOBAL &EMIF_EXT_PHY_CONTROL_35
GLOBAL &EMIF_EXT_PHY_CONTROL_35_SHADOW
GLOBAL &EMIF_EXT_PHY_CONTROL_36
GLOBAL &EMIF_EXT_PHY_CONTROL_36_SHADOW
GLOBAL &EMIF_MISC_REG
GLOBAL &EMIF_REVISION

GLOBAL &EMIF_SDRAM_REFRESH_CONTROL_INITREF_DIS_MASK
GLOBAL &EMIF_DDR_PHY_CONTROL_1_WRLVL_MASK_MASK
GLOBAL &EMIF_DDR_PHY_CONTROL_1_RDLVLGATE_MASK_MASK
GLOBAL &EMIF_DDR_PHY_CONTROL_1_RDLVL_MASK_MASK
GLOBAL &EMIF_READ_WRITE_LEVELING_RAMP_CONTROL_RDWRLVL_EN_MASK
GLOBAL &EMIF_READ_WRITE_LEVELING_CONTROL_RDWRLVLFULL_START_MASK
GLOBAL &EMIF_ECC_CTRL_REG_REG_ECC_EN_MASK
GLOBAL &EMIF_ECC_CTRL_REG_REG_ECC_ADDR_RGN_PROT_MASK

//DMM
&SOC_DMM_CONF_REGS_BASE=0x4e000000
&SOC_MA_MPU_CONF_REGS_BASE=0x482af000
&LISA_MAP_0=0x40
&LISA_MAP_1=0x44
&LISA_MAP_2=0x48
&LISA_MAP_3=0x4C

//CM WKUP CORE
&SOC_CTRL_MODULE_WKUP_CORE_REGISTERS_BASE=0x4ae0c100
&CTRL_WKUP_EMIF1_SDRAM_CONFIG_EXT=0x44
&CTRL_WKUP_EMIF2_SDRAM_CONFIG_EXT=0x48

//CM CORE CORE PAD
&SOC_CTRL_MODULE_CORE_CORE_PAD_REGISTERS_BASE=0x4a002da0
&CTRL_CORE_CONTROL_DDRCACH1_0=0x90
&CTRL_CORE_CONTROL_DDRCACH2_0=0x94
&CTRL_CORE_CONTROL_DDRCH1_0=0x98
&CTRL_CORE_CONTROL_DDRCH1_1=0x9c
&CTRL_CORE_CONTROL_DDRCH2_0=0xa0
&CTRL_CORE_CONTROL_DDRCH2_1=0xa4
&CTRL_CORE_CONTROL_DDRCH1_2=0xa8
&CTRL_CORE_CONTROL_DDRCH2_2=0xac
&CTRL_CORE_CONTROL_DDRIO_0=0xb0
&CTRL_CORE_CONTROL_DDRIO_1=0xb4

//CM CORE AON
&SOC_CKGEN_CM_CORE_AON_BASE=0x4a005100
&CM_DLL_CTRL=0x10

//PRM
&SOC_DEVICE_PRM_BASE=0x4ae07d00
&PRM_RSTST=0x4
&PRM_RSTST_GLOBAL_WARM_SW_RST_MASK=0x00000002
&PRM_RSTST_EXTERNAL_WARM_RST_MASK=0x00000020

//EMIF
&SOC_EMIF1_CONF_REGS_BASE=0x4c000000
&SOC_EMIF2_CONF_REGS_BASE=0x4d000000

&EMIF_STATUS=0x4
&EMIF_SDRAM_CONFIG=0x8
&EMIF_SDRAM_CONFIG_2=0xc
&EMIF_SDRAM_REFRESH_CONTROL=0x10
&EMIF_SDRAM_REFRESH_CONTROL_SHADOW=0x14
&EMIF_SDRAM_TIMING_1=0x18
&EMIF_SDRAM_TIMING_1_SHADOW=0x1c
&EMIF_SDRAM_TIMING_2=0x20
&EMIF_SDRAM_TIMING_2_SHADOW=0x24
&EMIF_SDRAM_TIMING_3=0x28
&EMIF_SDRAM_TIMING_3_SHADOW=0x2c
&EMIF_LPDDR2_NVM_TIMING=0x30
&EMIF_LPDDR2_NVM_TIMING_SHADOW=0x34
&EMIF_POWER_MANAGEMENT_CONTROL=0x38
&EMIF_POWER_MANAGEMENT_CONTROL_SHADOW=0x3c
&EMIF_LPDDR2_MODE_REG_DATA=0x40
&EMIF_LPDDR2_MODE_REG_CONFIG=0x50
&EMIF_OCP_CONFIG=0x54
&EMIF_OCP_CONFIG_VALUE_1=0x58
&EMIF_OCP_CONFIG_VALUE_2=0x5c
&EMIF_IODFT_TLGC=0x60
&EMIF_PERFORMANCE_COUNTER_1=0x80
&EMIF_PERFORMANCE_COUNTER_2=0x84
&EMIF_PERFORMANCE_COUNTER_CONFIG=0x88
&EMIF_PERFORMANCE_COUNTER_MASTER_REGION_SELECT=0x8c
&EMIF_PERFORMANCE_COUNTER_TIME=0x90
&EMIF_DLL_CALIB_CTRL=0x98
&EMIF_DLL_CALIB_CTRL_SHADOW=0x9c
&EMIF_SYSTEM_OCP_INTERRUPT_RAW_STATUS=0xa4
&EMIF_SYSTEM_OCP_INTERRUPT_STATUS=0xac
&EMIF_SYSTEM_OCP_INTERRUPT_ENABLE_SET=0xb4
&EMIF_SYSTEM_OCP_INTERRUPT_ENABLE_CLEAR=0xbc
&EMIF_SDRAM_OUTPUT_IMPEDANCE_CALIBRATION_CONFIG=0xc8
&EMIF_TEMPERATURE_ALERT_CONFIG=0xcc
&EMIF_OCP_ERROR_LOG=0xd0
&EMIF_READ_WRITE_LEVELING_RAMP_WINDOW=0xd4
&EMIF_READ_WRITE_LEVELING_RAMP_CONTROL=0xd8
&EMIF_READ_WRITE_LEVELING_CONTROL=0xdc
&EMIF_DDR_PHY_CONTROL_1=0xe4
&EMIF_DDR_PHY_CONTROL_1_SHADOW=0xe8
&EMIF_DDR_PHY_CONTROL_2=0xec
&EMIF_PRIORITY_TO_CLASS_OF_SERVICE_MAPPING=0x100
&EMIF_CONNECTION_ID_TO_CLASS_OF_SERVICE_1_MAPPING=0x104
&EMIF_CONNECTION_ID_TO_CLASS_OF_SERVICE_2_MAPPING=0x108
&EMIF_ECC_CTRL_REG=0x110
&EMIF_ECC_ADDRESS_RANGE_1=0x114
&EMIF_ECC_ADDRESS_RANGE_2=0x118
&EMIF_READ_WRITE_EXECUTION_THRESHOLD=0x120
&EMIF_COS_CONFIG=0x124
&EMIF_1B_ECC_ERR_CNT=0x130
&EMIF_1B_ECC_ERR_THRSH=0x134
&EMIF_1B_ECC_ERR_DIST_1=0x138
&EMIF_1B_ECC_ERR_ADDR_LOG=0x13c
&EMIF_2B_ECC_ERR_ADDR_LOG=0x140
&EMIF_PHY_STATUS_1=0x144
&EMIF_PHY_STATUS_7=0x15C
&EMIF_PHY_STATUS_8=0x160
&EMIF_PHY_STATUS_9=0x164
&EMIF_PHY_STATUS_10=0x168
&EMIF_PHY_STATUS_11=0x16C
&EMIF_PHY_STATUS_12=0x170
&EMIF_PHY_STATUS_13=0x174
&EMIF_PHY_STATUS_14=0x178
&EMIF_PHY_STATUS_15=0x17C
&EMIF_PHY_STATUS_16=0x180
&EMIF_PHY_STATUS_17=0x184
&EMIF_PHY_STATUS_18=0x188
&EMIF_PHY_STATUS_19=0x18C
&EMIF_PHY_STATUS_20=0x190
&EMIF_PHY_STATUS_21=0x194
&EMIF_PHY_STATUS_22=0x198
&EMIF_PHY_STATUS_23=0x19C
&EMIF_PHY_STATUS_24=0x1A0
&EMIF_PHY_STATUS_25=0x1A4
&EMIF_PHY_STATUS_26=0x1A8
&EMIF_EXT_PHY_CONTROL_1=0x200
&EMIF_EXT_PHY_CONTROL_1_SHADOW=0x204
&EMIF_EXT_PHY_CONTROL_2=0x208
&EMIF_EXT_PHY_CONTROL_2_SHADOW=0x20c
&EMIF_EXT_PHY_CONTROL_3=0x210
&EMIF_EXT_PHY_CONTROL_3_SHADOW=0x214
&EMIF_EXT_PHY_CONTROL_4=0x218
&EMIF_EXT_PHY_CONTROL_4_SHADOW=0x21c
&EMIF_EXT_PHY_CONTROL_5=0x220
&EMIF_EXT_PHY_CONTROL_5_SHADOW=0x224
&EMIF_EXT_PHY_CONTROL_6=0x228
&EMIF_EXT_PHY_CONTROL_6_SHADOW=0x22c
&EMIF_EXT_PHY_CONTROL_7=0x230
&EMIF_EXT_PHY_CONTROL_7_SHADOW=0x234
&EMIF_EXT_PHY_CONTROL_8=0x238
&EMIF_EXT_PHY_CONTROL_8_SHADOW=0x23c
&EMIF_EXT_PHY_CONTROL_9=0x240
&EMIF_EXT_PHY_CONTROL_9_SHADOW=0x244
&EMIF_EXT_PHY_CONTROL_10=0x248
&EMIF_EXT_PHY_CONTROL_10_SHADOW=0x24c
&EMIF_EXT_PHY_CONTROL_11=0x250
&EMIF_EXT_PHY_CONTROL_11_SHADOW=0x254
&EMIF_EXT_PHY_CONTROL_12=0x258
&EMIF_EXT_PHY_CONTROL_12_SHADOW=0x25c
&EMIF_EXT_PHY_CONTROL_13=0x260
&EMIF_EXT_PHY_CONTROL_13_SHADOW=0x264
&EMIF_EXT_PHY_CONTROL_14=0x268
&EMIF_EXT_PHY_CONTROL_14_SHADOW=0x26c
&EMIF_EXT_PHY_CONTROL_15=0x270
&EMIF_EXT_PHY_CONTROL_15_SHADOW=0x274
&EMIF_EXT_PHY_CONTROL_16=0x278
&EMIF_EXT_PHY_CONTROL_16_SHADOW=0x27c
&EMIF_EXT_PHY_CONTROL_17=0x280
&EMIF_EXT_PHY_CONTROL_17_SHADOW=0x284
&EMIF_EXT_PHY_CONTROL_18=0x288
&EMIF_EXT_PHY_CONTROL_18_SHADOW=0x28c
&EMIF_EXT_PHY_CONTROL_19=0x290
&EMIF_EXT_PHY_CONTROL_19_SHADOW=0x294
&EMIF_EXT_PHY_CONTROL_20=0x298
&EMIF_EXT_PHY_CONTROL_20_SHADOW=0x29c
&EMIF_EXT_PHY_CONTROL_21=0x2a0
&EMIF_EXT_PHY_CONTROL_21_SHADOW=0x2a4
&EMIF_EXT_PHY_CONTROL_22=0x2a8
&EMIF_EXT_PHY_CONTROL_22_SHADOW=0x2ac
&EMIF_EXT_PHY_CONTROL_23=0x2b0
&EMIF_EXT_PHY_CONTROL_23_SHADOW=0x2b4
&EMIF_EXT_PHY_CONTROL_24=0x2b8
&EMIF_EXT_PHY_CONTROL_24_SHADOW=0x2bc
&EMIF_EXT_PHY_CONTROL_25=0x2c0
&EMIF_EXT_PHY_CONTROL_25_SHADOW=0x2c4
&EMIF_EXT_PHY_CONTROL_26=0x2c8
&EMIF_EXT_PHY_CONTROL_26_SHADOW=0x2cc
&EMIF_EXT_PHY_CONTROL_27=0x2d0
&EMIF_EXT_PHY_CONTROL_27_SHADOW=0x2d4
&EMIF_EXT_PHY_CONTROL_28=0x2d8
&EMIF_EXT_PHY_CONTROL_28_SHADOW=0x2dc
&EMIF_EXT_PHY_CONTROL_29=0x2e0
&EMIF_EXT_PHY_CONTROL_29_SHADOW=0x2e4
&EMIF_EXT_PHY_CONTROL_30=0x2e8
&EMIF_EXT_PHY_CONTROL_30_SHADOW=0x2ec
&EMIF_EXT_PHY_CONTROL_31=0x2f0
&EMIF_EXT_PHY_CONTROL_31_SHADOW=0x2f4
&EMIF_EXT_PHY_CONTROL_32=0x2f8
&EMIF_EXT_PHY_CONTROL_32_SHADOW=0x2fc
&EMIF_EXT_PHY_CONTROL_33=0x300
&EMIF_EXT_PHY_CONTROL_33_SHADOW=0x304
&EMIF_EXT_PHY_CONTROL_34=0x308
&EMIF_EXT_PHY_CONTROL_34_SHADOW=0x30c
&EMIF_EXT_PHY_CONTROL_35=0x310
&EMIF_EXT_PHY_CONTROL_35_SHADOW=0x314
&EMIF_EXT_PHY_CONTROL_36=0x318
&EMIF_EXT_PHY_CONTROL_36_SHADOW=0x31c
&EMIF_MISC_REG=0x94
&EMIF_REVISION=0x0

&EMIF_SDRAM_REFRESH_CONTROL_INITREF_DIS_MASK=0x80000000
&EMIF_DDR_PHY_CONTROL_1_WRLVL_MASK_MASK=0x02000000
&EMIF_DDR_PHY_CONTROL_1_RDLVLGATE_MASK_MASK=0x04000000
&EMIF_DDR_PHY_CONTROL_1_RDLVL_MASK_MASK=0x08000000
&EMIF_READ_WRITE_LEVELING_RAMP_CONTROL_RDWRLVL_EN_MASK=0x80000000
&EMIF_READ_WRITE_LEVELING_CONTROL_RDWRLVLFULL_START_MASK=0x80000000
&EMIF_ECC_CTRL_REG_REG_ECC_EN_MASK=0x80000000
&EMIF_ECC_CTRL_REG_REG_ECC_ADDR_RGN_PROT_MASK=0x40000000
