; --------------------------------------------------------------------------------
; @Title: Setup Script for AM572x : am572x_prcm_config.cmm
; @Description: see "am572x_hardware_init.cmm"
; @Keywords: AM57xx
; @Author: jvogl
; @Board: AM572x EVM
; @Chip: AM572x
; @Copyright: (C) 1989-2019 Lauterbach GmbH, licensed for use with TRACE32(R) only
; --------------------------------------------------------------------------------
; $Id: am572x_prcm_config.2.cmm 15893 2020-03-31 07:11:47Z jvogl $

// DPLL Definitions
&DPLL_TIMEOUT=(5)
&CM_CLKMODE_DPLL =(0x00)
&CM_IDLEST_DPLL  =(0x04)
&CM_AUTOIDLE_DPLL=(0x08)
&CM_CLKSEL_DPLL  =(0x0C)
&CM_DIV_M2_DPLL  =(0x10)
&CM_DIV_M3_DPLL  =(0x14)
&CM_DIV_H11_DPLL =(0x18)
&CM_DIV_H12_DPLL =(0x1C)
&CM_DIV_H13_DPLL =(0x20)
&CM_DIV_H14_DPLL =(0x24)
&CM_DIV_H21_DPLL =(0x30)
&CM_DIV_H22_DPLL =(0x34)
&CM_DIV_H23_DPLL =(0x38)
&CM_DIV_H24_DPLL =(0x3C)

// Instance Base Addresses
&CTRL_MODULE_CORE=0x4a002000
&CKGEN_CM_CORE_AON=0x4a005100
&MPU_CM_CORE_AON=0x4a005300
&DSP1_CM_CORE_AON=0x4a005400
&IPU_CM_CORE_AON=0x4a005500
&DSP2_CM_CORE_AON=0x4a005600
&RTC_CM_CORE_AON=0x4a005740
&VPE_CM_CORE_AON=0x4a005760
&CKGEN_CM_CORE=0x4a008100
&COREAON_CM_CORE=0x4a008600
&CORE_CM_CORE=0x4a008700
&IVA_CM_CORE=0x4a008f00
&CAM_CM_CORE=0x4a009000
&DSS_CM_CORE=0x4a009100
&GPU_CM_CORE=0x4a009200
&L3INIT_CM_CORE=0x4a009300
&L4PER_CM_CORE=0x4a009700
&CKGEN_PRM=0x4ae06100
&WKUPAON_CM=0x4ae07800
&EMU_CM=0x4ae07a00

// CLKSTCTRL offsets
&CORE_CM_CORE__CM_L3MAIN1_CLKSTCTRL=0x000
&CORE_CM_CORE__CM_IPU2_CLKSTCTRL=0x200
&CORE_CM_CORE__CM_DMA_CLKSTCTRL=0x300
&CORE_CM_CORE__CM_EMIF_CLKSTCTRL=0x400
&CORE_CM_CORE__CM_L4CFG_CLKSTCTRL=0x600
&COREAON_CM_CORE__CM_COREAON_CLKSTCTRL=0x00
&DSP1_CM_CORE_AON__CM_DSP1_CLKSTCTRL=0x00
&DSP2_CM_CORE_AON__CM_DSP2_CLKSTCTRL=0x00
&DSS_CM_CORE__CM_DSS_CLKSTCTRL=0x00
&GPU_CM_CORE__CM_GPU_CLKSTCTRL=0x00
&IPU_CM_CORE_AON__CM_IPU1_CLKSTCTRL=0x00
&IPU_CM_CORE_AON__CM_IPU_CLKSTCTRL=0x40
&IVA_CM_CORE__CM_IVA_CLKSTCTRL=0x00
&CAM_CM_CORE__CM_CAM_CLKSTCTRL=0x00
&L3INIT_CM_CORE__CM_L3INIT_CLKSTCTRL=0x00
&L3INIT_CM_CORE__CM_PCIE_CLKSTCTRL=0xA0
&L3INIT_CM_CORE__CM_GMAC_CLKSTCTRL=0xC0
&L4PER_CM_CORE__CM_L4PER_CLKSTCTRL=0x000
&L4PER_CM_CORE__CM_L4PER2_CLKSTCTRL=0x1FC
&L4PER_CM_CORE__CM_L4PER3_CLKSTCTRL=0x210
&MPU_CM_CORE_AON__CM_MPU_CLKSTCTRL=0x00
&RTC_CM_CORE_AON__CM_RTC_CLKSTCTRL=0x00
&VPE_CM_CORE_AON__CM_VPE_CLKSTCTRL=0x00
&WKUPAON_CM__CM_WKUPAON_CLKSTCTRL=0x00

// CLKSTCTRL modes
&SW_SLEEP=(0x1)
&SW_WKUP=(0x2)
&HW_AUTO=(0x3)

&CLKSTCTRL_TIMEOUOT=100ms

// CLKCTRL Offsets
&CAM_CM_CORE__CM_CAM_VIP1_CLKCTRL=0x020
&CAM_CM_CORE__CM_CAM_VIP2_CLKCTRL=0x028
&CAM_CM_CORE__CM_CAM_VIP3_CLKCTRL=0x030
&CORE_CM_CORE__CM_L3MAIN1_L3_MAIN_1_CLKCTRL=0x020
&CORE_CM_CORE__CM_L3MAIN1_GPMC_CLKCTRL=0x028
&CORE_CM_CORE__CM_L3MAIN1_MMU_EDMA_CLKCTRL=0x030
&CORE_CM_CORE__CM_L3MAIN1_MMU_PCIESS_CLKCTRL=0x048
&CORE_CM_CORE__CM_L3MAIN1_OCMC_RAM1_CLKCTRL=0x050
&CORE_CM_CORE__CM_L3MAIN1_OCMC_RAM2_CLKCTRL=0x058
&CORE_CM_CORE__CM_L3MAIN1_OCMC_RAM3_CLKCTRL=0x060
&CORE_CM_CORE__CM_L3MAIN1_OCMC_ROM_CLKCTRL=0x068
&CORE_CM_CORE__CM_L3MAIN1_TPCC_CLKCTRL=0x070
&CORE_CM_CORE__CM_L3MAIN1_TPTC1_CLKCTRL=0x078
&CORE_CM_CORE__CM_L3MAIN1_TPTC2_CLKCTRL=0x080
&CORE_CM_CORE__CM_IPU2_IPU2_CLKCTRL=0x220
&CORE_CM_CORE__CM_DMA_DMA_SYSTEM_CLKCTRL=0x320
&CORE_CM_CORE__CM_EMIF_DMM_CLKCTRL=0x420
&CORE_CM_CORE__CM_EMIF_EMIF_OCP_FW_CLKCTRL=0x428
&CORE_CM_CORE__CM_EMIF_EMIF1_CLKCTRL=0x430
&CORE_CM_CORE__CM_EMIF_EMIF2_CLKCTRL=0x438
&CORE_CM_CORE__CM_L4CFG_L4_CFG_CLKCTRL=0x620
&CORE_CM_CORE__CM_L4CFG_SPINLOCK_CLKCTRL=0x628
&CORE_CM_CORE__CM_L4CFG_MAILBOX1_CLKCTRL=0x630
&CORE_CM_CORE__CM_L4CFG_MAILBOX2_CLKCTRL=0x648
&CORE_CM_CORE__CM_L4CFG_MAILBOX3_CLKCTRL=0x650
&CORE_CM_CORE__CM_L4CFG_MAILBOX4_CLKCTRL=0x658
&CORE_CM_CORE__CM_L4CFG_MAILBOX5_CLKCTRL=0x660
&CORE_CM_CORE__CM_L4CFG_MAILBOX6_CLKCTRL=0x668
&CORE_CM_CORE__CM_L4CFG_MAILBOX7_CLKCTRL=0x670
&CORE_CM_CORE__CM_L4CFG_MAILBOX8_CLKCTRL=0x678
&CORE_CM_CORE__CM_L4CFG_MAILBOX9_CLKCTRL=0x680
&CORE_CM_CORE__CM_L4CFG_MAILBOX10_CLKCTRL=0x688
&CORE_CM_CORE__CM_L4CFG_MAILBOX11_CLKCTRL=0x690
&CORE_CM_CORE__CM_L4CFG_MAILBOX12_CLKCTRL=0x698
&CORE_CM_CORE__CM_L4CFG_MAILBOX13_CLKCTRL=0x6A0
&CORE_CM_CORE__CM_L3INSTR_L3_MAIN_2_CLKCTRL=0x720
&DSS_CM_CORE__CM_DSS_DSS_CLKCTRL=0x020
&GPU_CM_CORE__CM_GPU_GPU_CLKCTRL=0x020
&EMU_CM__CM_EMU_MPU_EMU_DBG_CLKCTRL=0x00C
&IPU_CM_CORE_AON__CM_IPU1_IPU1_CLKCTRL=0x020
&IPU_CM_CORE_AON__CM_IPU_MCASP1_CLKCTRL=0x050
&IPU_CM_CORE_AON__CM_IPU_TIMER5_CLKCTRL=0x058
&IPU_CM_CORE_AON__CM_IPU_TIMER6_CLKCTRL=0x060
&IPU_CM_CORE_AON__CM_IPU_TIMER7_CLKCTRL=0x068
&IPU_CM_CORE_AON__CM_IPU_TIMER8_CLKCTRL=0x070
&IVA_CM_CORE__CM_IVA_IVA_CLKCTRL=0x020
&IVA_CM_CORE__CM_IVA_SL2_CLKCTRL=0x028
&L3INIT_CM_CORE__CM_L3INIT_MMC1_CLKCTRL=0x028
&L3INIT_CM_CORE__CM_L3INIT_MMC2_CLKCTRL=0x030
&L3INIT_CM_CORE__CM_L3INIT_IEEE1500_2_OCP_CLKCTRL=0x078
&L3INIT_CM_CORE__CM_PCIE_PCIESS1_CLKCTRL=0x0B0
&L3INIT_CM_CORE__CM_GMAC_GMAC_CLKCTRL=0x0D0
&L3INIT_CM_CORE__CM_L3INIT_OCP2SCP1_CLKCTRL=0x0E0
&L3INIT_CM_CORE__CM_L3INIT_OCP2SCP3_CLKCTRL=0x0E8
&L4PER_CM_CORE__CM_L4PER2_L4_PER2_CLKCTRL=0x00C
&L4PER_CM_CORE__CM_L4PER3_L4_PER3_CLKCTRL=0x014
&L4PER_CM_CORE__CM_L4PER_TIMER10_CLKCTRL=0x028
&L4PER_CM_CORE__CM_L4PER_TIMER11_CLKCTRL=0x030
&L4PER_CM_CORE__CM_L4PER_TIMER2_CLKCTRL=0x038
&L4PER_CM_CORE__CM_L4PER_TIMER3_CLKCTRL=0x040
&L4PER_CM_CORE__CM_L4PER_TIMER4_CLKCTRL=0x048
&L4PER_CM_CORE__CM_L4PER_TIMER9_CLKCTRL=0x050
&L4PER_CM_CORE__CM_L4PER_GPIO2_CLKCTRL=0x060
&L4PER_CM_CORE__CM_L4PER_GPIO3_CLKCTRL=0x068
&L4PER_CM_CORE__CM_L4PER_GPIO4_CLKCTRL=0x070
&L4PER_CM_CORE__CM_L4PER_GPIO5_CLKCTRL=0x078
&L4PER_CM_CORE__CM_L4PER_GPIO6_CLKCTRL=0x080
&L4PER_CM_CORE__CM_L4PER_I2C1_CLKCTRL=0x0A0
&L4PER_CM_CORE__CM_L4PER_I2C2_CLKCTRL=0x0A8
&L4PER_CM_CORE__CM_L4PER_I2C3_CLKCTRL=0x0B0
&L4PER_CM_CORE__CM_L4PER_I2C4_CLKCTRL=0x0B8
&L4PER_CM_CORE__CM_L4PER_L4_PER1_CLKCTRL=0x0C0
&L4PER_CM_CORE__CM_L4PER3_TIMER13_CLKCTRL=0x0C8
&L4PER_CM_CORE__CM_L4PER3_TIMER14_CLKCTRL=0x0D0
&L4PER_CM_CORE__CM_L4PER3_TIMER15_CLKCTRL=0x0D8
&L4PER_CM_CORE__CM_L4PER_MCSPI1_CLKCTRL=0x0F0
&L4PER_CM_CORE__CM_L4PER_GPIO7_CLKCTRL=0x110
&L4PER_CM_CORE__CM_L4PER_GPIO8_CLKCTRL=0x118
&L4PER_CM_CORE__CM_L4PER_MMC3_CLKCTRL=0x120
&L4PER_CM_CORE__CM_L4PER_MMC4_CLKCTRL=0x128
&L4PER_CM_CORE__CM_L4PER3_TIMER16_CLKCTRL=0x130
&L4PER_CM_CORE__CM_L4PER2_QSPI_CLKCTRL=0x138
&L4PER_CM_CORE__CM_L4PER_UART1_CLKCTRL=0x140
&L4PER_CM_CORE__CM_L4PER_UART3_CLKCTRL=0x150
&MPU_CM_CORE_AON__CM_MPU_MPU_CLKCTRL=0x020
&MPU_CM_CORE_AON__CM_MPU_MPU_MPU_DBG_CLKCTRL=0x028
&VPE_CM_CORE_AON__CM_VPE_VPE_CLKCTRL=0x004
&WKUPAON_CM__CM_WKUPAON_WD_TIMER1_CLKCTRL=0x028
&WKUPAON_CM__CM_WKUPAON_WD_TIMER2_CLKCTRL=0x030
&WKUPAON_CM__CM_WKUPAON_GPIO1_CLKCTRL=0x038
&WKUPAON_CM__CM_WKUPAON_TIMER1_CLKCTRL=0x040
&WKUPAON_CM__CM_WKUPAON_TIMER12_CLKCTRL=0x048
&WKUPAON_CM__CM_WKUPAON_UART10_CLKCTRL=0x080

// CLKCTRL modes
&MODE_DISABLED=(0x0)
&MODE_AUTO=(0x1)
&MODE_ENABLED=(0x2)

&CLKCTRL_TIMEOUOT=100ms

// Various register address definitions
&CM_CLKSEL_CORE=(&CKGEN_CM_CORE_AON+0x000)
&CM_CLKSEL_ABE=(&CKGEN_CM_CORE_AON+0x008)
&CM_DLL_CTRL=(&CKGEN_CM_CORE_AON+0x010)
&CM_CLKMODE_DPLL_CORE=(&CKGEN_CM_CORE_AON+0x020)
&CM_CLKSEL_DPLL_CORE=(&CKGEN_CM_CORE_AON+0x02C)
&CM_CLKMODE_DPLL_MPU=(&CKGEN_CM_CORE_AON+0x060)
&CM_CLKMODE_DPLL_IVA=(&CKGEN_CM_CORE_AON+0x0A0)
&CM_CLKMODE_DPLL_ABE=(&CKGEN_CM_CORE_AON+0x0E0)
&CM_CLKMODE_DPLL_DDR=(&CKGEN_CM_CORE_AON+0x110)
&CM_CLKMODE_DPLL_DSP=(&CKGEN_CM_CORE_AON+0x134)
&CM_CLKMODE_DPLL_GMAC=(&CKGEN_CM_CORE_AON+0x1A8)
&CM_CLKMODE_DPLL_GPU=(&CKGEN_CM_CORE_AON+0x1D8)
&CM_CLKMODE_DPLL_PER=(&CKGEN_CM_CORE+0x040)
&CM_CLKMODE_DPLL_PCIE_REF=(&CKGEN_CM_CORE+0x100)
&CM_SYS_CLKSEL=(&CKGEN_PRM+0x010)

&CTRL_CORE_CONTROL_IO_2=(&CTRL_MODULE_CORE+0x558)

;GOSUB AM572x_PRCM_Clock_Config_OPPNOM
GOSUB AM572x_PRCM_Module_AllEnable_Config

ENDDO

AM572x_PRCM_Module_AllEnable_Config:
(
	PRINT "--->>> PRCM Configuration for all modules in progress... <<<---"

	// PRCM clock domain state setting functions
	GOSUB prcm_set_clkdomain_state "&CAM_CM_CORE"       "&CAM_CM_CORE__CM_CAM_CLKSTCTRL"          "&SW_WKUP"
	GOSUB prcm_set_clkdomain_state "&L4PER_CM_CORE"     "&L4PER_CM_CORE__CM_L4PER_CLKSTCTRL"      "&SW_WKUP"
	GOSUB prcm_set_clkdomain_state "&L4PER_CM_CORE"     "&L4PER_CM_CORE__CM_L4PER2_CLKSTCTRL"     "&SW_WKUP"
	GOSUB prcm_set_clkdomain_state "&L4PER_CM_CORE"     "&L4PER_CM_CORE__CM_L4PER3_CLKSTCTRL"     "&SW_WKUP"
	GOSUB prcm_set_clkdomain_state "&L3INIT_CM_CORE"    "&L3INIT_CM_CORE__CM_L3INIT_CLKSTCTRL"    "&SW_WKUP"
	GOSUB prcm_set_clkdomain_state "&L3INIT_CM_CORE"    "&L3INIT_CM_CORE__CM_GMAC_CLKSTCTRL"      "&SW_WKUP"
	GOSUB prcm_set_clkdomain_state "&CORE_CM_CORE"      "&CORE_CM_CORE__CM_EMIF_CLKSTCTRL"        "&SW_WKUP"
	GOSUB prcm_set_clkdomain_state "&CORE_CM_CORE"      "&CORE_CM_CORE__CM_L4CFG_CLKSTCTRL"       "&SW_WKUP"
	GOSUB prcm_set_clkdomain_state "&CORE_CM_CORE"      "&CORE_CM_CORE__CM_DMA_CLKSTCTRL"         "&SW_WKUP"
	GOSUB prcm_set_clkdomain_state "&CORE_CM_CORE"      "&CORE_CM_CORE__CM_L3MAIN1_CLKSTCTRL"     "&SW_WKUP"
	GOSUB prcm_set_clkdomain_state "&CORE_CM_CORE"      "&CORE_CM_CORE__CM_IPU2_CLKSTCTRL"        "&SW_WKUP"
	GOSUB prcm_set_clkdomain_state "&COREAON_CM_CORE"   "&COREAON_CM_CORE__CM_COREAON_CLKSTCTRL"  "&SW_WKUP"
	GOSUB prcm_set_clkdomain_state "&DSS_CM_CORE"       "&DSS_CM_CORE__CM_DSS_CLKSTCTRL"          "&SW_WKUP"
	GOSUB prcm_set_clkdomain_state "&IPU_CM_CORE_AON"   "&IPU_CM_CORE_AON__CM_IPU1_CLKSTCTRL"     "&SW_WKUP"
	GOSUB prcm_set_clkdomain_state "&IPU_CM_CORE_AON"   "&IPU_CM_CORE_AON__CM_IPU_CLKSTCTRL"      "&SW_WKUP"
	GOSUB prcm_set_clkdomain_state "&RTC_CM_CORE_AON"   "&RTC_CM_CORE_AON__CM_RTC_CLKSTCTRL"      "&SW_WKUP"
	GOSUB prcm_set_clkdomain_state "&VPE_CM_CORE_AON"   "&VPE_CM_CORE_AON__CM_VPE_CLKSTCTRL"      "&SW_WKUP"
	GOSUB prcm_set_clkdomain_state "&WKUPAON_CM"        "&WKUPAON_CM__CM_WKUPAON_CLKSTCTRL"       "&SW_WKUP"
	GOSUB prcm_set_clkdomain_state "&MPU_CM_CORE_AON"   "&MPU_CM_CORE_AON__CM_MPU_CLKSTCTRL"      "&SW_WKUP"
	GOSUB prcm_set_clkdomain_state "&DSP1_CM_CORE_AON"  "&DSP1_CM_CORE_AON__CM_DSP1_CLKSTCTRL"    "&SW_WKUP"
	GOSUB prcm_set_clkdomain_state "&DSP2_CM_CORE_AON"  "&DSP2_CM_CORE_AON__CM_DSP2_CLKSTCTRL"    "&SW_WKUP"
	GOSUB prcm_set_clkdomain_state "&IVA_CM_CORE"       "&IVA_CM_CORE__CM_IVA_CLKSTCTRL"          "&SW_WKUP"

	// PRCM Generic module mode setting functions
	GOSUB prcm_set_module_mode "&CAM_CM_CORE"       "&CAM_CM_CORE__CM_CAM_VIP1_CLKCTRL"               "&MODE_AUTO"      "0x00000000" "0x00000000"
	GOSUB prcm_set_module_mode "&CAM_CM_CORE"       "&CAM_CM_CORE__CM_CAM_VIP2_CLKCTRL"               "&MODE_AUTO"      "0x00000000" "0x00000000"
	GOSUB prcm_set_module_mode "&CAM_CM_CORE"       "&CAM_CM_CORE__CM_CAM_VIP3_CLKCTRL"               "&MODE_AUTO"      "0x00000000" "0x00000000"
	GOSUB prcm_set_module_mode "&CORE_CM_CORE"      "&CORE_CM_CORE__CM_DMA_DMA_SYSTEM_CLKCTRL"        "&MODE_AUTO"      "0x00000000" "0x00000000"
	GOSUB prcm_set_module_mode "&CORE_CM_CORE"      "&CORE_CM_CORE__CM_EMIF_DMM_CLKCTRL"              "&MODE_AUTO"      "0x00000000" "0x00000000"
	GOSUB prcm_set_module_mode "&CORE_CM_CORE"      "&CORE_CM_CORE__CM_EMIF_EMIF1_CLKCTRL"            "&MODE_AUTO"      "0x00000000" "0x00000000"
	GOSUB prcm_set_module_mode "&CORE_CM_CORE"      "&CORE_CM_CORE__CM_EMIF_EMIF2_CLKCTRL"            "&MODE_AUTO"      "0x00000000" "0x00000000"
	GOSUB prcm_set_module_mode "&CORE_CM_CORE"      "&CORE_CM_CORE__CM_EMIF_EMIF_OCP_FW_CLKCTRL"      "&MODE_AUTO"      "0x00000000" "0x00000000"
	GOSUB prcm_set_module_mode "&CORE_CM_CORE"      "&CORE_CM_CORE__CM_L3INSTR_L3_MAIN_2_CLKCTRL"     "&MODE_AUTO"      "0x00000000" "0x00000000"
	GOSUB prcm_set_module_mode "&CORE_CM_CORE"      "&CORE_CM_CORE__CM_L3MAIN1_GPMC_CLKCTRL"          "&MODE_AUTO"      "0x00000000" "0x00000000"
	GOSUB prcm_set_module_mode "&CORE_CM_CORE"      "&CORE_CM_CORE__CM_L3MAIN1_L3_MAIN_1_CLKCTRL"     "&MODE_AUTO"      "0x00000000" "0x00000000"
	GOSUB prcm_set_module_mode "&CORE_CM_CORE"      "&CORE_CM_CORE__CM_L3MAIN1_MMU_EDMA_CLKCTRL"      "&MODE_AUTO"      "0x00000000" "0x00000000"
	GOSUB prcm_set_module_mode "&CORE_CM_CORE"      "&CORE_CM_CORE__CM_L3MAIN1_MMU_PCIESS_CLKCTRL"    "&MODE_AUTO"      "0x00000000" "0x00000000"
	GOSUB prcm_set_module_mode "&CORE_CM_CORE"      "&CORE_CM_CORE__CM_L3MAIN1_OCMC_RAM1_CLKCTRL"     "&MODE_AUTO"      "0x00000000" "0x00000000"
	GOSUB prcm_set_module_mode "&CORE_CM_CORE"      "&CORE_CM_CORE__CM_L3MAIN1_OCMC_RAM2_CLKCTRL"     "&MODE_AUTO"      "0x00000000" "0x00000000"
	GOSUB prcm_set_module_mode "&CORE_CM_CORE"      "&CORE_CM_CORE__CM_L3MAIN1_OCMC_RAM3_CLKCTRL"     "&MODE_AUTO"      "0x00000000" "0x00000000"
	GOSUB prcm_set_module_mode "&CORE_CM_CORE"      "&CORE_CM_CORE__CM_L3MAIN1_OCMC_ROM_CLKCTRL"      "&MODE_AUTO"      "0x00000000" "0x00000000"
	GOSUB prcm_set_module_mode "&CORE_CM_CORE"      "&CORE_CM_CORE__CM_L3MAIN1_TPCC_CLKCTRL"          "&MODE_AUTO"      "0x00000000" "0x00000000"
	GOSUB prcm_set_module_mode "&CORE_CM_CORE"      "&CORE_CM_CORE__CM_L3MAIN1_TPTC1_CLKCTRL"         "&MODE_AUTO"      "0x00000000" "0x00000000"
	GOSUB prcm_set_module_mode "&CORE_CM_CORE"      "&CORE_CM_CORE__CM_L3MAIN1_TPTC2_CLKCTRL"         "&MODE_AUTO"      "0x00000000" "0x00000000" 
	GOSUB prcm_set_module_mode "&CORE_CM_CORE"      "&CORE_CM_CORE__CM_L4CFG_L4_CFG_CLKCTRL"          "&MODE_AUTO"      "0x00000000" "0x00000000"
	GOSUB prcm_set_module_mode "&CORE_CM_CORE"      "&CORE_CM_CORE__CM_L4CFG_MAILBOX1_CLKCTRL"        "&MODE_AUTO"      "0x00000000" "0x00000000"
	GOSUB prcm_set_module_mode "&CORE_CM_CORE"      "&CORE_CM_CORE__CM_L4CFG_MAILBOX10_CLKCTRL"       "&MODE_AUTO"      "0x00000000" "0x00000000"
	GOSUB prcm_set_module_mode "&CORE_CM_CORE"      "&CORE_CM_CORE__CM_L4CFG_MAILBOX11_CLKCTRL"       "&MODE_AUTO"      "0x00000000" "0x00000000"
	GOSUB prcm_set_module_mode "&CORE_CM_CORE"      "&CORE_CM_CORE__CM_L4CFG_MAILBOX12_CLKCTRL"       "&MODE_AUTO"      "0x00000000" "0x00000000"
	GOSUB prcm_set_module_mode "&CORE_CM_CORE"      "&CORE_CM_CORE__CM_L4CFG_MAILBOX13_CLKCTRL"       "&MODE_AUTO"      "0x00000000" "0x00000000"
	GOSUB prcm_set_module_mode "&CORE_CM_CORE"      "&CORE_CM_CORE__CM_L4CFG_MAILBOX2_CLKCTRL"        "&MODE_AUTO"      "0x00000000" "0x00000000"
	GOSUB prcm_set_module_mode "&CORE_CM_CORE"      "&CORE_CM_CORE__CM_L4CFG_MAILBOX3_CLKCTRL"        "&MODE_AUTO"      "0x00000000" "0x00000000"
	GOSUB prcm_set_module_mode "&CORE_CM_CORE"      "&CORE_CM_CORE__CM_L4CFG_MAILBOX4_CLKCTRL"        "&MODE_AUTO"      "0x00000000" "0x00000000"
	GOSUB prcm_set_module_mode "&CORE_CM_CORE"      "&CORE_CM_CORE__CM_L4CFG_MAILBOX5_CLKCTRL"        "&MODE_AUTO"      "0x00000000" "0x00000000"
	GOSUB prcm_set_module_mode "&CORE_CM_CORE"      "&CORE_CM_CORE__CM_L4CFG_MAILBOX6_CLKCTRL"        "&MODE_AUTO"      "0x00000000" "0x00000000"
	GOSUB prcm_set_module_mode "&CORE_CM_CORE"      "&CORE_CM_CORE__CM_L4CFG_MAILBOX7_CLKCTRL"        "&MODE_AUTO"      "0x00000000" "0x00000000"
	GOSUB prcm_set_module_mode "&CORE_CM_CORE"      "&CORE_CM_CORE__CM_L4CFG_MAILBOX8_CLKCTRL"        "&MODE_AUTO"      "0x00000000" "0x00000000"
	GOSUB prcm_set_module_mode "&CORE_CM_CORE"      "&CORE_CM_CORE__CM_L4CFG_MAILBOX9_CLKCTRL"        "&MODE_AUTO"      "0x00000000" "0x00000000"
	GOSUB prcm_set_module_mode "&CORE_CM_CORE"      "&CORE_CM_CORE__CM_L4CFG_SPINLOCK_CLKCTRL"        "&MODE_AUTO"      "0x00000000" "0x00000000"
;	GOSUB prcm_set_module_mode "&IPU_CM_CORE_AON"   "&IPU_CM_CORE_AON__CM_IPU_MCASP1_CLKCTRL"         "&MODE_ENABLED"   "0x00000000" "0x00000000"
	GOSUB prcm_set_module_mode "&IPU_CM_CORE_AON"   "&IPU_CM_CORE_AON__CM_IPU_TIMER5_CLKCTRL"         "&MODE_ENABLED"   "0x00000000" "0x00000000"
	GOSUB prcm_set_module_mode "&IPU_CM_CORE_AON"   "&IPU_CM_CORE_AON__CM_IPU_TIMER6_CLKCTRL"         "&MODE_ENABLED"   "0x00000000" "0x00000000"
	GOSUB prcm_set_module_mode "&IPU_CM_CORE_AON"   "&IPU_CM_CORE_AON__CM_IPU_TIMER7_CLKCTRL"         "&MODE_ENABLED"   "0x00000000" "0x00000000"
	GOSUB prcm_set_module_mode "&IPU_CM_CORE_AON"   "&IPU_CM_CORE_AON__CM_IPU_TIMER8_CLKCTRL"         "&MODE_ENABLED"   "0x00000000" "0x00000000"
	GOSUB prcm_set_module_mode "&L3INIT_CM_CORE"    "&L3INIT_CM_CORE__CM_L3INIT_MMC1_CLKCTRL"         "&MODE_ENABLED"   "0x00000000" "0x00000000"
	GOSUB prcm_set_module_mode "&L3INIT_CM_CORE"    "&L3INIT_CM_CORE__CM_L3INIT_MMC2_CLKCTRL"         "&MODE_ENABLED"   "0x00000000" "0x00000000"
	GOSUB prcm_set_module_mode "&L3INIT_CM_CORE"    "&L3INIT_CM_CORE__CM_GMAC_GMAC_CLKCTRL"           "&MODE_ENABLED"   "0x00000000" "0x00000000"
	GOSUB prcm_set_module_mode "&L4PER_CM_CORE"     "&L4PER_CM_CORE__CM_L4PER2_L4_PER2_CLKCTRL"       "&MODE_AUTO"      "0x00000000" "0x00000000"
	GOSUB prcm_set_module_mode "&L4PER_CM_CORE"     "&L4PER_CM_CORE__CM_L4PER3_L4_PER3_CLKCTRL"       "&MODE_AUTO"      "0x00000000" "0x00000000"
	GOSUB prcm_set_module_mode "&L4PER_CM_CORE"     "&L4PER_CM_CORE__CM_L4PER3_TIMER13_CLKCTRL"       "&MODE_ENABLED"   "0x00000000" "0x00000000"
	GOSUB prcm_set_module_mode "&L4PER_CM_CORE"     "&L4PER_CM_CORE__CM_L4PER3_TIMER14_CLKCTRL"       "&MODE_ENABLED"   "0x00000000" "0x00000000"
	GOSUB prcm_set_module_mode "&L4PER_CM_CORE"     "&L4PER_CM_CORE__CM_L4PER3_TIMER15_CLKCTRL"       "&MODE_ENABLED"   "0x00000000" "0x00000000"
	GOSUB prcm_set_module_mode "&L4PER_CM_CORE"     "&L4PER_CM_CORE__CM_L4PER3_TIMER16_CLKCTRL"       "&MODE_ENABLED"   "0x00000000" "0x00000000"
	GOSUB prcm_set_module_mode "&L4PER_CM_CORE"     "&L4PER_CM_CORE__CM_L4PER_GPIO2_CLKCTRL"          "&MODE_AUTO"      "0x00000000" "0x00000000"
	GOSUB prcm_set_module_mode "&L4PER_CM_CORE"     "&L4PER_CM_CORE__CM_L4PER_GPIO3_CLKCTRL"          "&MODE_AUTO"      "0x00000000" "0x00000000"
	GOSUB prcm_set_module_mode "&L4PER_CM_CORE"     "&L4PER_CM_CORE__CM_L4PER_GPIO4_CLKCTRL"          "&MODE_AUTO"      "0x00000000" "0x00000000"
	GOSUB prcm_set_module_mode "&L4PER_CM_CORE"     "&L4PER_CM_CORE__CM_L4PER_GPIO5_CLKCTRL"          "&MODE_AUTO"      "0x00000000" "0x00000000"
	GOSUB prcm_set_module_mode "&L4PER_CM_CORE"     "&L4PER_CM_CORE__CM_L4PER_GPIO6_CLKCTRL"          "&MODE_AUTO"      "0x00000000" "0x00000000"
	GOSUB prcm_set_module_mode "&L4PER_CM_CORE"     "&L4PER_CM_CORE__CM_L4PER_GPIO7_CLKCTRL"          "&MODE_AUTO"      "0x00000000" "0x00000000"
	GOSUB prcm_set_module_mode "&L4PER_CM_CORE"     "&L4PER_CM_CORE__CM_L4PER_GPIO8_CLKCTRL"          "&MODE_AUTO"      "0x00000000" "0x00000000"
	GOSUB prcm_set_module_mode "&L4PER_CM_CORE"     "&L4PER_CM_CORE__CM_L4PER_I2C1_CLKCTRL"           "&MODE_ENABLED"   "0x00000000" "0x00000000"
	GOSUB prcm_set_module_mode "&L4PER_CM_CORE"     "&L4PER_CM_CORE__CM_L4PER_I2C2_CLKCTRL"           "&MODE_ENABLED"   "0x00000000" "0x00000000"
	GOSUB prcm_set_module_mode "&L4PER_CM_CORE"     "&L4PER_CM_CORE__CM_L4PER_I2C3_CLKCTRL"           "&MODE_ENABLED"   "0x00000000" "0x00000000"
	GOSUB prcm_set_module_mode "&L4PER_CM_CORE"     "&L4PER_CM_CORE__CM_L4PER_I2C4_CLKCTRL"           "&MODE_ENABLED"   "0x00000000" "0x00000000"
	GOSUB prcm_set_module_mode "&L4PER_CM_CORE"     "&L4PER_CM_CORE__CM_L4PER_L4_PER1_CLKCTRL"        "&MODE_AUTO"      "0x00000000" "0x00000000"
	GOSUB prcm_set_module_mode "&L4PER_CM_CORE"     "&L4PER_CM_CORE__CM_L4PER_MCSPI1_CLKCTRL"         "&MODE_ENABLED"   "0x00000000" "0x00000000"
	GOSUB prcm_set_module_mode "&L4PER_CM_CORE"     "&L4PER_CM_CORE__CM_L4PER_MMC3_CLKCTRL"           "&MODE_ENABLED"   "0x00000000" "0x00000000"
	GOSUB prcm_set_module_mode "&L4PER_CM_CORE"     "&L4PER_CM_CORE__CM_L4PER_MMC4_CLKCTRL"           "&MODE_ENABLED"   "0x00000000" "0x00000000"
	GOSUB prcm_set_module_mode "&L4PER_CM_CORE"     "&L4PER_CM_CORE__CM_L4PER_TIMER10_CLKCTRL"        "&MODE_ENABLED"   "0x00000000" "0x00000000"
	GOSUB prcm_set_module_mode "&L4PER_CM_CORE"     "&L4PER_CM_CORE__CM_L4PER_TIMER11_CLKCTRL"        "&MODE_ENABLED"   "0x00000000" "0x00000000"
	GOSUB prcm_set_module_mode "&L4PER_CM_CORE"     "&L4PER_CM_CORE__CM_L4PER_TIMER2_CLKCTRL"         "&MODE_ENABLED"   "0x00000000" "0x00000000"
	GOSUB prcm_set_module_mode "&L4PER_CM_CORE"     "&L4PER_CM_CORE__CM_L4PER_TIMER3_CLKCTRL"         "&MODE_ENABLED"   "0x00000000" "0x00000000"
	GOSUB prcm_set_module_mode "&L4PER_CM_CORE"     "&L4PER_CM_CORE__CM_L4PER_TIMER4_CLKCTRL"         "&MODE_ENABLED"   "0x00000000" "0x00000000"
	GOSUB prcm_set_module_mode "&L4PER_CM_CORE"     "&L4PER_CM_CORE__CM_L4PER_TIMER9_CLKCTRL"         "&MODE_ENABLED"   "0x00000000" "0x00000000"
	GOSUB prcm_set_module_mode "&L4PER_CM_CORE"     "&L4PER_CM_CORE__CM_L4PER2_QSPI_CLKCTRL"          "&MODE_ENABLED"   "0x05000000" "0x07000000"
	GOSUB prcm_set_module_mode "&L4PER_CM_CORE"     "&L4PER_CM_CORE__CM_L4PER_UART1_CLKCTRL"          "&MODE_ENABLED"   "0x00000000" "0x00000000"
	GOSUB prcm_set_module_mode "&L4PER_CM_CORE"     "&L4PER_CM_CORE__CM_L4PER_UART3_CLKCTRL"          "&MODE_ENABLED"   "0x00000000" "0x00000000"
	GOSUB prcm_set_module_mode "&MPU_CM_CORE_AON"   "&MPU_CM_CORE_AON__CM_MPU_MPU_CLKCTRL"            "&MODE_ENABLED"   "0x00000000" "0x00000000"
	GOSUB prcm_set_module_mode "&VPE_CM_CORE_AON"   "&VPE_CM_CORE_AON__CM_VPE_VPE_CLKCTRL"            "&MODE_AUTO"      "0x00000000" "0x00000000"
	GOSUB prcm_set_module_mode "&WKUPAON_CM"        "&WKUPAON_CM__CM_WKUPAON_GPIO1_CLKCTRL"           "&MODE_AUTO"      "0x00000000" "0x00000000"
	GOSUB prcm_set_module_mode "&WKUPAON_CM"        "&WKUPAON_CM__CM_WKUPAON_TIMER1_CLKCTRL"          "&MODE_ENABLED"   "0x00000000" "0x00000000"
	GOSUB prcm_set_module_mode "&WKUPAON_CM"        "&WKUPAON_CM__CM_WKUPAON_TIMER12_CLKCTRL"         "&MODE_ENABLED"   "0x00000000" "0x00000000"
	GOSUB prcm_set_module_mode "&WKUPAON_CM"        "&WKUPAON_CM__CM_WKUPAON_WD_TIMER1_CLKCTRL"       "&MODE_ENABLED"   "0x00000000" "0x00000000"
	GOSUB prcm_set_module_mode "&WKUPAON_CM"        "&WKUPAON_CM__CM_WKUPAON_WD_TIMER2_CLKCTRL"       "&MODE_ENABLED"   "0x00000000" "0x00000000"

	// PRCM Specialized module mode setting functions
	GOSUB prcm_set_proc_mode "&IVA_CM_CORE"         "&IVA_CM_CORE__CM_IVA_SL2_CLKCTRL"                "&MODE_AUTO"
	GOSUB prcm_set_proc_mode "&IVA_CM_CORE"         "&IVA_CM_CORE__CM_IVA_IVA_CLKCTRL"                "&MODE_AUTO"
	GOSUB prcm_set_proc_mode "&CORE_CM_CORE"        "&CORE_CM_CORE__CM_IPU2_IPU2_CLKCTRL"             "&MODE_AUTO"
	GOSUB prcm_set_dss_mode  "&DSS_CM_CORE"         "&DSS_CM_CORE__CM_DSS_DSS_CLKCTRL"                "&MODE_ENABLED"
	GOSUB prcm_set_ipu1_mode "&IPU_CM_CORE_AON"     "&IPU_CM_CORE_AON__CM_IPU1_IPU1_CLKCTRL"          "&MODE_AUTO"

	PRINT "--->>> PRCM Configuration for all modules is DONE! <<<---"
	PRINT

	RETURN
)

prcm_set_dss_mode:
(
	PARAMETERS &MODULE_BASE &MODULE_OFFSET &MODE

	PRINT "module_base:   0x" %Hex &MODULE_BASE
	PRINT "module_offset: 0x" %Hex &MODULE_OFFSET

	// DESHDCP Clock ENABLE for DSS
	Data.Set AD:&CTRL_CORE_CONTROL_IO_2 %Long Data.Long(AD:&CTRL_CORE_CONTROL_IO_2)|0x1

	&MODULE_ADDRESS=&MODULE_BASE+&MODULE_OFFSET
	Data.Set AD:&MODULE_ADDRESS %Long (Data.Long(AD:&MODULE_ADDRESS)&~0x3)|0x00003F00|&MODE

	PRINT "	Waiting for DSS module IDLE status...."
	WAIT (Data.Long(AD:&MODULE_ADDRESS)&0x00030000)==0 &CLKCTRL_TIMEOUOT
	IF (Data.Long(AD:&MODULE_ADDRESS)&0x00030000)==0
	(
		PRINT "	DONE"
	)
	ELSE
	(
		PRINT %ERROR "module_base:   0x" %Hex &MODULE_BASE
		PRINT %ERROR "module_offset: 0x" %Hex &MODULE_OFFSET
		PRINT %ERROR "	TIMEOUT"
		STOP
	)

	RETURN
)

prcm_set_proc_mode:
(
	PARAMETERS &MODULE_BASE &MODULE_OFFSET &MODE

	PRINT "module_base:   0x" %Hex &MODULE_BASE
	PRINT "module_offset: 0x" %Hex &MODULE_OFFSET

	&MODULE_ADDRESS=&MODULE_BASE+&MODULE_OFFSET
	Data.Set AD:&MODULE_ADDRESS %Long (Data.Long(AD:&MODULE_ADDRESS)&~0x3)|&MODE

	WAIT (Data.Long(AD:&MODULE_ADDRESS)&0x00030000)!=0x00030000 &CLKCTRL_TIMEOUOT
	IF (Data.Long(AD:&MODULE_ADDRESS)&0x00030000)!=0x00030000
	(
		PRINT "	DONE"
	)
	ELSE
	(
		PRINT %ERROR "module_base:   0x" %Hex &MODULE_BASE
		PRINT %ERROR "module_offset: 0x" %Hex &MODULE_OFFSET
		PRINT %ERROR "	TIMEOUT"
		STOP
	)

	RETURN
)

prcm_set_ipu1_mode:
(
	PARAMETERS &MODULE_BASE &MODULE_OFFSET &MODE

	PRINT "module_base:   0x" %Hex &MODULE_BASE
	PRINT "module_offset: 0x" %Hex &MODULE_OFFSET

	&MODULE_ADDRESS=&MODULE_BASE+&MODULE_OFFSET
	Data.Set AD:&MODULE_ADDRESS %Long (Data.Long(AD:&MODULE_ADDRESS)&~0x3)|0x01000000|&MODE

	PRINT "	Waiting for IPU1 module IDLE status...."
	WAIT (Data.Long(AD:&MODULE_ADDRESS)&0x00030000)!=0x00030000 &CLKCTRL_TIMEOUOT
	
	IF (Data.Long(AD:&MODULE_ADDRESS)&0x00030000)!=0x00030000
	(
		PRINT "	DONE"
	)
	ELSE
	(
		PRINT %ERROR "module_base:   0x" %Hex &MODULE_BASE
		PRINT %ERROR "module_offset: 0x" %Hex &MODULE_OFFSET
		PRINT %ERROR "	TIMEOUT"
		STOP
	)

	RETURN
)

prcm_set_module_mode:
(
	PARAMETERS &MODULE_BASE &MODULE_OFFSET &MODE &EXTRABITS &EXTRABITSMASK

	PRINT "module_base:   0x" %Hex &MODULE_BASE
	PRINT "module_offset: 0x" %Hex &MODULE_OFFSET

	&MODULE_ADDRESS=&MODULE_BASE+&MODULE_OFFSET
	Data.Set AD:&MODULE_ADDRESS %Long (Data.Long(AD:&MODULE_ADDRESS)&~(&EXTRABITSMASK|0x00000003))|(&MODE&0x3)

	PRINT "	Waiting for module IDLE status...."
	WAIT (Data.Long(AD:&MODULE_ADDRESS)&0x00030000)==0 &CLKCTRL_TIMEOUOT

	IF (Data.Long(AD:&MODULE_ADDRESS)&0x00030000)==0
	(
		PRINT "	DONE"
	)
	ELSE
	(
		PRINT %ERROR "module_base:   0x" %Hex &MODULE_BASE
		PRINT %ERROR "module_offset: 0x" %Hex &MODULE_OFFSET
		PRINT %ERROR "	TIMEOUT"
		STOP
	)

	RETURN
)

prcm_set_clkdomain_state:
(
	PARAMETERS &MODULE_BASE &MODULE_OFFSET &STATE

	PRINT "module_base:   " %Hex &MODULE_BASE
	PRINT "module_offset: " %Hex &MODULE_OFFSET

	&MODULE_ADDRESS=&MODULE_BASE+&MODULE_OFFSET
	Data.Set AD:&MODULE_ADDRESS %Long (Data.Long(AD:&MODULE_ADDRESS)&~(0x3))|(&STATE&0x3)

	RETURN
)

AM572x_PRCM_Clock_Config_OPPNOM:
(
	GOSUB AM572x_PRCM_Clock_Config_API "OPP_NOM" "DEVICE_AM572X_GP"

	RETURN
)

AM572x_PRCM_Clock_Config_API:
(
	PARAMETERS &OPP &DEVICE_TYPE

	PRINT "--->>> PRCM Clock Configuration for OPPNOM in progress... <<<---"
	IF "&OPP"!="OPP_NOM"
	(
		PRINT "	!!!Only DPLL configuration is done!!!"
		PRINT "	!!!Voltage changes for non-NOMinal OPP needs to be done externally!!!"
	)

	// DDR DPLL programming is NOT done here, but is called from the DDR config commands

	// DPLL programming
;	 GOSUB dpll_a15_opp_config "&OPP" "&DEVICE_TYPE"

	// IVA clock programming
;	 GOSUB dpll_iva_opp_config "&OPP" "&DEVICE_TYPE"

	// PER DPLL programming
;	 GOSUB dpll_per_opp_config "&OPP" "&DEVICE_TYPE"

	// Core DPLL programming
;	 GOSUB dpll_core_opp_config "&OPP" "&DEVICE_TYPE"

	// ABE DPLL programming
;	 GOSUB dpll_abe_opp_config "&OPP" "&DEVICE_TYPE"

	// GMAC DPLL programming
	 GOSUB dpll_gmac_config "&OPP" "&DEVICE_TYPE"

	// GPU DPLL programming
;	 GOSUB dpll_gpu_config "&OPP" "&DEVICE_TYPE"

	// DSP DPLL programming
;	 GOSUB dpll_dsp_config "&OPP" "&DEVICE_TYPE"

	// PCIE DPLL programming
;	 GOSUB dpll_pcie_config "&OPP" "&DEVICE_TYPE"

	PRINT "--->>> PRCM Clock Configuration for OPP " "&OPP" " is DONE! <<<---"
	
	RETURN
)

//******************************************************************************
// dpll_gmac_config() : GMAC DPLL configuration
//******************************************************************************
dpll_gmac_config:
(
	PARAMETERS &OPP &DEVICE_TYPE

	PRINT "	GMAC DPLL OPP " "&OPP" " clock config is in progress..."

	IF (Data.Long(AD:&CM_CLKMODE_DPLL_GMAC+&CM_IDLEST_DPLL)&0x1)==0x1
	(
		PRINT "	GMAC DPLL already locked, now unlocking...."
		GOSUB dpll_unlock_sequence "&CM_CLKMODE_DPLL_GMAC"
	)

	// CM_CLKSEL_DPLL_GMAC DPLL MULT
	Data.Set AD:(&CM_CLKMODE_DPLL_GMAC+&CM_CLKSEL_DPLL) %Long 0xFA04

	// CM_DIV_M2_DPLL_GMAC
	Data.Set AD:(&CM_CLKMODE_DPLL_GMAC+&CM_DIV_M2_DPLL) %Long 0x4

	// CM_DIV_M3_DPLL_GMAC
	Data.Set AD:(&CM_CLKMODE_DPLL_GMAC+&CM_DIV_M3_DPLL) %Long 0xA

	// CM_DIV_H11_DPLL_GMAC
	Data.Set AD:(&CM_CLKMODE_DPLL_GMAC+&CM_DIV_H11_DPLL) %Long 0x28

	// CM_DIV_H12_DPLL_GMAC
	Data.Set AD:(&CM_CLKMODE_DPLL_GMAC+&CM_DIV_H12_DPLL) %Long 0x8

	// CM_DIV_H13_DPLL_GMAC
	Data.Set AD:(&CM_CLKMODE_DPLL_GMAC+&CM_DIV_H13_DPLL) %Long 0xA

	GOSUB dpll_lock_sequence "&CM_CLKMODE_DPLL_GMAC"

	PRINT "	GMAC DPLL OPP " "&OPP" " is DONE!"

	RETURN
)

//******************************************************************************
// dpll_lock_sequence() : DPLL lock sequence
//******************************************************************************
dpll_lock_sequence:
(
	PARAMETERS &BASE_ADDRESS

	// Put DPLL into lock mode
	Data.Set AD:(&BASE_ADDRESS+&CM_CLKMODE_DPLL) %Long 0x7

	// Wait for DPLL to be locked
	&TIMEOUT=&DPLL_TIMEOUT
	WHILE ((Data.Long(AD:&BASE_ADDRESS+&CM_IDLEST_DPLL)&0x1)!=0x1)&&(&TIMEOUT>0)
	(
		&TIMEOUT=&TIMEOUT-1
	)

	IF &TIMEOUT==0
	(
		PRINT %ERROR "	ERROR: timeout while unlocking DPLL"
		STOP
		PLIST
	)

	RETURN
)

//******************************************************************************
// dpll_unlock_sequence() : DPLL unlock sequence
//******************************************************************************
dpll_unlock_sequence:
(
	PARAMETERS &BASE_ADDRESS

	// Take DPLL out of lock mode
	Data.Set AD:(&BASE_ADDRESS+&CM_CLKMODE_DPLL) %Long Data.Long(AD:&BASE_ADDRESS+&CM_CLKMODE_DPLL)&~0x1

	// Wait for DPLL to be unlocked
	&TIMEOUT=&DPLL_TIMEOUT
	WHILE ((Data.Long(AD:&BASE_ADDRESS+&CM_IDLEST_DPLL)&0x1)!=0x0)&&(&TIMEOUT>0)
	(
		&TIMEOUT=&TIMEOUT-1
	)

	IF &TIMEOUT==0
	(
		PRINT %ERROR "	ERROR: timeout while unlocking DPLL"
		STOP
		PLIST
	)

	RETURN
)

ENDDO
