; --------------------------------------------------------------------------------
; @Title: Setup Script for AM572x : am572x_ddr_config.cmm
; @Description: see "am572x_hardware_init.cmm"
; @Keywords: AM57xx
; @Author: YDA
; @Board: AM572x EVM
; @Chip: AM572x
; @Copyright: (C) 1989-2019 Lauterbach GmbH, licensed for use with TRACE32(R) only
; --------------------------------------------------------------------------------
; $Id: am572x_ddr_config.cmm 15217 2019-11-04 16:17:15Z bschroefel $

 LOCAL &RDWR_LVL_RMP_CTRL
 LOCAL &EMIF_PHY_HALF_DELAY_MODE
 LOCAL &EMIF_PHY_DIS_CALIB_RST
 LOCAL &EMIF_PHY_INVERT_CLKOUT
 LOCAL &EMIF_PHY_DLL_LOCK_DIFF
 LOCAL &EMIF_PHY_FAST_DLL_LOCK
 LOCAL &EMIF_PHY_READ_LATENCY
 LOCAL &EMIF_PHY_USE_RANK0_DELAYS

 LOCAL &EMIF_PHY_CTRL_SLAVE_RATIO
 LOCAL &EMIF_PHY_DQ_OFFSET
 LOCAL &EMIF_PHY_GATELVL_INIT_MODE
 LOCAL &EMIF_PHY_FIFO_WE_IN_DELAY
 LOCAL &EMIF_PHY_CTRL_SLAVE_DELAY
 LOCAL &EMIF_PHY_RD_DQS_SLAVE_DELAY
 LOCAL &EMIF_PHY_WR_DQS_SLAVE_DELAY
 LOCAL &EMIF_PHY_WR_DATA_SLAVE_DELAY
 LOCAL &EMIF_PHY_LEVLELING_DISABLED

 LOCAL &SDRAM_TIM_1
 LOCAL &SDRAM_TIM_2
 LOCAL &SDRAM_TIM_3

 LOCAL &PWR_MGMT_CTRL
 LOCAL &OCP_CONFIG
 LOCAL &IODFT_TLGC
 LOCAL &DLL_CALIB_CTRL
 LOCAL &ZQ_CONFIG
 LOCAL &RDWR_LVL_RMP_WIN

 LOCAL &DDR_PHY_CTRL_2
 LOCAL &PRI_COS_MAP
 LOCAL &CONNID_COS_1_MAP
 LOCAL &CONNID_COS_2_MAP
 LOCAL &RD_WR_EXEC_THRSH
 LOCAL &COS_CONFIG

 LOCAL &EXT_PHY_CTRL_1
 LOCAL &EXT_PHY_CTRL_2
 LOCAL &EXT_PHY_CTRL_3
 LOCAL &EXT_PHY_CTRL_4
 LOCAL &EXT_PHY_CTRL_5
 LOCAL &EXT_PHY_CTRL_6

 LOCAL &EXT_PHY_CTRL_7
 LOCAL &EXT_PHY_CTRL_8
 LOCAL &EXT_PHY_CTRL_9
 LOCAL &EXT_PHY_CTRL_10
 LOCAL &EXT_PHY_CTRL_11

 LOCAL &EXT_PHY_CTRL_12
 LOCAL &EXT_PHY_CTRL_13
 LOCAL &EXT_PHY_CTRL_14
 LOCAL &EXT_PHY_CTRL_15
 LOCAL &EXT_PHY_CTRL_16

//EMIF_PHY_WR_DQS_SLAVE_RATIO
 LOCAL &EXT_PHY_CTRL_17
 LOCAL &EXT_PHY_CTRL_18
 LOCAL &EXT_PHY_CTRL_19
 LOCAL &EXT_PHY_CTRL_20
 LOCAL &EXT_PHY_CTRL_21

//EMIF_PHY_GATELVL_INIT_RATIO
 LOCAL &EXT_PHY_CTRL_26
 LOCAL &EXT_PHY_CTRL_27
 LOCAL &EXT_PHY_CTRL_28
 LOCAL &EXT_PHY_CTRL_29
 LOCAL &EXT_PHY_CTRL_30

//EMIF_PHY_WRLVL_INIT_RATIO
 LOCAL &EXT_PHY_CTRL_31
 LOCAL &EXT_PHY_CTRL_32
 LOCAL &EXT_PHY_CTRL_33
 LOCAL &EXT_PHY_CTRL_34
 LOCAL &EXT_PHY_CTRL_35

 LOCAL &EXT_PHY_CTRL_36
 LOCAL &EXT_PHY_CTRL_36

 LOCAL &SDRAM_REF_CTRL
 LOCAL &SDRAM_CONFIG_2
 LOCAL &SDRAM_CONFIG

 LOCAL &DISABLE_READ_LEVELING
 LOCAL &DISABLE_READ_GATE_LEVELING
 LOCAL &DISABLE_WRITE_LEVELING

 LOCAL &SDRAM_TIM_1
 LOCAL &SDRAM_TIM_2
 LOCAL &SDRAM_TIM_3

 LOCAL &SDRAM_REF_CTRL
 LOCAL &SDRAM_CONFIG
 LOCAL &SDRAM_REF_CTRL_INIT

//EMIF_PHY_FIFO_WE_SLAVE_RATIO (RD_DQS_GATE)
 LOCAL &EXT_PHY_CTRL_2
 LOCAL &EXT_PHY_CTRL_3
 LOCAL &EXT_PHY_CTRL_4
 LOCAL &EXT_PHY_CTRL_5
 LOCAL &EXT_PHY_CTRL_6

//EMIF_PHY_RD_DQS_SLAVE_RATIO
 LOCAL &EXT_PHY_CTRL_7
 LOCAL &EXT_PHY_CTRL_8
 LOCAL &EXT_PHY_CTRL_9
 LOCAL &EXT_PHY_CTRL_10
 LOCAL &EXT_PHY_CTRL_11

//EMIF_PHY_WR_DQS_SLAVE_RATIO
 LOCAL &EXT_PHY_CTRL_17
 LOCAL &EXT_PHY_CTRL_18
 LOCAL &EXT_PHY_CTRL_19
 LOCAL &EXT_PHY_CTRL_20
 LOCAL &EXT_PHY_CTRL_21

 LOCAL &SDRAM_TIM_1
 LOCAL &SDRAM_TIM_2
 LOCAL &SDRAM_TIM_3

 LOCAL &SDRAM_REF_CTRL
 LOCAL &SDRAM_CONFIG
 LOCAL &SDRAM_REF_CTRL_INIT

//EMIF_PHY_FIFO_WE_SLAVE_RATIO (RD_DQS_GATE)
 LOCAL &EXT_PHY_CTRL_2
 LOCAL &EXT_PHY_CTRL_3
 LOCAL &EXT_PHY_CTRL_4
 LOCAL &EXT_PHY_CTRL_5
 LOCAL &EXT_PHY_CTRL_6

//EMIF_PHY_RD_DQS_SLAVE_RATIO
 LOCAL &EXT_PHY_CTRL_7
 LOCAL &EXT_PHY_CTRL_8
 LOCAL &EXT_PHY_CTRL_9
 LOCAL &EXT_PHY_CTRL_10
 LOCAL &EXT_PHY_CTRL_11

//EMIF_PHY_WR_DQS_SLAVE_RATIO
 LOCAL &EXT_PHY_CTRL_17
 LOCAL &EXT_PHY_CTRL_18
 LOCAL &EXT_PHY_CTRL_19
 LOCAL &EXT_PHY_CTRL_20
 LOCAL &EXT_PHY_CTRL_21

 &HW_LEVELING_ENABLED=1
 &IS_EMIF2_AVAILABLE=1
 &ENABLE_ECC=0
 &MEMMAP_2GB_NON_INTL_EMIFX2=0
 &MEMMAP_2GB_INTL_EMIFX2=1

AM572x_DDR3_532MHz_Config:
(
  PRINT " DDR3 Initialization is in progress ..."
//DDR PLL config
  do  ~~~~/am572x_prcm_config.cmm "dpll_ddr_config 532."
  GOSUB AM572x_CM_DDRIO_Config
  GOSUB AM572x_reset_EMIF_params_ddr3_532 &SOC_EMIF1_CONF_REGS_BASE
  GOSUB AM572x_set_emIF1_params_ddr3_532 &SOC_EMIF1_CONF_REGS_BASE
  GOSUB EMIF_Config &SOC_EMIF1_CONF_REGS_BASE &HW_LEVELING_ENABLED &ENABLE_ECC
  IF (1==&IS_EMIF2_AVAILABLE)
  (
    GOSUB AM572x_reset_EMIF_params_ddr3_532 &SOC_EMIF2_CONF_REGS_BASE
    GOSUB AM572x_set_emIF2_params_ddr3_532 &SOC_EMIF2_CONF_REGS_BASE
    GOSUB EMIF_Config &SOC_EMIF2_CONF_REGS_BASE &HW_LEVELING_ENABLED &ENABLE_ECC
  )
  GOSUB AM572x_set_LISA_maps
  PRINT " DDR3 Initialization is DONE!"

ENDDO
)

EMIF_DDR3_UpdateHWLevelOUtpUt_EMIF1:
(
  GOSUB EMIF_DDR3_UpdateHWLevelOUtpUt &SOC_EMIF1_CONF_REGS_BASE
RETURN
)

EMIF_DDR3_UpdateHWLevelOUtpUt_EMIF2:
(
  GOSUB EMIF_DDR3_UpdateHWLevelOUtpUt &SOC_EMIF2_CONF_REGS_BASE
RETURN
)

AM572x_reset_EMIF_params_ddr3_532:
(
ENTRY &base_addr

  &EMIF_PHY_HALF_DELAY_MODE=1
  &EMIF_PHY_DIS_CALIB_RST=0
  &EMIF_PHY_INVERT_CLKOUT=1
  &EMIF_PHY_DLL_LOCK_DIFF=0x10
  &EMIF_PHY_FAST_DLL_LOCK=0
  &EMIF_PHY_READ_LATENCY=0xB

  &EMIF_PHY_USE_RANK0_DELAYS=0x1

  &EMIF_PHY_CTRL_SLAVE_RATIO=0x80
  &EMIF_PHY_DQ_OFFSET=0x40
  &EMIF_PHY_GATELVL_INIT_MODE=0x01
  &EMIF_PHY_FIFO_WE_IN_DELAY=0x00
  &EMIF_PHY_CTRL_SLAVE_DELAY=0x00
  &EMIF_PHY_RD_DQS_SLAVE_DELAY=0x20
  &EMIF_PHY_WR_DQS_SLAVE_DELAY=0x60
  &EMIF_PHY_WR_DATA_SLAVE_DELAY=0x80

  &SDRAM_TIM_1=0xCCCF36AB
  &SDRAM_TIM_2=0x308F7FDA
  &SDRAM_TIM_3=0x409F88A8

  &PWR_MGMT_CTRL=0
  &OCP_CONFIG=0x0A500000
  &IODFT_TLGC=Data.Long(A:&base_addr+&EMIF_IODFT_TLGC)
  &DLL_CALIB_CTRL=0x00050000
  &ZQ_CONFIG=0x5007190B
  &RDWR_LVL_RMP_WIN=Data.Long(A:&base_addr+&EMIF_READ_WRITE_LEVELING_RAMP_WINDOW)

  &DDR_PHY_CTRL_2=Data.Long(A:&base_addr+&EMIF_DDR_PHY_CONTROL_2)
  &PRI_COS_MAP=0
  &CONNID_COS_1_MAP=0
  &CONNID_COS_2_MAP=0
  &RD_WR_EXEC_THRSH=0x00000305
  &COS_CONFIG=0x00FFFFFF

  &temp=0xBB
  &EXT_PHY_CTRL_2=(&temp<<16.)|(&temp<<0)
  &EXT_PHY_CTRL_3=(&temp<<16.)|(&temp<<0)
  &EXT_PHY_CTRL_4=(&temp<<16.)|(&temp<<0)
  &EXT_PHY_CTRL_5=(&temp<<16.)|(&temp<<0)
  &EXT_PHY_CTRL_6=(&temp<<16.)|(&temp<<0)

  &temp=0x44
  &EXT_PHY_CTRL_7=(&temp<<16.)|(&temp<<0)
  &EXT_PHY_CTRL_8=(&temp<<16.)|(&temp<<0)
  &EXT_PHY_CTRL_9=(&temp<<16.)|(&temp<<0)
  &EXT_PHY_CTRL_10=(&temp<<16.)|(&temp<<0)
  &EXT_PHY_CTRL_11=(&temp<<16.)|(&temp<<0)

  &temp=0x7F
  &EXT_PHY_CTRL_12=(&temp<<16.)|(&temp<<0)
  &EXT_PHY_CTRL_13=(&temp<<16.)|(&temp<<0)
  &EXT_PHY_CTRL_14=(&temp<<16.)|(&temp<<0)
  &EXT_PHY_CTRL_15=(&temp<<16.)|(&temp<<0)
  &EXT_PHY_CTRL_16=(&temp<<16.)|(&temp<<0)

//EMIF_PHY_WR_DQS_SLAVE_RATIO
  &temp=0x60
  &EXT_PHY_CTRL_17=(&temp<<16.)|(&temp<<0)
  &EXT_PHY_CTRL_18=(&temp<<16.)|(&temp<<0)
  &EXT_PHY_CTRL_19=(&temp<<16.)|(&temp<<0)
  &EXT_PHY_CTRL_20=(&temp<<16.)|(&temp<<0)
  &EXT_PHY_CTRL_21=(&temp<<16.)|(&temp<<0)

//EMIF_PHY_GATELVL_INIT_RATIO
  &temp=0
  &EXT_PHY_CTRL_26=(&temp<<16.)|(&temp<<0)
  &EXT_PHY_CTRL_27=(&temp<<16.)|(&temp<<0)
  &EXT_PHY_CTRL_28=(&temp<<16.)|(&temp<<0)
  &EXT_PHY_CTRL_29=(&temp<<16.)|(&temp<<0)
  &EXT_PHY_CTRL_30=(&temp<<16.)|(&temp<<0)

//EMIF_PHY_WRLVL_INIT_RATIO
  &temp=0
  &EXT_PHY_CTRL_31=(&temp<<16.)|(&temp<<0)
  &EXT_PHY_CTRL_32=(&temp<<16.)|(&temp<<0)
  &EXT_PHY_CTRL_33=(&temp<<16.)|(&temp<<0)
  &EXT_PHY_CTRL_34=(&temp<<16.)|(&temp<<0)
  &EXT_PHY_CTRL_35=(&temp<<16.)|(&temp<<0)

  &EXT_PHY_CTRL_36=Data.Long(A:&base_addr+&EMIF_EXT_PHY_CONTROL_36)
  &EXT_PHY_CTRL_36=Data.Long(A:&base_addr+&EMIF_EXT_PHY_CONTROL_36_SHADOW)

  &SDRAM_REF_CTRL=0x00001035
  &SDRAM_CONFIG_2=0x08000000
  &SDRAM_CONFIG=0x61851B32

  &DISABLE_READ_LEVELING=0
  &DISABLE_READ_GATE_LEVELING=0
  &DISABLE_WRITE_LEVELING=0

RETURN
)

AM572x_set_emIF1_params_ddr3_532:
(
ENTRY &base_addr

  &SDRAM_TIM_1=0xCCCF36AB
  &SDRAM_TIM_2=0x308F7FDA
  &SDRAM_TIM_3=0x409F88A8

  &SDRAM_REF_CTRL=0x00001035
  &SDRAM_CONFIG=0x61851B32
  &SDRAM_REF_CTRL_INIT=0x000040F1

//EMIF_PHY_FIFO_WE_SLAVE_RATIO (RD_DQS_GATE)
  &EXT_PHY_CTRL_2=0x00910091
  &EXT_PHY_CTRL_3=0x00950095
  &EXT_PHY_CTRL_4=0x009B009B
  &EXT_PHY_CTRL_5=0x009E009E
  &EXT_PHY_CTRL_6=0x00980098

//EMIF_PHY_RD_DQS_SLAVE_RATIO
  &EXT_PHY_CTRL_7=0x00340034
  &EXT_PHY_CTRL_8=0x00350035
  &EXT_PHY_CTRL_9=0x00340034
  &EXT_PHY_CTRL_10=0x00310031
  &EXT_PHY_CTRL_11=0x00340034

//EMIF_PHY_WR_DQS_SLAVE_RATIO
  &EXT_PHY_CTRL_17=0x00480048
  &EXT_PHY_CTRL_18=0x004A004A
  &EXT_PHY_CTRL_19=0x00520052
  &EXT_PHY_CTRL_20=0x00550055
  &EXT_PHY_CTRL_21=0x00500050

RETURN
)

AM572x_set_emIF2_params_ddr3_532:
(
ENTRY &base_addr

  &SDRAM_TIM_1=0xCCCF36AB
  &SDRAM_TIM_2=0x308F7FDA
  &SDRAM_TIM_3=0x409F88A8

  &SDRAM_REF_CTRL=0x00001035
  &SDRAM_CONFIG=0x61851B32
  &SDRAM_REF_CTRL_INIT=0x000040F1

//EMIF_PHY_FIFO_WE_SLAVE_RATIO (RD_DQS_GATE)
  &EXT_PHY_CTRL_2=0x00910091
  &EXT_PHY_CTRL_3=0x00950095
  &EXT_PHY_CTRL_4=0x009B009B
  &EXT_PHY_CTRL_5=0x009E009E
  &EXT_PHY_CTRL_6=0x00980098

//EMIF_PHY_RD_DQS_SLAVE_RATIO
  &EXT_PHY_CTRL_7=0x00330033
  &EXT_PHY_CTRL_8=0x00330033
  &EXT_PHY_CTRL_9=0x002F002F
  &EXT_PHY_CTRL_10=0x00320032
  &EXT_PHY_CTRL_11=0x00310031

//EMIF_PHY_WR_DQS_SLAVE_RATIO
  &EXT_PHY_CTRL_17=0x00520052
  &EXT_PHY_CTRL_18=0x00520052
  &EXT_PHY_CTRL_19=0x00470047
  &EXT_PHY_CTRL_20=0x00490049
  &EXT_PHY_CTRL_21=0x00500050

RETURN
)

AM572x_set_LISA_maps:
(
&memmap_intl_flag=0.

  Data.Set (&SOC_DMM_CONF_REGS_BASE+&LISA_MAP_0) %LE %Long  0
  Data.Set (&SOC_DMM_CONF_REGS_BASE+&LISA_MAP_1) %LE %Long  0
  Data.Set (&SOC_DMM_CONF_REGS_BASE+&LISA_MAP_2) %LE %Long  0
  Data.Set (&SOC_DMM_CONF_REGS_BASE+&LISA_MAP_3) %LE %Long  0
  Data.Set (&SOC_MA_MPU_CONF_REGS_BASE+&LISA_MAP_0) %LE %Long 0
  Data.Set (&SOC_MA_MPU_CONF_REGS_BASE+&LISA_MAP_1) %LE %Long 0
  Data.Set (&SOC_MA_MPU_CONF_REGS_BASE+&LISA_MAP_2) %LE %Long 0
  Data.Set (&SOC_MA_MPU_CONF_REGS_BASE+&LISA_MAP_3) %LE %Long 0

  IF (&MEMMAP_2GB_NON_INTL_EMIFX2!=0)
  (
    Data.Set 0x482AF040 %LE %Long 0x80600100
    Data.Set 0x482AF044 %LE %Long 0xC0600200
    Data.Set 0x4E000040 %LE %Long 0x80600100
    Data.Set 0x4E000044 %LE %Long 0xC0600200
  )

  IF (&MEMMAP_2GB_INTL_EMIFX2!=0)
  (
    //MA_&LISA_MAP_i
	Data.Set 0x482AF040 %LE %Long 0x80740300
	Data.Set 0x482AF044 %LE %Long 0x80740300
    //DMM_&LISA_MAP_i
	Data.Set 0x4E000040 %LE %Long 0x80740300
	Data.Set 0x4E000044 %LE %Long 0x80740300
  )

RETURN
)

AM572x_CM_DDRIO_Config:
(

  Data.Set (&SOC_CKGEN_CM_CORE_AON_BASE+&CM_DLL_CTRL) %LE %Long 0

  Data.Set (&SOC_CTRL_MODULE_CORE_CORE_PAD_REGISTERS_BASE+&CTRL_CORE_CONTROL_DDRCACH1_0) %LE %Long 0x80808080
  Data.Set (&SOC_CTRL_MODULE_CORE_CORE_PAD_REGISTERS_BASE+&CTRL_CORE_CONTROL_DDRCH1_0) %LE %Long 0x40404040
  Data.Set (&SOC_CTRL_MODULE_CORE_CORE_PAD_REGISTERS_BASE+&CTRL_CORE_CONTROL_DDRCH1_1) %LE %Long 0x40404040
  Data.Set (&SOC_CTRL_MODULE_CORE_CORE_PAD_REGISTERS_BASE+&CTRL_CORE_CONTROL_DDRCH1_2) %LE %Long 0x00404000

  Data.Set (&SOC_CTRL_MODULE_CORE_CORE_PAD_REGISTERS_BASE+&CTRL_CORE_CONTROL_DDRCACH2_0) %LE %Long 0x80808080
  Data.Set (&SOC_CTRL_MODULE_CORE_CORE_PAD_REGISTERS_BASE+&CTRL_CORE_CONTROL_DDRCH2_0) %LE %Long 0x40404040
  Data.Set (&SOC_CTRL_MODULE_CORE_CORE_PAD_REGISTERS_BASE+&CTRL_CORE_CONTROL_DDRCH2_1) %LE %Long 0x40404040

  Data.Set (&SOC_CTRL_MODULE_CORE_CORE_PAD_REGISTERS_BASE+&CTRL_CORE_CONTROL_DDRIO_0) %LE %Long 0x00094A40
  Data.Set (&SOC_CTRL_MODULE_CORE_CORE_PAD_REGISTERS_BASE+&CTRL_CORE_CONTROL_DDRIO_1) %LE %Long 0x04A52000

  IF (1==&ENABLE_ECC) //ECC Enabled
  (
    Data.Set (&SOC_CTRL_MODULE_WKUP_CORE_REGISTERS_BASE+&CTRL_WKUP_EMIF1_SDRAM_CONFIG_EXT) %LE %Long 0x0001C127  ; /* EMIF1_EN_ECC=1 */
  )
  ELSE
  (
    Data.Set (&SOC_CTRL_MODULE_WKUP_CORE_REGISTERS_BASE+&CTRL_WKUP_EMIF1_SDRAM_CONFIG_EXT) %LE %Long 0x0000C127  ; /* EMIF1_EN_ECC=0 */
  )

  IF (1==&IS_EMIF2_AVAILABLE)
  (
    Data.Set (&SOC_CTRL_MODULE_WKUP_CORE_REGISTERS_BASE+&CTRL_WKUP_EMIF2_SDRAM_CONFIG_EXT) %LE %Long 0x0000C127
  )
RETURN
)

EMIF_DDR3_UpdateHWLevelOUtpUt:
(
ENTRY &base_addr

  IF (0==&DISABLE_READ_GATE_LEVELING)
  (
//EMIF_PHY_FIFO_WE_SLAVE_RATIO (RD_DQS_GATE)
    Data.Set (&base_addr+&EMIF_EXT_PHY_CONTROL_2) %LE %Long Data.Long(A:&base_addr+&EMIF_PHY_STATUS_12)
    Data.Set (&base_addr+&EMIF_EXT_PHY_CONTROL_2_SHADOW) %LE %Long Data.Long(A:&base_addr+&EMIF_PHY_STATUS_12)
    Data.Set (&base_addr+&EMIF_EXT_PHY_CONTROL_3) %LE %Long Data.Long(A:&base_addr+&EMIF_PHY_STATUS_13)
    Data.Set (&base_addr+&EMIF_EXT_PHY_CONTROL_3_SHADOW) %LE %Long Data.Long(A:&base_addr+&EMIF_PHY_STATUS_13)
    Data.Set (&base_addr+&EMIF_EXT_PHY_CONTROL_4) %LE %Long Data.Long(A:&base_addr+&EMIF_PHY_STATUS_14)
    Data.Set (&base_addr+&EMIF_EXT_PHY_CONTROL_4_SHADOW) %LE %Long Data.Long(A:&base_addr+&EMIF_PHY_STATUS_14)
    Data.Set (&base_addr+&EMIF_EXT_PHY_CONTROL_5) %LE %Long Data.Long(A:&base_addr+&EMIF_PHY_STATUS_15)
    Data.Set (&base_addr+&EMIF_EXT_PHY_CONTROL_5_SHADOW) %LE %Long Data.Long(A:&base_addr+&EMIF_PHY_STATUS_15)
    Data.Set (&base_addr+&EMIF_EXT_PHY_CONTROL_6) %LE %Long Data.Long(A:&base_addr+&EMIF_PHY_STATUS_16)
    Data.Set (&base_addr+&EMIF_EXT_PHY_CONTROL_6_SHADOW) %LE %Long Data.Long(A:&base_addr+&EMIF_PHY_STATUS_16)
  )

  IF (0==&DISABLE_READ_LEVELING)
  (
//EMIF_PHY_RD_DQS_SLAVE_RATIO
    Data.Set (&base_addr+&EMIF_EXT_PHY_CONTROL_7) %LE %Long Data.Long(A:&base_addr+&EMIF_PHY_STATUS_7)
    Data.Set (&base_addr+&EMIF_EXT_PHY_CONTROL_7_SHADOW) %LE %Long Data.Long(A:&base_addr+&EMIF_PHY_STATUS_7)
    Data.Set (&base_addr+&EMIF_EXT_PHY_CONTROL_8) %LE %Long Data.Long(A:&base_addr+&EMIF_PHY_STATUS_8)
    Data.Set (&base_addr+&EMIF_EXT_PHY_CONTROL_8_SHADOW) %LE %Long Data.Long(A:&base_addr+&EMIF_PHY_STATUS_8)
    Data.Set (&base_addr+&EMIF_EXT_PHY_CONTROL_9) %LE %Long Data.Long(A:&base_addr+&EMIF_PHY_STATUS_9)
    Data.Set (&base_addr+&EMIF_EXT_PHY_CONTROL_9_SHADOW) %LE %Long Data.Long(A:&base_addr+&EMIF_PHY_STATUS_9)
    Data.Set (&base_addr+&EMIF_EXT_PHY_CONTROL_10) %LE %Long Data.Long(A:&base_addr+&EMIF_PHY_STATUS_10)
    Data.Set (&base_addr+&EMIF_EXT_PHY_CONTROL_10_SHADOW) %LE %Long Data.Long(A:&base_addr+&EMIF_PHY_STATUS_10)
    Data.Set (&base_addr+&EMIF_EXT_PHY_CONTROL_11) %LE %Long Data.Long(A:&base_addr+&EMIF_PHY_STATUS_11)
    Data.Set (&base_addr+&EMIF_EXT_PHY_CONTROL_11_SHADOW) %LE %Long Data.Long(A:&base_addr+&EMIF_PHY_STATUS_11)
  )

  IF (0==&DISABLE_WRITE_LEVELING)
  (
//EMIF_PHY_WR_DATA_SLAVE_RATIO
    Data.Set (&base_addr+&EMIF_EXT_PHY_CONTROL_12) %LE %Long Data.Long(A:&base_addr+&EMIF_PHY_STATUS_17)
    Data.Set (&base_addr+&EMIF_EXT_PHY_CONTROL_12_SHADOW) %LE %Long Data.Long(A:&base_addr+&EMIF_PHY_STATUS_17)
    Data.Set (&base_addr+&EMIF_EXT_PHY_CONTROL_13) %LE %Long Data.Long(A:&base_addr+&EMIF_PHY_STATUS_18)
    Data.Set (&base_addr+&EMIF_EXT_PHY_CONTROL_13_SHADOW) %LE %Long Data.Long(A:&base_addr+&EMIF_PHY_STATUS_18)
    Data.Set (&base_addr+&EMIF_EXT_PHY_CONTROL_14) %LE %Long Data.Long(A:&base_addr+&EMIF_PHY_STATUS_19)
    Data.Set (&base_addr+&EMIF_EXT_PHY_CONTROL_14_SHADOW) %LE %Long Data.Long(A:&base_addr+&EMIF_PHY_STATUS_19)
    Data.Set (&base_addr+&EMIF_EXT_PHY_CONTROL_15) %LE %Long Data.Long(A:&base_addr+&EMIF_PHY_STATUS_20)
    Data.Set (&base_addr+&EMIF_EXT_PHY_CONTROL_15_SHADOW) %LE %Long Data.Long(A:&base_addr+&EMIF_PHY_STATUS_20)
    Data.Set (&base_addr+&EMIF_EXT_PHY_CONTROL_16) %LE %Long Data.Long(A:&base_addr+&EMIF_PHY_STATUS_21)
    Data.Set (&base_addr+&EMIF_EXT_PHY_CONTROL_16_SHADOW) %LE %Long Data.Long(A:&base_addr+&EMIF_PHY_STATUS_21)

//EMIF_PHY_WR_DQS_SLAVE_RATIO
    Data.Set (&base_addr+&EMIF_EXT_PHY_CONTROL_17) %LE %Long Data.Long(A:&base_addr+&EMIF_PHY_STATUS_22)
    Data.Set (&base_addr+&EMIF_EXT_PHY_CONTROL_17_SHADOW) %LE %Long Data.Long(A:&base_addr+&EMIF_PHY_STATUS_22)
    Data.Set (&base_addr+&EMIF_EXT_PHY_CONTROL_18) %LE %Long Data.Long(A:&base_addr+&EMIF_PHY_STATUS_23)
    Data.Set (&base_addr+&EMIF_EXT_PHY_CONTROL_18_SHADOW) %LE %Long Data.Long(A:&base_addr+&EMIF_PHY_STATUS_23)
    Data.Set (&base_addr+&EMIF_EXT_PHY_CONTROL_19) %LE %Long Data.Long(A:&base_addr+&EMIF_PHY_STATUS_24)
    Data.Set (&base_addr+&EMIF_EXT_PHY_CONTROL_19_SHADOW) %LE %Long Data.Long(A:&base_addr+&EMIF_PHY_STATUS_24)
    Data.Set (&base_addr+&EMIF_EXT_PHY_CONTROL_20) %LE %Long Data.Long(A:&base_addr+&EMIF_PHY_STATUS_25)
    Data.Set (&base_addr+&EMIF_EXT_PHY_CONTROL_20_SHADOW) %LE %Long Data.Long(A:&base_addr+&EMIF_PHY_STATUS_25)
    Data.Set (&base_addr+&EMIF_EXT_PHY_CONTROL_21) %LE %Long Data.Long(A:&base_addr+&EMIF_PHY_STATUS_26)
    Data.Set (&base_addr+&EMIF_EXT_PHY_CONTROL_21_SHADOW) %LE %Long Data.Long(A:&base_addr+&EMIF_PHY_STATUS_26)
  )

  Data.Set (&base_addr+&EMIF_DDR_PHY_CONTROL_1) %LE %Long (Data.Long(A:&base_addr+&EMIF_DDR_PHY_CONTROL_1)|&EMIF_DDR_PHY_CONTROL_1_WRLVL_MASK_MASK|&EMIF_DDR_PHY_CONTROL_1_RDLVLGATE_MASK_MASK|&EMIF_DDR_PHY_CONTROL_1_RDLVL_MASK_MASK)
  Data.Set (&base_addr+&EMIF_DDR_PHY_CONTROL_1_SHADOW) %LE %Long (Data.Long(A:&base_addr+&EMIF_DDR_PHY_CONTROL_1_SHADOW)|&EMIF_DDR_PHY_CONTROL_1_WRLVL_MASK_MASK|&EMIF_DDR_PHY_CONTROL_1_RDLVLGATE_MASK_MASK|&EMIF_DDR_PHY_CONTROL_1_RDLVL_MASK_MASK)
  Data.Set (&base_addr+&EMIF_READ_WRITE_LEVELING_RAMP_CONTROL) %LE %Long 0
RETURN
)

EMIF_Config:
(
ENTRY &base_addr &isHwLevelingEnabledInpUt &isEccEnabled

  &isHwLevelingEnabled=&isHwLevelingEnabledInpUt

  IF (1==&isHwLevelingEnabled)
  (
    &EMIF_PHY_LEVLELING_DISABLED=0
    IF (1==&DISABLE_READ_LEVELING)
    (
      &EMIF_PHY_LEVLELING_DISABLED|=&EMIF_DDR_PHY_CONTROL_1_RDLVL_MASK_MASK
    )
    IF (1==&DISABLE_READ_GATE_LEVELING)
    (
      &EMIF_PHY_LEVLELING_DISABLED|=&EMIF_DDR_PHY_CONTROL_1_RDLVLGATE_MASK_MASK
    )
    IF (1==&DISABLE_WRITE_LEVELING)
    (
      &EMIF_PHY_LEVLELING_DISABLED|=&EMIF_DDR_PHY_CONTROL_1_WRLVL_MASK_MASK
    )
    &RDWR_LVL_RMP_CTRL=&EMIF_READ_WRITE_LEVELING_RAMP_CONTROL_RDWRLVL_EN_MASK
  )
  ELSE
  (
    &EMIF_PHY_LEVLELING_DISABLED=&EMIF_DDR_PHY_CONTROL_1_WRLVL_MASK_MASK|&EMIF_DDR_PHY_CONTROL_1_RDLVLGATE_MASK_MASK|&EMIF_DDR_PHY_CONTROL_1_RDLVL_MASK_MASK
    &RDWR_LVL_RMP_CTRL=0
  )

  &DDR_PHY_CTRL_1=(&EMIF_PHY_READ_LATENCY<<0)|(&EMIF_PHY_FAST_DLL_LOCK<<9.)|(&EMIF_PHY_DLL_LOCK_DIFF<<10.)|(&EMIF_PHY_INVERT_CLKOUT<<18.)|(&EMIF_PHY_DIS_CALIB_RST<<19.)|(&EMIF_PHY_HALF_DELAY_MODE<<21.)|(&EMIF_PHY_LEVLELING_DISABLED)
  &EXT_PHY_CTRL_22=(&EMIF_PHY_FIFO_WE_IN_DELAY<<16.)|(&EMIF_PHY_CTRL_SLAVE_DELAY<<0)
  &EXT_PHY_CTRL_23=(&EMIF_PHY_WR_DQS_SLAVE_DELAY<<16.)|(&EMIF_PHY_RD_DQS_SLAVE_DELAY<<0)
  &EXT_PHY_CTRL_24=(&EMIF_PHY_DQ_OFFSET<<24.)|(&EMIF_PHY_GATELVL_INIT_MODE<<16.)|(&EMIF_PHY_USE_RANK0_DELAYS<<12.)|(&EMIF_PHY_WR_DATA_SLAVE_DELAY<<0)
  &EXT_PHY_CTRL_25=(&EMIF_PHY_DQ_OFFSET<<21.)|(&EMIF_PHY_DQ_OFFSET<<14.)|(&EMIF_PHY_DQ_OFFSET<<7.)|(&EMIF_PHY_DQ_OFFSET<<0)

  IF (0!=(Data.Long(A:&SOC_DEVICE_PRM_BASE+&PRM_RSTST)&(&PRM_RSTST_GLOBAL_WARM_SW_RST_MASK|&PRM_RSTST_EXTERNAL_WARM_RST_MASK)))
  (
    Data.Set (&base_addr+&EMIF_IODFT_TLGC) %LE %Long (Data.Long(A:&base_addr+&EMIF_IODFT_TLGC)|0x400)
  )

  IF (1==&EMIF_PHY_INVERT_CLKOUT)
  (
    &EXT_PHY_CTRL_1=((&EMIF_PHY_CTRL_SLAVE_RATIO+0x80)<<20.)|((&EMIF_PHY_CTRL_SLAVE_RATIO+0x80)<<10.)|((&EMIF_PHY_CTRL_SLAVE_RATIO+0x80)<<0)
  )
  ELSE
  (
    &EXT_PHY_CTRL_1=(&EMIF_PHY_CTRL_SLAVE_RATIO<<20.)|(&EMIF_PHY_CTRL_SLAVE_RATIO<<10.)|(&EMIF_PHY_CTRL_SLAVE_RATIO<<0)
  )
  Data.Set (&base_addr+&EMIF_EXT_PHY_CONTROL_1) %LE %Long &EXT_PHY_CTRL_1
  Data.Set (&base_addr+&EMIF_EXT_PHY_CONTROL_1_SHADOW) %LE %Long &EXT_PHY_CTRL_1

  IF (((1==&isHwLevelingEnabled)&&(1==&DISABLE_READ_GATE_LEVELING))||(0==&isHwLevelingEnabled))
  (
    Data.Set (&base_addr+&EMIF_EXT_PHY_CONTROL_2) %LE %Long &EXT_PHY_CTRL_2
    Data.Set (&base_addr+&EMIF_EXT_PHY_CONTROL_2_SHADOW) %LE %Long &EXT_PHY_CTRL_2
    Data.Set (&base_addr+&EMIF_EXT_PHY_CONTROL_3) %LE %Long &EXT_PHY_CTRL_3
    Data.Set (&base_addr+&EMIF_EXT_PHY_CONTROL_3_SHADOW) %LE %Long &EXT_PHY_CTRL_3
    Data.Set (&base_addr+&EMIF_EXT_PHY_CONTROL_4) %LE %Long & EXT_PHY_CTRL_4
    Data.Set (&base_addr+&EMIF_EXT_PHY_CONTROL_4_SHADOW) %LE %Long &EXT_PHY_CTRL_4
    Data.Set (&base_addr+&EMIF_EXT_PHY_CONTROL_5) %LE %Long &EXT_PHY_CTRL_5
    Data.Set (&base_addr+&EMIF_EXT_PHY_CONTROL_5_SHADOW) %LE %Long &EXT_PHY_CTRL_5
    Data.Set (&base_addr+&EMIF_EXT_PHY_CONTROL_6) %LE %Long &EXT_PHY_CTRL_6
    Data.Set (&base_addr+&EMIF_EXT_PHY_CONTROL_6_SHADOW) %LE %Long &EXT_PHY_CTRL_6
  )

  IF (((1==&isHwLevelingEnabled)&&(1==&DISABLE_READ_LEVELING))||(0==&isHwLevelingEnabled))
  (
//EMIF_PHY_RD_DQS_SLAVE_RATIO
    Data.Set (&base_addr+&EMIF_EXT_PHY_CONTROL_7) %LE %Long &EXT_PHY_CTRL_7
    Data.Set (&base_addr+&EMIF_EXT_PHY_CONTROL_7_SHADOW) %LE %Long &EXT_PHY_CTRL_7
    Data.Set (&base_addr+&EMIF_EXT_PHY_CONTROL_8) %LE %Long &EXT_PHY_CTRL_8
    Data.Set (&base_addr+&EMIF_EXT_PHY_CONTROL_8_SHADOW) %LE %Long &EXT_PHY_CTRL_8
    Data.Set (&base_addr+&EMIF_EXT_PHY_CONTROL_9) %LE %Long &EXT_PHY_CTRL_9
    Data.Set (&base_addr+&EMIF_EXT_PHY_CONTROL_9_SHADOW) %LE %Long &EXT_PHY_CTRL_9
    Data.Set (&base_addr+&EMIF_EXT_PHY_CONTROL_10) %LE %Long &EXT_PHY_CTRL_10
    Data.Set (&base_addr+&EMIF_EXT_PHY_CONTROL_10_SHADOW) %LE %Long &EXT_PHY_CTRL_10
    Data.Set (&base_addr+&EMIF_EXT_PHY_CONTROL_11) %LE %Long &EXT_PHY_CTRL_11
    Data.Set (&base_addr+&EMIF_EXT_PHY_CONTROL_11_SHADOW) %LE %Long &EXT_PHY_CTRL_11
  )
  IF (((1==&isHwLevelingEnabled)&&(1==&DISABLE_WRITE_LEVELING))||(0==&isHwLevelingEnabled))
  (
//EMIF_PHY_WR_DATA_SLAVE_RATIO
    Data.Set (&base_addr+&EMIF_EXT_PHY_CONTROL_12) %LE %Long &EXT_PHY_CTRL_12
    Data.Set (&base_addr+&EMIF_EXT_PHY_CONTROL_12_SHADOW) %LE %Long &EXT_PHY_CTRL_12
    Data.Set (&base_addr+&EMIF_EXT_PHY_CONTROL_13) %LE %Long &EXT_PHY_CTRL_13
    Data.Set (&base_addr+&EMIF_EXT_PHY_CONTROL_13_SHADOW) %LE %Long &EXT_PHY_CTRL_13
    Data.Set (&base_addr+&EMIF_EXT_PHY_CONTROL_14) %LE %Long &EXT_PHY_CTRL_14
    Data.Set (&base_addr+&EMIF_EXT_PHY_CONTROL_14_SHADOW) %LE %Long &EXT_PHY_CTRL_14
    Data.Set (&base_addr+&EMIF_EXT_PHY_CONTROL_15) %LE %Long &EXT_PHY_CTRL_15
    Data.Set (&base_addr+&EMIF_EXT_PHY_CONTROL_15_SHADOW) %LE %Long &EXT_PHY_CTRL_15
    Data.Set (&base_addr+&EMIF_EXT_PHY_CONTROL_16) %LE %Long &EXT_PHY_CTRL_16
    Data.Set (&base_addr+&EMIF_EXT_PHY_CONTROL_16_SHADOW) %LE %Long &EXT_PHY_CTRL_16

//EMIF_PHY_WR_DQS_SLAVE_RATIO
    Data.Set (&base_addr+&EMIF_EXT_PHY_CONTROL_17) %LE %Long &EXT_PHY_CTRL_17
    Data.Set (&base_addr+&EMIF_EXT_PHY_CONTROL_17_SHADOW) %LE %Long &EXT_PHY_CTRL_17
    Data.Set (&base_addr+&EMIF_EXT_PHY_CONTROL_18) %LE %Long &EXT_PHY_CTRL_18
    Data.Set (&base_addr+&EMIF_EXT_PHY_CONTROL_18_SHADOW) %LE %Long &EXT_PHY_CTRL_18
    Data.Set (&base_addr+&EMIF_EXT_PHY_CONTROL_19) %LE %Long &EXT_PHY_CTRL_19
    Data.Set (&base_addr+&EMIF_EXT_PHY_CONTROL_19_SHADOW) %LE %Long &EXT_PHY_CTRL_19
    Data.Set (&base_addr+&EMIF_EXT_PHY_CONTROL_20) %LE %Long &EXT_PHY_CTRL_20
    Data.Set (&base_addr+&EMIF_EXT_PHY_CONTROL_20_SHADOW) %LE %Long &EXT_PHY_CTRL_20
    Data.Set (&base_addr+&EMIF_EXT_PHY_CONTROL_21) %LE %Long &EXT_PHY_CTRL_21
    Data.Set (&base_addr+&EMIF_EXT_PHY_CONTROL_21_SHADOW) %LE %Long &EXT_PHY_CTRL_21
  )

  Data.Set (&base_addr+&EMIF_EXT_PHY_CONTROL_22) %LE %Long &EXT_PHY_CTRL_22
  Data.Set (&base_addr+&EMIF_EXT_PHY_CONTROL_22_SHADOW) %LE %Long &EXT_PHY_CTRL_22
  Data.Set (&base_addr+&EMIF_EXT_PHY_CONTROL_23) %LE %Long &EXT_PHY_CTRL_23
  Data.Set (&base_addr+&EMIF_EXT_PHY_CONTROL_23_SHADOW) %LE %Long &EXT_PHY_CTRL_23
  Data.Set (&base_addr+&EMIF_EXT_PHY_CONTROL_24) %LE %Long &EXT_PHY_CTRL_24
  Data.Set (&base_addr+&EMIF_EXT_PHY_CONTROL_24_SHADOW) %LE %Long &EXT_PHY_CTRL_24
  Data.Set (&base_addr+&EMIF_EXT_PHY_CONTROL_25) %LE %Long &EXT_PHY_CTRL_25
  Data.Set (&base_addr+&EMIF_EXT_PHY_CONTROL_25_SHADOW) %LE %Long &EXT_PHY_CTRL_25

  IF (1==&isHwLevelingEnabled)
  (
    Data.Set (&base_addr+&EMIF_EXT_PHY_CONTROL_26) %LE %Long &EXT_PHY_CTRL_26
    Data.Set (&base_addr+&EMIF_EXT_PHY_CONTROL_26_SHADOW) %LE %Long &EXT_PHY_CTRL_26
    Data.Set (&base_addr+&EMIF_EXT_PHY_CONTROL_27) %LE %Long &EXT_PHY_CTRL_27
    Data.Set (&base_addr+&EMIF_EXT_PHY_CONTROL_27_SHADOW) %LE %Long &EXT_PHY_CTRL_27
    Data.Set (&base_addr+&EMIF_EXT_PHY_CONTROL_28) %LE %Long &EXT_PHY_CTRL_28
    Data.Set (&base_addr+&EMIF_EXT_PHY_CONTROL_28_SHADOW) %LE %Long &EXT_PHY_CTRL_28
    Data.Set (&base_addr+&EMIF_EXT_PHY_CONTROL_29) %LE %Long &EXT_PHY_CTRL_29
    Data.Set (&base_addr+&EMIF_EXT_PHY_CONTROL_29_SHADOW) %LE %Long &EXT_PHY_CTRL_29
    Data.Set (&base_addr+&EMIF_EXT_PHY_CONTROL_30) %LE %Long &EXT_PHY_CTRL_30
    Data.Set (&base_addr+&EMIF_EXT_PHY_CONTROL_30_SHADOW) %LE %Long &EXT_PHY_CTRL_30

    Data.Set (&base_addr+&EMIF_EXT_PHY_CONTROL_31) %LE %Long &EXT_PHY_CTRL_31
    Data.Set (&base_addr+&EMIF_EXT_PHY_CONTROL_31_SHADOW) %LE %Long &EXT_PHY_CTRL_31
    Data.Set (&base_addr+&EMIF_EXT_PHY_CONTROL_32) %LE %Long &EXT_PHY_CTRL_32
    Data.Set (&base_addr+&EMIF_EXT_PHY_CONTROL_32_SHADOW) %LE %Long &EXT_PHY_CTRL_32
    Data.Set (&base_addr+&EMIF_EXT_PHY_CONTROL_33) %LE %Long &EXT_PHY_CTRL_33
    Data.Set (&base_addr+&EMIF_EXT_PHY_CONTROL_33_SHADOW) %LE %Long &EXT_PHY_CTRL_33
    Data.Set (&base_addr+&EMIF_EXT_PHY_CONTROL_34) %LE %Long &EXT_PHY_CTRL_34
    Data.Set (&base_addr+&EMIF_EXT_PHY_CONTROL_34_SHADOW) %LE %Long &EXT_PHY_CTRL_34
    Data.Set (&base_addr+&EMIF_EXT_PHY_CONTROL_35) %LE %Long &EXT_PHY_CTRL_35
    Data.Set (&base_addr+&EMIF_EXT_PHY_CONTROL_35_SHADOW) %LE %Long &EXT_PHY_CTRL_35
  )

  Data.Set (&base_addr+&EMIF_EXT_PHY_CONTROL_36) %LE %Long &EXT_PHY_CTRL_36
  Data.Set (&base_addr+&EMIF_EXT_PHY_CONTROL_36_SHADOW) %LE %Long &EXT_PHY_CTRL_36
  Data.Set (&base_addr+&EMIF_SDRAM_REFRESH_CONTROL_SHADOW) %LE %Long (&EMIF_SDRAM_REFRESH_CONTROL_INITREF_DIS_MASK|&SDRAM_REF_CTRL_INIT)
  Data.Set (&base_addr+&EMIF_SDRAM_REFRESH_CONTROL) %LE %Long (&EMIF_SDRAM_REFRESH_CONTROL_INITREF_DIS_MASK|&SDRAM_REF_CTRL_INIT)
  Data.Set (&base_addr+&EMIF_SDRAM_TIMING_1) %LE %Long &SDRAM_TIM_1
  Data.Set (&base_addr+&EMIF_SDRAM_TIMING_1_SHADOW) %LE %Long &SDRAM_TIM_1
  Data.Set (&base_addr+&EMIF_SDRAM_TIMING_2) %LE %Long &SDRAM_TIM_2
  Data.Set (&base_addr+&EMIF_SDRAM_TIMING_2_SHADOW) %LE %Long &SDRAM_TIM_2
  Data.Set (&base_addr+&EMIF_SDRAM_TIMING_3) %LE %Long &SDRAM_TIM_3
  Data.Set (&base_addr+&EMIF_SDRAM_TIMING_3_SHADOW) %LE %Long &SDRAM_TIM_3
  Data.Set (&base_addr+&EMIF_POWER_MANAGEMENT_CONTROL) %LE %Long &PWR_MGMT_CTRL
  Data.Set (&base_addr+&EMIF_POWER_MANAGEMENT_CONTROL_SHADOW) %LE %Long &PWR_MGMT_CTRL
  Data.Set (&base_addr+&EMIF_OCP_CONFIG) %LE %Long &OCP_CONFIG
  Data.Set (&base_addr+&EMIF_IODFT_TLGC) %LE %Long &IODFT_TLGC
  Data.Set (&base_addr+&EMIF_DLL_CALIB_CTRL) %LE %Long &DLL_CALIB_CTRL
  Data.Set (&base_addr+&EMIF_DLL_CALIB_CTRL_SHADOW) %LE %Long &DLL_CALIB_CTRL
  Data.Set (&base_addr+&EMIF_SDRAM_OUTPUT_IMPEDANCE_CALIBRATION_CONFIG) %LE %Long &ZQ_CONFIG
  Data.Set (&base_addr+&EMIF_READ_WRITE_LEVELING_RAMP_WINDOW) %LE %Long &RDWR_LVL_RMP_WIN
  Data.Set (&base_addr+&EMIF_READ_WRITE_LEVELING_RAMP_CONTROL) %LE %Long &RDWR_LVL_RMP_CTRL
  Data.Set (&base_addr+&EMIF_READ_WRITE_LEVELING_CONTROL) %LE %Long 0
  Data.Set (&base_addr+&EMIF_DDR_PHY_CONTROL_1) %LE %Long &DDR_PHY_CTRL_1
  Data.Set (&base_addr+&EMIF_DDR_PHY_CONTROL_1_SHADOW) %LE %Long &DDR_PHY_CTRL_1
  Data.Set (&base_addr+&EMIF_DDR_PHY_CONTROL_2) %LE %Long &DDR_PHY_CTRL_2
  Data.Set (&base_addr+&EMIF_PRIORITY_TO_CLASS_OF_SERVICE_MAPPING) %LE %Long &PRI_COS_MAP
  Data.Set (&base_addr+&EMIF_CONNECTION_ID_TO_CLASS_OF_SERVICE_1_MAPPING) %LE %Long &CONNID_COS_1_MAP
  Data.Set (&base_addr+&EMIF_CONNECTION_ID_TO_CLASS_OF_SERVICE_2_MAPPING) %LE %Long &CONNID_COS_2_MAP
  Data.Set (&base_addr+&EMIF_READ_WRITE_EXECUTION_THRESHOLD) %LE %Long &RD_WR_EXEC_THRSH
  Data.Set (&base_addr+&EMIF_COS_CONFIG) %LE %Long &COS_CONFIG
  Data.Set (&base_addr+&EMIF_SDRAM_REFRESH_CONTROL_SHADOW) %LE %Long &SDRAM_REF_CTRL_INIT
  Data.Set (&base_addr+&EMIF_SDRAM_REFRESH_CONTROL) %LE %Long &SDRAM_REF_CTRL_INIT
  Data.Set (&base_addr+&EMIF_SDRAM_CONFIG_2) %LE %Long &SDRAM_CONFIG_2
  Data.Set (&base_addr+&EMIF_SDRAM_CONFIG) %LE %Long &SDRAM_CONFIG

  WAIT 1000.us

  Data.Set (&base_addr+&EMIF_SDRAM_REFRESH_CONTROL_SHADOW) %LE %Long &SDRAM_REF_CTRL
  Data.Set (&base_addr+&EMIF_SDRAM_REFRESH_CONTROL) %LE %Long &SDRAM_REF_CTRL

  IF (1==&isHwLevelingEnabled)
  (
    IF ((1==&isEccEnabled)&&(&SOC_EMIF1_CONF_REGS_BASE==&base_addr))
    (
      Data.Set (&base_addr+&EMIF_ECC_ADDRESS_RANGE_1) %LE %Long 0
      Data.Set (&base_addr+&EMIF_ECC_ADDRESS_RANGE_2) %LE %Long 0
      Data.Set (&base_addr+&EMIF_ECC_CTRL_REG) %LE %Long (&EMIF_ECC_CTRL_REG_REG_ECC_EN_MASK|&EMIF_ECC_CTRL_REG_REG_ECC_ADDR_RGN_PROT_MASK)
    )
    Data.Set (&base_addr+&EMIF_EXT_PHY_CONTROL_36) %LE %Long (Data.Long(A:&base_addr+&EMIF_EXT_PHY_CONTROL_36)|0x00000100)
    Data.Set (&base_addr+&EMIF_EXT_PHY_CONTROL_36_SHADOW) %LE %Long (Data.Long(A:&base_addr+&EMIF_EXT_PHY_CONTROL_36_SHADOW)|0x00000100)
    Data.Set (&base_addr+&EMIF_SDRAM_REFRESH_CONTROL) %LE %Long (Data.Long(A:&base_addr+&EMIF_SDRAM_REFRESH_CONTROL)|&EMIF_SDRAM_REFRESH_CONTROL_INITREF_DIS_MASK)
    Data.Set (&base_addr+&EMIF_READ_WRITE_LEVELING_CONTROL) %LE %Long &EMIF_READ_WRITE_LEVELING_CONTROL_RDWRLVLFULL_START_MASK
    WAIT 300.us

//WAIT for the leveling proced re to complete
    WHILE ((Data.Long(A:&base_addr+&EMIF_READ_WRITE_LEVELING_CONTROL)&&EMIF_READ_WRITE_LEVELING_CONTROL_RDWRLVLFULL_START_MASK)!=0)
    (
    )
    Data.Set (&base_addr+&EMIF_SDRAM_REFRESH_CONTROL) %LE %Long (Data.Long(A:&base_addr+&EMIF_SDRAM_REFRESH_CONTROL)&~&EMIF_SDRAM_REFRESH_CONTROL_INITREF_DIS_MASK)

    IF ((Data.Long(A:&base_addr+&EMIF_STATUS)&0x70)!=0)
    (
      print " ERROR: HW-Leveling time-oUt"
    )
    ELSE
    (
      GOSUB EMIF_DDR3_UpdateHWLevelOUtpUt &base_addr
    )
    Data.Set (&base_addr+&EMIF_ECC_CTRL_REG) %LE %Long 0
  )

RETURN
)

AM572x_EMIF1_ECC_ConfigUration:
(
  print " EMIF1 ECC Initialization is in progress ..."
  print " DEB G: Ens re all memory browsers and watch windows accessing"
  print " DDR are closed!!"
  Data.Set 0x4AE0C144 %LE %Long (Data.Long(A:0x4AE0C144)|0x00010000)
  Data.Set 0x4C000114 %LE %Long 0x0FFF0000
  Data.Set 0x4C000118 %LE %Long 0x1FFF1000
  Data.Set 0x4C000110 %LE %Long 0xC0000003
  print " DEB G: Init all ECC enabled memory before any read access!!"
  print " EMIF1 ECC Initialization is DONE!"
  RETURN
)

AM572x_EMIF1_Enable_Narrow_Mode:
(
  print " EMIF1 Narrow Mode config is in progress ..."
  Data.Set 0x4C000008 %LE %Long (Data.Long(A:0x4C000008)|0x00004000)
  print " EMIF1 Narrow Mode config is DONE!"

RETURN
)

AM572x_EMIF2_Enable_Narrow_Mode:
(
  IF (1==&IS_EMIF2_AVAILABLE)
  (
    PRINT " EMIF2 Narrow Mode config is in progress..."
    Data.Set 0x4D000008 %LE %Long (Data.Long(A:0x4D000008)|0x00004000)
    print " EMIF2 Narrow Mode config is DONE!"
  )
  ELSE
  (
    print " EMIF2 not available!"
  )
RETURN
)

AM572x_EMIF1_EMIF2_Interleave_128byte:
(
  IF (1==&IS_EMIF2_AVAILABLE)
  (
    print " EMIF1/2 Interleaving (2x512MB, 128 byte interleaving) is in progress ..."
    Data.Set (&SOC_MA_MPU_CONF_REGS_BASE+&LISA_MAP_0) %LE %Long 0x80640300
    Data.Set (&SOC_MA_MPU_CONF_REGS_BASE+&LISA_MAP_1) %LE %Long 0
    Data.Set (&SOC_DMM_CONF_REGS_BASE+&LISA_MAP_0) %LE %Long 0x80640300
    Data.Set (&SOC_DMM_CONF_REGS_BASE+&LISA_MAP_1) %LE %Long 0
    print " EMIF1/2 Interleaving is in DONE! ..."
  )
  ELSE
  (
    print " EMIF2 not available!"
  )
RETURN
)