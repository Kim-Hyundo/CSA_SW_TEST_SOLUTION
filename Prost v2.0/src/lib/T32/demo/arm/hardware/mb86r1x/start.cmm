; --------------------------------------------------------------------------------
; @Title: Start-Up script for MB86R1x Emerald.
; @Description: 
;   This script sets up an debug session of
;   an MB86R1x. Starts an low-level code afterwards.
;   Set SW10.Pin4 to 1 JTAG DFT mode
; @Keywords: Emerald
; @Author: AME
; @Board: SK-86R12-01
; @Chip: MB86R11, MB86R12
; @Copyright: (C) 1989-2019 Lauterbach GmbH, licensed for use with TRACE32(R) only
; --------------------------------------------------------------------------------
; $Id: start.cmm 15223 2019-11-05 16:29:45Z bschroefel $


RESet
SYStem.RESet
SYStem.CPU MB86R12
SYStem.Up

; load some code into SRAM
Data.LOAD.Elf ~~/demo/arm/compiler/gnu-pic/midi_arm.elf 0xd0200100 /RelPATH

; stop at 'main'
Go main
WAIT !STATE.RUN()

; open some windows
List.auto

