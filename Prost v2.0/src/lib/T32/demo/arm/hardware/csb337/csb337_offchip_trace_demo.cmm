; --------------------------------------------------------------------------------
; @Title: Off-Chip Trace demo for the Cogent CSB337
; @Description:
;   Loads the sieve demo into SRAM and sets up a demo
;   debug scenario. Use this script for getting started.
; @Keywords: Cogent, ETM, trace
; @Author: KJM
; @Board: CSB337 CSB637
; @Chip: AT91RM9200
; @Copyright: (C) 1989-2019 Lauterbach GmbH, licensed for use with TRACE32(R) only
; --------------------------------------------------------------------------------
; $Id: csb337_offchip_trace_demo.cmm 15217 2019-11-04 16:17:15Z bschroefel $


 SYStem.Down
 SYStem.CPU AT91RM9200
 SYStem.Option ResBreak OFF
 SYStem.Option WaitReset ON
 SYStem.Option BigEndian OFF
 SYStem.Up

 DO ~~~~/csb337_init

 IF ANALYZER()
 (
    ; configure chip to output ETM lines

    Data.Set 0xfffffa00+0x0004 %LE %Long 0x0fffff80   ; select peripheral for ETM lines
    Data.Set 0xfffffa00+0x0074  %LE %Long 0x0fffff80   ; select periph B for ETM lines

    ; configure TRACE32 for ETM

    ETM.HalfRate ON
    ETM.PortSize 16
    ETM.PortMode Normal

   ; open some windows
    WinCLEAR
    WinPOS 0% 0% 100% 50%
    List.auto
    WinPOS 0% 50% 50% 50%
    Analyzer.List
    WinPOS 50% 50% 50% 50%
 )

 Data.LOAD.Elf ~~~~/thumble.axf 0x20000000

 ;relink
 Data.Set main+0x15c %Long func3+1
 Data.Set main+0x160 %Long DEFault
 Data.Set main+0x168 %Long ast
 Data.Set sieve+0x50 %Long flags

 Register.Set CPSR 0x33
 Register.Set PC main
 Register.Set R13 0x20001000

 ENDDO

