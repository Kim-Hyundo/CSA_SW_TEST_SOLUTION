; --------------------------------------------------------------------------------
; @Title: Demo script for LS1021A with Offchip-Trace via PCIe (RAM, SMP)
; @Description:
;   Loads the sieve demo application into SRAM and sets up a demo debug
;   scenario.
;   The program flow is traced using the Offchip-Trace via PCIe. The PCIe
;   RootComplex is configured using a script. As the PCIe lanes are activated
;   while using the RCW the RCW-Override machinism is used.
;   Prerequisites:
;    * Connect Debug Cable/Combiprobe to J12
;      using the ARM20-MIPI converter LA-3770
;    * disable MBED debugger SW2[8]=0y1
;    * Set SW2[1..5]==RCW-SRC to a valid bootsource
;      e.g. NOR       0y10001
;      e.g. QSPI      0y00010
;    * connect PowerTraceSerial using the PCIe Testadapter to PCIe header
;      MiniPCIe1
; @Keywords: ARM, Cortex-A7, ETM, PCIe
; @Author: AME
; @Board: TWR-LS1021A
; @Chip: LS1020A LS1021A LS1022A
; @Copyright: (C) 1989-2019 Lauterbach GmbH, licensed for use with TRACE32(R) only
; --------------------------------------------------------------------------------
; $Id: twr-ls1021_sieve_offchip_pcie_trace_sram.cmm 15217 2019-11-04 16:17:15Z bschroefel $


WinCLEAR

; --------------------------------------------------------------------------------
; check prerequisites
IF VERSION.BUILD.BASE()<92440.
(
  PRINT %ERROR "Please use more recent Software! Contact support@lauterbach.com."
  ENDDO
)
IF !POWERTRACESERIAL()
(
  PRINT %ERROR "This example requires a PowerTrace Serial."
  ENDDO
)

; --------------------------------------------------------------------------------
; initialize and start the debugger
RESet
SYStem.RESet
SYStem.CPU LS1021A
SYStem.Option HRCWOVerRide OFF
SYStem.Option TRST OFF
SYStem.Option EnReset ON
CORE.ASSIGN 1. ; select only master core 1 - 1. first core, 2. second core, 1. 2. first + second core (SMP) ...
Trace.DISable
SYStem.JtagClock CTCK 10MHz

; <temporariely override the RCW>
; make sure PCIe is enabled, prevent the target from booting to be in a defined status
; Reset the SoC using the RCW-Override
SYStem.Option EnReset OFF
SYStem.Option HRCWOVerRide ON /PORESET

SYStem.Mode.Prepare
; override RCW-Code = Hardcoded
Data.Set EDBG:0x42000040 %Long 0x9a

; override the RCW itself - hardcoded + PCIe config
Data.Set EDBG:0x42000000 %Long 0x0608000A
Data.Set EDBG:0x42000004 %Long 0x00000000
Data.Set EDBG:0x42000008 %Long 0x00000000
Data.Set EDBG:0x4200000c %Long 0x00000000
Data.Set EDBG:0x42000010 %Long 0x30000000
Data.Set EDBG:0x42000014 %Long 0x00007900
Data.Set EDBG:0x42000018 %Long 0xfb800a00 ; PBL_SRC=reserved, IFC=0xa
Data.Set EDBG:0x4200001C %Long 0x21046800
Data.Set EDBG:0x42000020 %Long 0x00000000
Data.Set EDBG:0x42000024 %Long 0x00000000
Data.Set EDBG:0x42000028 %Long 0x00000000
Data.Set EDBG:0x4200002C %Long 0x00000000
Data.Set EDBG:0x42000030 %Long 0x00000000
Data.Set EDBG:0x42000034 %Long 0x24A4BFE0
Data.Set EDBG:0x42000038 %Long 0x00000000
Data.Set EDBG:0x4200003C %Long 0x00000000

SYStem.Up
; </temporariely override the RCW>

SYStem.Up

; --------------------------------------------------------------------------------
; initialize OFFCHIP trace via PCIe, stream data using the ETR to the PCIe Endpoint

; enable MMU - map PCIe Memory Space to virtual 0x0--0xffffffff
; setup phase requires access to the PCIe Bar
GOSUB MmuMapPcieMem

; setup PCIe RootComplex - script based
; DO ~~/demo/arm/hardware/ls10xx/scripts/setup_ls_pcie "0x03400000" "0x4000000000" "0x0"
DO ~~~~/../scripts/setup_ls_pcie "0x03400000" "0x4000000000" "0x0"

; these settings are generated by calling
;   DO ~~/demo/arm/etc/embedded_trace_router/etr_utility.cmm
; use the ETR to write to the PCIe
(
  PRIVATE &EtrAxiBase
  &EtrAxiBase=0x4049000000
  DO "~~/demo/arm/etc/embedded_trace_router/etr_utility.cmm" ETR1 set DAB    &EtrAxiBase
  DO "~~/demo/arm/etc/embedded_trace_router/etr_utility.cmm" ETR1 set RSZ    0x8
  DO "~~/demo/arm/etc/embedded_trace_router/etr_utility.cmm" ETR1 set AXICTL 0x00000F00 0x00000FBF
  Trace.METHOD Analyzer
  ETM.Trace ON
  ETM.ON
)
; disable MMU
Data.Set C15:0x1 %Long Data.Long(C15:0x1)&~0x1

; --------------------------------------------------------------------------------
; load demo program (uses internal RAM only)
CORE.select 0.
Data.LOAD.Elf "~~~~/sieve_ram_arm_v7.elf"
; Set PC for all secondary cores
;Register.Init /CORE 1.
;Register.Set PC _start /CORE 1.

; --------------------------------------------------------------------------------
; start program execution
Go.direct main
WAIT !STATE.RUN()

; --------------------------------------------------------------------------------
; open some windows
WinCLEAR
Mode.Hll
WinPOS 0. 0.
List.auto
WinPOS 120. 0. 100. 8.
Frame.view
WinPOS 120. 14.
Var.Watch
Var.AddWatch %SpotLight ast flags
WinPOS 120. 25.
Trace.List
WinPOS 0. 32.
Var.DRAW %DEFault sinewave

ENDDO

MmuMapPcieMem:
(
  ; map virt -> phys 0x0--0xffffffff -> 0x40:0x0
  ; this routine does NOT store any context

  ; switch to SVC SEC
  Register.Set M 0x13
  Register.Set NS 0

  ; create a PageTable
  &ptbase=0x10000000
  Data.Set A:&ptbase %Quad 0x4000000411 0x4040000411 0x4080000411 0x40C0000411

  ; enable LPAE, set PTBASE
  Data.Set C15:0x202 %Long 0x80000000
  Data.Set C15:0x10020 %Quad &ptbase
  Data.Set C15:0x11020 %Quad &ptbase

  ; enable MMU & flush TLB
  Data.Set C15:0x1 %Long Data.Long(C15:0x1)|0x1
  Data.Set C15:0x78 %Long 0x1
  RETURN
)