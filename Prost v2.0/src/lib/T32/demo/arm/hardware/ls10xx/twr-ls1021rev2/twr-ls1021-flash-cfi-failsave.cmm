; --------------------------------------------------------------------------------
; @Title: LS1021A CFI NOR Flash configuration example (FAILSAVE - Hardcoded RCW)
; @Description:
;   Show how to initialize CFI NOR Flash Programming on TWR-LS1021A board using
;   the hardcoded RCW mode of the SoC. The timing parameters and the mux settings
;   match the TWR-LS1021A board and are a template for other boards.
;   Prerequisites:
;   * connect Debugcable to J12
;     using the ARM20-MIPI converter LA-3770
;     OR
;     connect Combiprobe to J12 directly
;   * disable MBED debugger SW2[8]=0y1
;   * set bootsource to hardcoded RCW SW2[5..1]=0y10010
; @Keywords: Freescale, Layerscape, CortexA7, QorIQ, RCW
; @Author: AME
; @Board: TWR-LS1021A
; @Chip: LS1021A
; @Copyright: (C) 1989-2019 Lauterbach GmbH, licensed for use with TRACE32(R) only
; --------------------------------------------------------------------------------
; $Id: twr-ls1021-flash-cfi-failsave.cmm 15217 2019-11-04 16:17:15Z bschroefel $

; --------------------------------------------------------------------------------
; check prerequisites
IF VERSION.BUILD.BASE()<77180.
(
  PRINT %ERROR "Please use more recent Software! Contact support@lauterbach.com."
  ENDDO
)

; --------------------------------------------------------------------------------
; board setup
RESet
SYStem.RESet
SYStem.CPU LS1021A
; check SYStem.Detect.ShowCHAIN
; on LS1021A Rev2 the USB-JTAG TAP may be bypassed
;SYStem.CONFIG DAPIRPRE 8.
;SYStem.CONFIG DAPDRPRE 1.
SYStem.Option ResBreak OFF
CORE.ASSIGN 1.

; overwrite the RCW
SYStem.Option HRCWOVerRide ON
SYStem.Mode.Prepare
; set RCW_SRC 0x9a -> HARDCODED
Data.Set EDBG:0x42000040 %Long 0x9A
; set RCW itself
Data.Set EDBG:0x42000000 %Long 0x060A0006
Data.Set EDBG:0x42000004 %Long 0x00000000
Data.Set EDBG:0x42000008 %Long 0x00000000
Data.Set EDBG:0x4200000C %Long 0x00000000
Data.Set EDBG:0x42000010 %Long 0x00000000
Data.Set EDBG:0x42000014 %Long 0x00404000
Data.Set EDBG:0x42000018 %Long 0xFB800A00
Data.Set EDBG:0x4200001C %Long 0x21046800
Data.Set EDBG:0x42000020 %Long 0x00200000
Data.Set EDBG:0x42000024 %Long 0x00000000
Data.Set EDBG:0x42000028 %Long 0x00000000
Data.Set EDBG:0x4200002C %Long 0x00000000
Data.Set EDBG:0x42000030 %Long 0x00000000
Data.Set EDBG:0x42000034 %Long 0x24A4BFE0
Data.Set EDBG:0x42000038 %Long 0x00000000
Data.Set EDBG:0x4200003C %Long 0x00000000

; do a SYStem.UP -> Connect should work regardless of FLASH content now
SYStem.Up
SYStem.Option HRCWOVerRide OFF

; some initializations for the core
; lock interrupts
Register.Set I 1
Register.Set F 1
; init SCTLR - MMU OFF, I-Cache ON
Data.Set C15:0x1 %Long 0xC5187A

; enable the IFC controller
; NOR on CS0
; use failsave timings
; IFC_CSPR0 - 16bit, NOR, Valid, no WriteProtection
Data.Set A:0x1530010 %Long %BE 0x101
; IFC_CSOR0_NOR - NOR, ADM_SHFT=4
Data.Set A:0x1530130 %Long %BE 0x800C
; set timing
; IFC_FTIM0_CS0_NOR - TACSE=TEADC=TEAHC=15
Data.Set A:0x15301C0 %Long %BE 0xF00F000F
; IFC_FTIM1_CS0_NOR - TAC0=TRAD_NOR=TSEQRAD=0x3f
Data.Set A:0x15301C4 %Long %BE 0x3F003F3F
; IFC_FTIM2_CS0_NOR - TCS=TCH=TWPH=15 TWP=0x3f
Data.Set A:0x15301C8 %Long %BE 0xF3C3C3F

; use either the Misc->Flash Programming dialog
; or the CLI
; the board uses 16Bit bus, start address 0x60000000
; use the target SRAM "Target based programming"
FLASH.CFI 0x60000000 Word /TARGET 0x10000000 0x10001000 0x1000
; alternative: use tool based programming - much slower but really failsave
;FLASH.CFI 0x60000000 Word
FLASH.List

; Flash.ReProgram ALL
; Data.LOAD.<Elf/Bin/...>
; Flash.ReProgram ALL


ENDDO