; --------------------------------------------------------------------------------
; @Title: LS1021A Rev 2 simple onchip trace demo
; @Description:
;   Run a simple sieve demo in processor internal SRAM.
;   The onchip trace is configured to use the Embedded Trace Router ETR to
;   write the data to DRAM.
;   Prerequisites:
;   * connect Debugcable to J12
;     using the ARM20-MIPI converter LA-3770
;     OR
;     connect Combiprobe to J12 directly
;   * disable MBED debugger SW2[8]=0y1
;   * Target must boot and configure DRAM - e.g. U-Boot is programmed
; @Keywords: Freescale, Layerscape, CortexA7, QorIQ
; @Author: AME
; @Board: TWR-LS1021A
; @Chip: LS1021A
; @Copyright: (C) 1989-2019 Lauterbach GmbH, licensed for use with TRACE32(R) only
; --------------------------------------------------------------------------------
; $Id: twr-ls1021-onchip-trace-etr-dram.cmm 15217 2019-11-04 16:17:15Z bschroefel $

; board setup
RESet
SYStem.RESet
SYStem.CPU LS1021A
; check SYStem.Detect.ShowCHAIN
; on LS1021A Rev2 the USB-JTAG TAP may be bypassed
;SYStem.CONFIG DAPIRPRE 8.
;SYStem.CONFIG DAPDRPRE 1.
SYStem.Option ResBreak OFF
CORE.ASSIGN 1.
SYStem.Up

; set a Breakpoint which waits for a WRITE to DRAM (1GB)
Break.Set 0x80000000++0x3fffffff /Write
Go
WAIT !STATE.RUN() 5.s
IF STATE.RUN()
(
  Break
  PRINT "Fail: Target did configure DRAM => Abort."
  ENDDO
)
Break.Delete
; DRAM is ready now

; load the code to SRAM
Data.LOAD.Elf ~~~~/sieve_ram_arm_v7.elf

; some initializations (u-boot started to execute)
; lock interrupts
Register.Set I 1
Register.Set F 1
; init SCTLR - MMU OFF, I-Cache ON
Data.Set C15:0x1 %Long 0xC5187A

; silicon ERRATA - CORE_clk must be <600Mhz on Rev1 to use Trace
; set CORE_clk to PLL1/2
Data.Set SD:0x1EE1000 %Long %LE 0x00000008

; trace initializations
; the following sequence is generated by using the interactive
; DO ~~/demo/arm/etc/embedded_trace_router/etr_utility.cmm
; script
; example configuration - write Address 0x90000000, Size 1M
  DO ~~/demo/arm/etc/embedded_trace_router/etr_utility.cmm ETR1 set DAB 0x0000000090000000
  DO ~~/demo/arm/etc/embedded_trace_router/etr_utility.cmm ETR1 set RSZ 0x40000
  DO ~~/demo/arm/etc/embedded_trace_router/etr_utility.cmm ETR1 set AXICTL 0x00000F00 0x00000FBF
  Onchip.TraceCONNECT ETR1
  Trace.METHOD Onchip
ETM.DataTrace OFF
ETM.Trace ON
ETM.ON


; some windows
Mode.Hll
List.auto
Trace.List

ENDDO