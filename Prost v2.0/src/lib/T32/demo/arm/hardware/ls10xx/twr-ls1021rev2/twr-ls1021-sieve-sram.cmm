; --------------------------------------------------------------------------------
; @Title: LS1021A Rev 2 simple debug demo
; @Description:
;   Run a simple sieve demo in Processor internal SRAM.
;   Prerequisites:
;   * connect Debugcable to J12
;     using the ARM20-MIPI converter LA-3770
;     OR
;     connect Combiprobe to J12 directly
;   * disable MBED debugger SW2[8]=0y1
; @Keywords: Freescale, Layerscape, CortexA7, QorIQ
; @Author: AME
; @Board: TWR-LS1021A
; @Chip: LS1021A
; @Copyright: (C) 1989-2019 Lauterbach GmbH, licensed for use with TRACE32(R) only
; --------------------------------------------------------------------------------
; $Id: twr-ls1021-sieve-sram.cmm 15217 2019-11-04 16:17:15Z bschroefel $

; board setup
RESet
SYStem.RESet
SYStem.CPU LS1021A
; check SYStem.Detect.ShowCHAIN
; on LS1021A Rev2 the USB-JTAG TAP may be bypassed
;SYStem.CONFIG DAPIRPRE 8.
;SYStem.CONFIG DAPDRPRE 1.
SYStem.Option ResBreak OFF
CORE.ASSIGN 1.
SYStem.Up

; load the code
Data.LOAD.Elf ~~~~/sieve_ram_arm_v7.elf

; some initializations (u-boot started to execute)
; lock interrupts
Register.Set I 1
Register.Set F 1
; init SCTLR - MMU OFF, I-Cache ON
Data.Set C15:0x1 %Long 0xC5187A

; some windows
Mode.Hll
List.auto