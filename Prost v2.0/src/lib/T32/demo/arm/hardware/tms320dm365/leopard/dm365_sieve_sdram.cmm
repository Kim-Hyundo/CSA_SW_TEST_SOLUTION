; --------------------------------------------------------------------------------
; @Title: startup script on SDRAM for Leopard TMS320DM365
; @Description:
;
;   This demo demonstrates the debugging of the ARM926 core of the Leopard
;   using a simple sieve demo loaded on the SDRAM.
;   SDRAM: 0x80002000
;
; @Author: MSA
; @Board: Leopard
; @Chip: TMS320DM365
; @Keywords: ARM926EJ-S, sieve
; @Copyright: (C) 1989-2019 Lauterbach GmbH, licensed for use with TRACE32(R) only
; --------------------------------------------------------------------------------
; $Id: dm365_sieve_sdram.cmm 15217 2019-11-04 16:17:15Z bschroefel $


; reset chip, connect to first core only
  RESet
  SYStem.Down

  SYStem.RESet
  SYStem.CPU DM365
  SYStem.Option.ResBreak OFF
  SYStem.JtagClock 1Mhz

  SYStem.Up
  Go.direct
  WAIT 1.s
  Break.direct

  DO ~~~~/dm365-init.cmm
  Data.LOAD.Elf ~~~~/demo_sdram.axf


  Go.direct
; open some windows
  WinCLEAR

  WinPOS 0% 50% 50% 50%
  Data.List

  WinPOS 50% 0% 50% 50%
  Register.view /SpotLight

  WinPOS 50% 50% 50% 50%
  Var.Watch
  Var.AddWatch ast; flags;

  Break.direct

  ENDDO
