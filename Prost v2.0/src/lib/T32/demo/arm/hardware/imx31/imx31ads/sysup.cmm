; --------------------------------------------------------------------------------
; @Title: Simple SYStem.Up Script for iMX31ADS
; @Description: -
; @Board: i.MX31ADS
; @Chip: IMX31
; @Author: KJM
; @Copyright: (C) 1989-2019 Lauterbach GmbH, licensed for use with TRACE32(R) only
; --------------------------------------------------------------------------------
; $Id: sysup.cmm 15217 2019-11-04 16:17:15Z bschroefel $


 SYStem.CPU MCIMX31         
 SYStem.Option ResBreak OFF     
 SYStem.JtagClock RTCK       
 SYStem.Up
 
 WinPOS 0% 0% 100% 50%
 List.auto
 WinPOS 0% 50% 50% 50%
 Register