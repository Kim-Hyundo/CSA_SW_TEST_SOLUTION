; --------------------------------------------------------------------------------
; @Title: Demo script for MKL28Z512VLL7 on FRDM-KL28Z with MTB-Trace (RAM)
; @Description:
;   Loads the sieve demo application into RAM and sets up a demo debug
;   scenario.
;   The program flow is traced using the MTB.
;   Prerequisites:
;    * Connect Debug Cable to J11 using Adapter LA-3770
;      or
;      Connect Combiprobe/uTrace to J11
; @Keywords: ARM, Cortex-M0+, MTB
; @Author: STK
; @Board: FRDM-KL28Z
; @Chip: MKL28Z512VLL7
; @Copyright: (C) 1989-2020 Lauterbach GmbH, licensed for use with TRACE32(R) only
; --------------------------------------------------------------------------------
; $Id: frdm-kl28z_sieve_onchip_mtb_trace_sram.cmm 15961 2020-04-20 15:56:29Z bwright $


WinCLEAR

; --------------------------------------------------------------------------------
; initialize and start the debugger
RESet
SYStem.RESet
SYStem.CPU MKL28Z512VLL7
SYStem.CONFIG.DEBUGPORTTYPE SWD
IF COMBIPROBE()||UTRACE()
(
  SYStem.CONFIG.CONNECTOR MIPI20T
)
SYStem.Option DUALPORT ON
SYStem.MemAccess DAP
SYStem.JtagClock CTCK 10MHz
Trace.DISable
SYStem.Up

GOSUB DisableWatchdog

; --------------------------------------------------------------------------------
; load demo program (uses internal RAM only)
Data.LOAD.Elf "~~~~/sieve_ram_thumb_v6m.elf"

; --------------------------------------------------------------------------------
; initialize ONCHIP trace (MTB)
Trace.METHOD Onchip
Trace.TBADDRESS ADDRESS.OFFSET(sYmbol.SECADDRESS(.mtb))
Trace.SIZE 64.

; --------------------------------------------------------------------------------
; start program execution
Go.direct main
WAIT !STATE.RUN()

; --------------------------------------------------------------------------------
; open some windows
WinCLEAR
Mode.Hll
WinPOS 0. 0. 116. 26.
List.auto
WinPOS 120. 0. 100. 8.
Frame.view
WinPOS 120. 14.
Var.Watch
Var.AddWatch %SpotLight ast flags
WinPOS 120. 25.
Trace.List
WinPOS 0. 32.
Var.DRAW %DEFault sinewave

ENDDO

DisableWatchdog:
(
  ; Locally save the portion of processor memory used to configure the watchdog timer
  LOCAL &tmp1 &tmp2 &tmp3
  &tmp1=Data.Long(ST:0x20000000)
  &tmp2=Data.Long(ST:0x20000004)
  &tmp3=Data.Long(ST:0x20000008)
  Register.SWAP

  ; The watchdog has a restrictive timing. It has to be configured and unlocked within a period
  ;   of 20+256 cycles. Therefore the unlock sequence is run directly on the CPU.
  Data.Assemble ST:0x20000000  cpsid i      ; disable interrupts
  Data.Assemble ,              str r0,[r1]  ; put unlock key in WDOG_CNT register
  Data.Assemble ,              str r2,[r3]  ; set WDOG_TOVAL
  Data.Assemble ,              str r4,[r5]  ; disable watchdog and allow reconfig without reset
  Data.Assemble ,              cpsie i      ; enable interrupts
  Data.Assemble ,              bkpt #0
  ; The official Kinetis method checks if 16-bit register accesses are used and, if so,
  ;   writes the unlock key over two operations. Check the WDOG_CS register for CMD32EN.

  Register.Set PC 0x20000000
  Register.Set R0 0xD928C520  ; unlock key
  Register.Set R1 0x40076004  ; WDOG_CNT
  Register.Set R2 0xFFFF
  Register.Set R3 0x40076008  ; WDOG_TOVAL
  Register.Set R4 0x2120      ; (1 << CMD32EN) | (01 << CLK) | (1 << UPDATE)
  Register.Set R5 0x40076000  ; WDOG_CS [control and status]
  Go.direct
  WAIT !STATE.RUN()

  ; Restore pre-routine memory contents
  Register.SWAP
  Data.Set ST:0x20000000 %Long &tmp1
  Data.Set ST:0x20000004 %Long &tmp2
  Data.Set ST:0x20000008 %Long &tmp3

  RETURN
)
