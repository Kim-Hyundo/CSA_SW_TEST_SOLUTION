; --------------------------------------------------------------------------------
; @Title: Simple demo script for S9KEAZN64AMLH on TRK-KEA64 (RAM)
; @Description:
;   Loads the sieve demo application into RAM and sets up a demo debug
;   scenario.
;   Use this script for getting started.
;   Prerequisites:
;    * Connect Debug Cable to J13 using Adapter LA-3770
;      or
;      Connect Combiprobe/uTrace to J13
; @Keywords: ARM, Cortex-M0+
; @Author: AME
; @Board: TRK-KEA64
; @Chip: S9KEAZN64AMLH
; @Copyright: (C) 1989-2019 Lauterbach GmbH, licensed for use with TRACE32(R) only
; --------------------------------------------------------------------------------
; $Id: trk-kea64_sieve_sram.cmm 15223 2019-11-05 16:29:45Z bschroefel $


WinCLEAR

; --------------------------------------------------------------------------------
; check prerequisites
IF VERSION.BUILD.BASE()<76316.
(
  PRINT %ERROR "Please use more recent Software! Contact support@lauterbach.com."
  ENDDO
)


; --------------------------------------------------------------------------------
; initialize and start the debugger
RESet
SYStem.RESet
SYStem.CPU S9KEAZN64AMLH
SYStem.CONFIG.DEBUGPORTTYPE SWD
IF hardware.COMBIPROBE()||hardware.UTRACE()
(
  SYStem.CONFIG.CONNECTOR MIPI20T
)
SYStem.Option DUALPORT ON
SYStem.MemAccess DAP
SYStem.JtagClock CTCK 10MHz
SYStem.Up

GOSUB DisableWatchdog

; --------------------------------------------------------------------------------
; load demo program (uses internal RAM only)
Data.LOAD.Elf "~~~~/midi_ram_thumb_v6m.elf"

; --------------------------------------------------------------------------------
; start program execution
Go.direct main
WAIT !STATE.RUN()

; --------------------------------------------------------------------------------
; open some windows
WinCLEAR
Mode.Hll
WinPOS 0. 0.
List.auto
WinPOS 120. 0. 100. 8.
Frame.view
WinPOS 120. 14.
Var.Watch
Var.AddWatch %SpotLight ast flags
WinPOS 120. 25.
Register.view /SpotLight
WinPOS 0. 32.
Var.DRAW %DEFault sinewave

ENDDO

DisableWatchdog:
(
  ; disable the Watchdog
  Register.SWAP
  Data.Set VM:0x20000000++0x2F %Long 0
  Data.Assemble VMT:0x20000000 adr     r0,0x20000014
  Data.Assemble ,              ldm     r0,{r0-r4}
  Data.Assemble ,              movs    r5,0
  Data.Assemble ,              strb r5, [r0, #1]
  Data.Assemble ,              strh r1, [r0, #2]
  Data.Assemble ,              strh r2, [r0, #2]
  Data.Assemble ,              strh r3, [r0, #4]
  Data.Assemble ,              strh r4, [r0, #0]
  Data.Assemble ,              bkpt    #0x0
  Data.Set VM:0x20000014 %Long 0x40052000
  Data.Set VM:0x20000018 %Long 0x20c5
  Data.Set VM:0x2000001C %Long 0x28D9
  Data.Set VM:0x20000020 %Long 0xFFFF
  Data.Set VM:0x20000024 %Long 0x20
  Data.COPY SD:0x20000000++0x2F VM:0x20000030
  Data.COPY VM:0x20000000++0x2F SD:0x20000000
  Register.Set PC 0x20000000
  Go.direct
  WAIT !STATE.RUN()
  Data.COPY VM:0x20000030++0x2F SD:0x20000000
  Register.SWAP
  RETURN
)
