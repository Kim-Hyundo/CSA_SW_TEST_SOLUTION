; --------------------------------------------------------------------------------
; @Title: Sorting Demo with SPOT breakpoints and Data.DRAW
; @Description:
;   This script sets up a small visualizing several sorting algorithms.
; @Keywords: Cortex-M4, Freescale, k60, Kinetis
; @Props: NoIndex, NoWelcome, NoFullText
; @Author: ING
; @Board: TWR-K60N512
; @Chip: MK60DN512VMD10*
; @Copyright: (C) 1989-2019 Lauterbach GmbH, licensed for use with TRACE32(R) only
; --------------------------------------------------------------------------------
; $Id: start_sort.cmm 15217 2019-11-04 16:17:15Z bschroefel $

  LOCAL &srtsize
  &srtsize=400.

// create settings for setup script
  OPEN #1 "sboard_settings.txt" /Create
  WRITE #1 "MK60DN512VMD10"   // Device Type
  WRITE #1 "0x1"              // Turn On Serial Wire Debug
  WRITE #1 "75Mhz"            // Set clock to 75Mhz
  WRITE #1 "sort.elf"         // ELF file
  WRITE #1 "0x1"              // go to main
  WRITE #1 ""                 // do not turn on external ram
  WRITE #1 ""                 // do not turn on extrnal flash
  WRITE #1 "0x0"              // do not use cJTAG
  WRITE #1 "0x0"              // use 1st whisker
  WRITE #1 "0x0"              // do not use SWV
  CLOSE #1

// start board, load elf, go to main
  DO ~~~~/../setup start_board_no_gui

// we want a faster clock to read out data faster
  SYStem.JtagClock CTCK 25Mhz
//  SYStem.JtagClock 10Mhz

// Spot Breakpoints for displaying the "array" variable
  Break.RESet
  Break.Set is_h\6         /SPOT
  Break.Set qs_h\12        /SPOT
  Break.Set shell_h\8      /SPOT
  Break.Set heapsort\28    /SPOT
  Break.Set merge_sort\34  /SPOT
  Break.Set merge_sort\37  /SPOT
  Break.Set merge_sort2\49 /SPOT
  Break.Set merge_sort2\54 /SPOT
  Break.Set bubblesort\4   /SPOT
  Break.Set rdxsort\30     /SPOT
  Break.Set rdxsort2_h\42  /SPOT
  Break.Set selsort\18     /SPOT
  Break.Set bitonic_split\16 /SPOT
  Break.Set bitonic_merge\16 /SPOT

// Let Demo run longer via increasing count variable
  Var.set count = 1000000003.
// Sort only &srtsize entries, so that sorting does not take ages
  Var.set array_size = &srtsize


  WinCLEAR
  WinPOS 0. 0. 100% 24.
  Data.DRAW %Long Var.ADDRESS(array)++((&(srtsize)*4.)-1) /IMPULSES

  WinPOS 0. 31. 80. 25.
  List.auto

  WinPOS 85. 31. 80. 16.
  Break.List

  ITM.PortSize 4
  ITM.PortMode CONTINUOUS
  ITM.OFF
  ETM.ON
  ITM.ON

