; --------------------------------------------------------------------------------
; @Title: Demo script for MKV10Z32VLF7 on TWR-KV10Z32 with MTB-Trace (RAM)
; @Description:
;   Loads the midi demo application into RAM and sets up a demo debug scenario.
;   The program flow is traced using the MTB.
;   Prerequisites:
;    * Connect Debug Cable to J17 using Adapter LA-3770
;      or
;      Connect Combiprobe/uTrace to J17
; @Keywords: ARM, Cortex-M0+, MTB
; @Author: STK
; @Board: TWR-KV10Z32
; @Chip: MKV10Z32VLF7
; @Copyright: (C) 1989-2019 Lauterbach GmbH, licensed for use with TRACE32(R) only
; --------------------------------------------------------------------------------
; $Id: twr-kv10z32_sieve_onchip_mtb_trace_sram.cmm 15223 2019-11-05 16:29:45Z bschroefel $


WinCLEAR

; --------------------------------------------------------------------------------
; initialize and start the debugger
RESet
SYStem.RESet
SYStem.CPU MKV10Z32VLF7
SYStem.CONFIG.DEBUGPORTTYPE SWD
IF COMBIPROBE()||UTRACE()
(
  SYStem.CONFIG.CONNECTOR MIPI20T
)
SYStem.Option DUALPORT ON
SYStem.MemAccess DAP
SYStem.JtagClock CTCK 10MHz
Trace.DISable
SYStem.Up

GOSUB DisableWatchdog

; --------------------------------------------------------------------------------
; load demo program (uses internal RAM only)
Data.LOAD.Elf "~~~~/midi_ram_thumb_v6m.elf"

; --------------------------------------------------------------------------------
; initialize ONCHIP trace (MTB)
Trace.METHOD Onchip
Trace.TBADDRESS ADDRESS.OFFSET(sYmbol.SECADDRESS(.mtb))
Trace.SIZE 64.

; --------------------------------------------------------------------------------
; start program execution
Go.direct main
WAIT !STATE.RUN()

; --------------------------------------------------------------------------------
; open some windows
WinCLEAR
Mode.Hll
WinPOS 0. 0. 116. 26.
List.auto
WinPOS 120. 0. 100. 8.
Frame.view
WinPOS 120. 14.
Var.Watch
Var.AddWatch %SpotLight ast flags
WinPOS 120. 25.
Trace.List
WinPOS 0. 32.
Var.DRAW %DEFault sinewave

ENDDO

DisableWatchdog:
(
  ; disable the Watchdog
  Frame.SWAP
  Data.Assemble ST:0x20000000  strh    r1,[r0]
  Data.Assemble ,              strh    r2,[r0]
  Data.Assemble ,              strh    r4,[r3]
  Data.Assemble ,              bkpt    #0x0
  Register.Set  R0 0x4005200E
  Register.Set  R1 0x0000C520
  Register.Set  R2 0x0000D928
  Register.Set  R3 0x40052000
  Register.Set  R4 0x00000000
  Register.Set  PC 0x20000000
  Go.direct
  WAIT !STATE.RUN()
  Frame.SWAP
  RETURN
)
