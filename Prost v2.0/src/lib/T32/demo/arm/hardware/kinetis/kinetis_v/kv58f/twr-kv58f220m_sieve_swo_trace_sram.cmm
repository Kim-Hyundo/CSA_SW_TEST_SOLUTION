; --------------------------------------------------------------------------------
; @Title: Demo script for MKV58F1M0VLQ24 on TWR-KV58F220M with SWV (RAM)
; @Description:
;   Loads the sieve demo application into RAM and sets up a demo debug
;   scenario.
;   The SerialWireViewer is set up to trace some data values using the DWT.
;   Prerequisites:
;    * Connect Debug Cable to J13 using Adapter LA-3770
;      or
;      Connect Combiprobe/uTrace to J13
;    * J17 MUST be removed!
;    * Remove J19 and J20 to disconnect the onboard SDA
; @Keywords: ARM, Cortex-M7, ITM, SWV
; @Author: STK
; @Board: TWR-KV58F220M
; @Chip: MKV58F1M0VLQ24
; @Copyright: (C) 1989-2019 Lauterbach GmbH, licensed for use with TRACE32(R) only
; --------------------------------------------------------------------------------
; $Id: twr-kv58f220m_sieve_swo_trace_sram.cmm 15223 2019-11-05 16:29:45Z bschroefel $


; Prerequisite: check if a Combiprobe/uTrace is connected
IF !CAnalyzer()
(
  DIALOG.OK "Support for SerialWireViewer requires a Combiprobe or uTrace."
  ENDDO
)

WinCLEAR

; --------------------------------------------------------------------------------
; initialize and start the debugger
RESet
SYStem.RESet
SYStem.CPU MKV58F1M0VLQ24
SYStem.CONFIG.DEBUGPORTTYPE SWD
IF COMBIPROBE()||UTRACE()
(
  SYStem.CONFIG.CONNECTOR MIPI20T
)
SYStem.Option DUALPORT ON
SYStem.MemAccess DAP
SYStem.JtagClock 10MHz
Trace.DISable
SYStem.Up

GOSUB DisableWatchdog

; --------------------------------------------------------------------------------
; load demo program (uses internal RAM only)
Data.LOAD.Elf "~~~~/sieve_ram_thumb_ii_v7m.elf"

; --------------------------------------------------------------------------------
; start program execution
Go.direct main
WAIT !STATE.RUN()

; --------------------------------------------------------------------------------
; initialize SerialWireViewer (clock is stable now)
Trace.METHOD CAnalyzer
Trace.AutoInit ON
TPIU.PortSize SWV
ITM.DataTrace ON
ITM.ON
; use auto-calibration script to find most suitable TPIU.SWVPrescaler <divider>
DO ~~/demo/arm/etc/serial_wire_viewer/swv_autocalibration.cmm

; --------------------------------------------------------------------------------
; setup ITM based datatrace of variable plot1
Var.Break.Set plot1 /Write /TraceData

; --------------------------------------------------------------------------------
; open some windows
WinCLEAR
Mode.Hll
WinPOS 0. 0. 116. 26.
List.auto
WinPOS 120. 0. 100. 8.
Frame.view
WinPOS 120. 14.
Var.Watch
Var.AddWatch %SpotLight ast flags
WinPOS 120. 25.
ITMTrace.List
WinPOS 0. 32.
Trace.DRAW.Var %DEFault plot1

ENDDO

DisableWatchdog:
(
  ; disable the Watchdog
  Frame.SWAP
  Data.Assemble ST:0x20000000  strh    r1,[r0]
  Data.Assemble ,              strh    r2,[r0]
  Data.Assemble ,              strh    r4,[r3]
  Data.Assemble ,              bkpt    #0x0
  Register.Set  R0 0x4005200E
  Register.Set  R1 0x0000C520
  Register.Set  R2 0x0000D928
  Register.Set  R3 0x40052000
  Register.Set  R4 0x00000000
  Register.Set  PC 0x20000000
  Go.direct
  WAIT !STATE.RUN()
  Frame.SWAP
  RETURN
)
