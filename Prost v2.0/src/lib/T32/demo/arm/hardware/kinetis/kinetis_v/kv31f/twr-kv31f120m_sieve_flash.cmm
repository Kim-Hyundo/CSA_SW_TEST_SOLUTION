; --------------------------------------------------------------------------------
; @Title: Demo script for MKV31F128VLL10 on TWR-KV31F120M (FLASH)
; @Description:
;   Programs the sieve demo application into the processor internal flash and
;   sets up a demo debug scenario.
;   This script can be used as a template for flashing an application.
;   Prerequisites:
;    * Connect Debug Cable to J19 using Adapter LA-3770
;      or
;      Connect Combiprobe/uTrace to J19
; @Keywords: ARM, Cortex-M4, Flash
; @Author: STK
; @Board: TWR-KV31F120M
; @Chip: MKV31F128VLL10
; @Copyright: (C) 1989-2019 Lauterbach GmbH, licensed for use with TRACE32(R) only
; --------------------------------------------------------------------------------
; $Id: twr-kv31f120m_sieve_flash.cmm 15223 2019-11-05 16:29:45Z bschroefel $


WinCLEAR

; --------------------------------------------------------------------------------
; initialize and start the debugger
RESet
SYStem.RESet
SYStem.CPU MKV31F128VLL10
SYStem.CONFIG.DEBUGPORTTYPE SWD
IF COMBIPROBE()||UTRACE()
(
  SYStem.CONFIG.CONNECTOR MIPI20T
)
SYStem.Option DUALPORT ON
SYStem.MemAccess DAP
SYStem.JtagClock CTCK 10MHz
Trace.DISable
SYStem.Up

GOSUB DisableWatchdog

; --------------------------------------------------------------------------------
; Flash programming

; prepare flash programming (declarations)
DO ~~/demo/arm/flash/mkv30.cmm PREPAREONLY

; ReProgram Flash
FLASH.ReProgram ALL
Data.LOAD.Elf "~~~~/sieve_flash_thumb_ii_v7m.elf"
FLASH.ReProgram OFF

; --------------------------------------------------------------------------------
; Reset the target again
SYStem.Up

GOSUB DisableWatchdog

; --------------------------------------------------------------------------------
; start program execution
Go.direct main
WAIT !STATE.RUN()

; --------------------------------------------------------------------------------
; open some windows
WinCLEAR
Mode.Hll
WinPOS 0. 0. 116. 26.
List.auto
WinPOS 120. 0. 100. 8.
Frame.view
WinPOS 120. 14.
Var.Watch
Var.AddWatch %SpotLight ast flags
WinPOS 120. 25.
Register.view /SpotLight
WinPOS 0. 32.
Var.DRAW %DEFault sinewave

ENDDO

DisableWatchdog:
(
  ; disable the Watchdog
  Frame.SWAP
  Data.Assemble ST:0x20000000  strh    r1,[r0]
  Data.Assemble ,              strh    r2,[r0]
  Data.Assemble ,              strh    r4,[r3]
  Data.Assemble ,              bkpt    #0x0
  Register.Set  R0 0x4005200E
  Register.Set  R1 0x0000C520
  Register.Set  R2 0x0000D928
  Register.Set  R3 0x40052000
  Register.Set  R4 0x00000000
  Register.Set  PC 0x20000000
  Go.direct
  WAIT !STATE.RUN()
  Frame.SWAP
  RETURN
)
