; --------------------------------------------------------------------------------
; @Title: ETM deactivation script for NETX500
; @Description: This script deactivates the ETM (Embedded Trace Macrocell)
; @Keywords: Hilscher, NetX*
; @Board: 
;   NETX FPGA Board, NXHX500, NXHMI-BB, NXHMI-RE, NXDB500-SYS, NXEB500-HMI, NXSB100, NETPAC, Honeywell (Tower)
; @Chip: NETX500
; @Author: Hilscher
; @Copyright: -
; --------------------------------------------------------------------------------
; $Id: etm_deinit.cmm 15223 2019-11-05 16:29:45Z bschroefel $


LOCAL &ioconfig &restart

&restart="0"

IF STATE.RUN()
(
  &restart="1"
  Break.direct
)

;Enable ETM Interface on netX
&ioconfig=Data.Long(ASD:0x00100004)&0xFF7FFFFF

Data.Set ASD:0x00100070 %Long Data.Long(ASD:0x00100070)
Data.Set ASD:0x00100004 %Long (&ioconfig|0x00000003)

ETM.OFF
ETM.RESet

IF "&restart"=="1"
  Go.direct

ENDDO
