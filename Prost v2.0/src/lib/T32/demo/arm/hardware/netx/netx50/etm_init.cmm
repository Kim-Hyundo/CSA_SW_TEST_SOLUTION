; --------------------------------------------------------------------------------
; @Title: ETM activation script for NETX50
; @Description: This script activates the ETM (Embedded Trace Macrocell)
; @Keywords: Hilscher, NetX*
; @Board: NX50TEST, NXHX50, COMX-CCLS
; @Chip: NETX50
; @Author: Hilscher
; @Copyright: -
; --------------------------------------------------------------------------------
; $Id: etm_init.cmm 15223 2019-11-05 16:29:45Z bschroefel $


LOCAL &ioconfig &restart

&restart="0"

IF STATE.RUN()
(
  &restart="1"
  Break.direct
)

;Enable ETM Interface on netX
&ioconfig=Data.Long(ASD:0x1c000004)

Data.Set ASD:0x1c000070 %Long Data.Long(ASD:0x1c000070)
Data.Set ASD:0x1c000004 %Long (&ioconfig|0x00800000)

ETM.OFF
;ETM.RESET
ETM.PortMode NORMAL
ETM.HalfRate ON
ETM.PortSize 16
ETM.FifoLevel 15.
ETM.DataTrace READ 
ETM.ON

Analyzer.CLOCK 200MHz
Analyzer.AutoFocus ASD:0x10000000--ASD:0x1000FFFC

IF "&restart"=="1"
  Go.direct

ENDDO
