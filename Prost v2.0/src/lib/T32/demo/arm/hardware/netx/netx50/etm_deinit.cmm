; --------------------------------------------------------------------------------
; @Title: ETM deactivation script for NETX50
; @Description: This script deactivates the ETM (Embedded Trace Macrocell)
; @Keywords: Hilscher, NetX*
; @Board: NX50TEST, NXH50, COMX-CCLS
; @Chip: NETX50
; @Author: Hilscher
; @Copyright: -
; --------------------------------------------------------------------------------
; $Id: etm_deinit.cmm 15223 2019-11-05 16:29:45Z bschroefel $


LOCAL &ioconfig &restart

&restart="0"

IF STATE.RUN()
(
  &restart="1"
  Break.direct
)

;Enable ETM Interface on netX
&ioconfig=Data.Long(ASD:0x1c000004)&0xFF7FFFFF

Data.Set ASD:0x1c000070 %Long Data.Long(ASD:0x1c000070)
Data.Set ASD:0x1c000004 %Long (&ioconfig)

ETM.OFF
ETM.RESet

IF "&restart"=="1"
  Go.direct

ENDDO
