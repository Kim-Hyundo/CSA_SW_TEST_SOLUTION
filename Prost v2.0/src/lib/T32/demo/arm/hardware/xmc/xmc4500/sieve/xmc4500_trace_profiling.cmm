; --------------------------------------------------------------------------------
; @Title: Trace based duration statistics for XMC4500 Hexagon board
; @Description:
;   This demo shows how to use ETM and ITM to get statistics about function
;   execution duration.
; @Keywords: Cortex-M4, ETM, ITM, Statistic
; @Author: HDA
; @Board: XMC4500 Hexagon
; @Chip: XMC4500
; @Copyright: (C) 1989-2019 Lauterbach GmbH, licensed for use with TRACE32(R) only
; --------------------------------------------------------------------------------
; $Id: xmc4500_trace_profiling.cmm 15217 2019-11-04 16:17:15Z bschroefel $


  Break.RESet
  SYStem.RESet
  SYStem.CPU XMC4500
  SYStem.Option ResBreak OFF
  SYStem.CONFIG.DEBUGPORTTYPE SWD
  SYStem.CONFIG.CONNECTOR MIPI20T

  ; Init CombiProbe if available
  IF hardware.COMBIPROBE()||hardware.UTRACE()
  (
    CAnalyzer.RESet
    CAnalyzer.THreshold 1.6
  )

  SYStem.Up

; Init internal SRAM
  Data.Set 0x20000000++0FFFF %Long 0

;load demo application
  Data.LOAD.Elf ~~~~/demo.axf
; load stack pointer and PC from vector table
  Register.RESet
  Register.Set PC main
  Register.Set R13 0x20005000

; Set Pin-Multiplexing for enabling the trace
  Data.Set E:0x48028274 %Long 0x00401405                           ; Enable ETM Pins P2
  Data.Set E:0x48028244 %Long Data.Long(E:0x48028244)&0xF00000FF   ; Inclease driver strength P2
  Data.Set E:0x48028674 %Long 0x00001405                           ; Enable ETM Pins P6
  Data.Set E:0x48028640 %Long Data.Long(E:0x48028640)&0xF00FF000   ; Inclease driver strength P6

  IF hardware.COMBIPROBE()||hardware.UTRACE()
  (
    ; Init CombiProbe
    Trace.METHOD CAnalyzer

    IF COMBIPROBE()
    (
      CAnalyzer.CLOCKDelay MEDium
    )
    ELSE IF UTRACE()
    (
      CAnalyzer.CLOCKDelay MAXimum
    )
    CAnalyzer.Init
  )
  ELSE IF Analyzer()
  (
    Trace.METHOD Analyzer    ; Using ARM preprocessor
  )

  Trace.OFF              ; Enable the trace and turn it off

  ETM.PortMode Continuous
  ETM.PortSize 4.

;Turn on ETM

  ETM.ON
  ITM.ON

; set TraceEnable breakpoints at beginning of sieve function
  Break.Set sYmbol.BEGIN(sieve) /Program /TraceEnable /Onchip
; set TraceEnable breakpoints at end of sieve function
  Break.Set sYmbol.END(sieve)-1 /Program /TraceEnable /Onchip

; enable cycle accurate for duration calculation
  ITM.TImeMode CycleAccurate+External

; open some window
  WinCLEAR

  WinPOS 0% 0% 50% 50%
  Trace.STATistic.DURation /FilterA Address sYmbol.BEGIN(sieve) /FilterB Address sYmbol.end(sieve)-1

  WinPOS 0% 50% 50% 50%
  Trace.List

  WinPOS 50% 0% 50% 20%
  Break.List

  WinPOS 50% 20% 50% 80%
  List.auto

; run the program for 3 seconds
  Go.direct
  WAIT 3.s
  Break.direct

  ENDDO
