; --------------------------------------------------------------------------------
; @Title: Simple demo script for ZYNQ-ULTRASCALE+-APU on Avnet ULTRA96 Rev2 (RAM)
; @Description:
;   Loads the sieve demo application into RAM and sets up a demo debug
;   scenario.
;   Use this script for getting started.
;   Prerequisites:
;    * Connect Debug Cable/Combiprobe to JTAG
;    * use METHOD 1 if
;      * a SD-Card Image is available that selects the A53 as bootcore
;      * bootmode SD-Card is selected - SW2[1..2]=0y01
;    * use METHOD 2 if
;      * bootmode JTAG is selected - SW2[1..2]=0y11
;      * alternative: bootmode SD-Card but remove SD-Card
;    * use METHOD 3 to override bootmode to JTAG
; @Keywords: ARM, Cortex-A53
; @Author: AME
; @Board: Avnet ULTRA96 Rev2
; @Chip: ZYNQ-ULTRASCALE+-APU
; @Copyright: (C) 1989-2019 Lauterbach GmbH, licensed for use with TRACE32(R) only
; --------------------------------------------------------------------------------
; $Id: ultra96-rev2-apu_sieve_sram.cmm 14983 2019-09-25 14:19:33Z amerkle $


WinCLEAR

; --------------------------------------------------------------------------------
; initialize and start the debugger
RESet
SYStem.RESet
SYStem.CPU ZYNQ-ULTRASCALE+-APU
SYStem.JtagClock 10MHz
CORE.ASSIGN 1.
Trace.DISable

IF FALSE()
(
  ; METHOD 1 - self booting
  SYStem.Up
)
ELSE IF FALSE()
(
  ; METHOD 2 - Bootmode JTAG
  SYStem.Mode Prepare
  ; start the APU subsystem
  ; DO ~~/demo/arm64/hardware/zynq_ultrascale/scripts/zynq-ultrascale_kick_bootcore.cmm A53_X64
  DO ~~~~/../../scripts/zynq-ultrascale_kick_bootcore.cmm A53_X64
  SYStem.Mode Attach
  Break
)
ELSE
(
  ; METHOD 3 - Bootmode override
  ; <temporariely switch to BOOTMODE=JTAG>
  ; this sequence forces the SoC to use BOOTMODE=JTAG
  ; a SRST is issued using the debug logic
  ; we kickstart the first R5/A53
  SYStem.Option ResBreak OFF
  SYStem.Option EnReset OFF
  SYStem.Option TRST OFF
  ; DO ~~/demo/arm64/hardware/zynq_ultrascale/scripts/zynq-ultrascale_reset.cmm OVERRIDE_BOOTMODE=0x0
  DO ~~~~/../../scripts/zynq-ultrascale_reset.cmm OVERRIDE_BOOTMODE=0x0
  SYStem.Mode Prepare
  ; start the APU subsystem
  ; DO ~~/demo/arm64/hardware/zynq_ultrascale/scripts/zynq-ultrascale_kick_bootcore.cmm A53_X64
  DO ~~~~/../../scripts/zynq-ultrascale_kick_bootcore.cmm A53_X64
  ; set BOOT_MODE_USER to JTAG
  ; mandatory as FSBL will evaluate BOOT_MODE_POR otherwise
  Data.Set ENAXI:0xFF5E0200 %Long 0x100
  ; </temporariely switch to BOOTMODE=JTAG>

  SYStem.Mode.Attach
  IF STATE.RUN()
  Break
)

; --------------------------------------------------------------------------------
; load demo program (uses internal RAM only)
Data.LOAD.Elf "~~~~/sieve_ram_aarch64_v8.elf"

; --------------------------------------------------------------------------------
; start program execution
Go.direct main
WAIT !STATE.RUN()

; --------------------------------------------------------------------------------
; open some windows
WinCLEAR
Mode.Hll
WinPOS 0. 0. 116. 26.
List.auto
WinPOS 120. 0. 100. 8.
Frame.view
WinPOS 120. 14.
Var.Watch
Var.AddWatch %SpotLight ast flags
WinPOS 120. 25.
Register.view /SpotLight
WinPOS 0. 32.
Var.DRAW %DEFault sinewave

ENDDO
