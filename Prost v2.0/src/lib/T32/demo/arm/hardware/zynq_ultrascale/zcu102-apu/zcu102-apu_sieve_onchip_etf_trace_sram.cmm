; --------------------------------------------------------------------------------
; @Title: Demo script for ZYNQ-ULTRASCALE+-APU on ZCU102 with Onchip-Trace
; @Description:
;   Loads the sieve demo application into RAM and sets up a demo debug
;   scenario.
;   The program flow is traced using the Onchip-Trace (ETF).
;   As the bootcode does not start any core in JTAG-Bootmode we start the first
;   core using the script.
;   Prerequisites:
;    * Connect Debug Cable/Combiprobe to J6
;    * set SW6 = 0y1111 (JTAG Bootmode)
;    * short J14
; @Keywords: ARM, Cortex-A53, ETF, ETM
; @Author: AME
; @Board: ZCU102
; @Chip: ZYNQ-ULTRASCALE+*
; @Copyright: (C) 1989-2019 Lauterbach GmbH, licensed for use with TRACE32(R) only
; --------------------------------------------------------------------------------
; $Id: zcu102-apu_sieve_onchip_etf_trace_sram.cmm 16744 2020-11-06 12:52:40Z bschroefel $


WinCLEAR

; --------------------------------------------------------------------------------
; check prerequisites
IF VERSION.BUILD.BASE()<75524.
(
  PRINT %ERROR "Please use more recent Software! Contact support@lauterbach.com."
  ENDDO
)

; --------------------------------------------------------------------------------
; initialize and start the debugger
RESet
SYStem.RESet
SYStem.CPU ZYNQ-ULTRASCALE+-APU
SYStem.Option TRST OFF
SYStem.Option ResBreak OFF
SYStem.Option WaitDAPPWR ON
SYStem.JtagClock CTCK 10MHz
CORE.ASSIGN 1.
; disable Trace infrastructure for the moment - TPIU may be unclocked!
ETM.OFF
Trace.DISable
SYStem.Mode Prepare

; --------------------------------------------------------------------------------
; Disable watchdog SWDT and reset core 0 to defined state
GOSUB DisableWatchdog

DO "~~~~/../scripts/zynq-ultrascale_kick_bootcore.cmm" A53_X64

SYStem.Mode.Attach
IF STATE.RUN()
  Break.direct

; --------------------------------------------------------------------------------
; load demo program (uses internal RAM only)
Data.LOAD.Elf "~~~~/sieve_ram_aarch64_v8.elf"
Register.Set M 0x5            ; EL1
Register.Set NS 1.            ; nsec

; --------------------------------------------------------------------------------
; start program execution
Go.direct main
WAIT !STATE.RUN()

; --------------------------------------------------------------------------------
; initialize ONCHIP trace (ETF)
Trace.METHOD ONCHIP
Trace.TraceCONNECT ETF
DO "~~~~/../scripts/timestamps.cmm"
ETM.Trace ON
ETM.ON
ETM.TImeMode AsyncTimeStamps
ETM.PortMode Wrapped

; --------------------------------------------------------------------------------
; open some windows
WinCLEAR
Mode.Hll
WinPOS 0. 0.
List.auto
WinPOS 120. 0. 100. 8.
Frame.view
WinPOS 120. 14.
Var.Watch
Var.AddWatch %SpotLight ast flags
WinPOS 120. 25.
Trace.List
WinPOS 0. 32.
Var.DRAW %DEFault sinewave

ENDDO

; ================================================================================
DisableWatchdog:
(
  PRIVATE &swdtMode
  
  &swdtMode=Data.Long(ENAXI:0xFF150000)
  &swdtMode=&swdtMode&0xFFE      ; Mode.WDEN = 0
  &swdtMode=&swdtMode+0xABC000   ; zKEY
  
  Data.Set ENAXI:0xFF150000 %LE %Long &swdtMode
)
RETURN