; --------------------------------------------------------------------------------
; @Title: AMP-Demo script for ZYNQ-ULTRASCALE+ on ZCU102 with Offchip-Trace
; @Description:
;   Setup a AMP debug session using a single script approach.
;   Loads the sieve demo application into RAM and sets up a demo debug
;   scenario on the APU & RPU cores.
;   The program flow is traced using the Offchip-Trace. FPGA loading and Clock
;   setup is handled in the script.
;   Use this script to test the Offchip-Trace.
;   Prerequisites:
;    * Connect Debug Cable/Combiprobe to J6
;    * Connect AutoFocus Preprocessor to P6 using Mictor38 cable
;    * set SW6 = 0y1111 (JTAG Bootmode)
;    * short J14, J38, J88
;    * TRACE32 is started using the .bat/.sh file in this directory
; @Keywords: ARM, ETM
; @Author: AME
; @Board: ZCU102
; @Chip: ZYNQ-ULTRASCALE+*
; @Copyright: (C) 1989-2019 Lauterbach GmbH, licensed for use with TRACE32(R) only
; --------------------------------------------------------------------------------
; $Id: zcu102_amp_offchip_trace_sram.cmm 15576 2020-01-27 10:11:09Z alintner $


WinCLEAR

; --------------------------------------------------------------------------------
; check prerequisites
IF VERSION.BUILD.BASE()<75524.
(
  PRINT %ERROR "Please use more recent Software! Contact support@lauterbach.com."
  ENDDO
)
IF SYStem.INSTANCE()<1.
(
  PRINT %ERROR "TRACE32 is not running in AMP mode! Use .bat/.sh file in this directory."
  ENDDO
)

PRIVATE &ppd
&ppd=OS.PPD()
;&bitfile="&ppd/../zcu102-binaries/zcu102_arm_trace_16_to_16.bit"
&bitfile="&ppd/../zcu102-binaries/zcu102_arm_trace_32_to_16.bit"
IF !OS.FILE("&bitfile")
(
  UNZIP "&bitfile.gz" "&bitfile"
)

; --------------------------------------------------------------------------------
; Close any existing REMOTE GUIs
InterCom OTHERS QUIT

; --------------------------------------------------------------------------------
; open all SLAVE GUIs
TargetSystem.NewInstance ARM_1 /ARCHitecture ARM
TargetSystem.NewInstance ARM_2 /ARCHitecture ARM

TITLE "TRACE32 for ARM64 - ZYNQ-ULTRASCALE+-APU - MASTER"
InterCom ARM_1 TITLE "TRACE32 for ARM - ZYNQ-ULTRASCALE+-RPU - SLAVE1"
InterCom ARM_2 TITLE "TRACE32 for ARM - ZYNQ-ULTRASCALE+-RPU - SLAVE2"

; --------------------------------------------------------------------------------
; common SYStem settings
InterCom ALL RESet
InterCom ALL SYStem.RESet
SYStem.CPU ZYNQ-ULTRASCALE+-APU
SYStem.CONFIG CORE 1. 1.
SYStem.CONFIG SLAVE OFF
SYStem.Option TRST OFF
SYStem.Option ResBreak OFF
SYStem.Option WaitReset 500ms
CORE.ASSIGN 1.

InterCom ARM_1 SYStem.CPU ZYNQ-ULTRASCALE+-RPU
InterCom ARM_1 SYStem.CONFIG CORE 2. 1.
InterCom ARM_1 SYStem.CONFIG SLAVE ON
InterCom ARM_1 CORE.ASSIGN 1.

InterCom ARM_2 SYStem.CPU ZYNQ-ULTRASCALE+-RPU
InterCom ARM_2 SYStem.CONFIG CORE 3. 1.
InterCom ARM_2 SYStem.CONFIG SLAVE ON
InterCom ARM_2 CORE.ASSIGN 2.

; disable Trace infrastructure for the moment - TPIU may be unclocked!
ETM.OFF
STM.OFF
Trace.DISable

InterCom ARM_1 ETM.OFF
InterCom ARM_1 STM.OFF
InterCom ARM_1 Trace.DISable

InterCom ARM_2 ETM.OFF
InterCom ARM_2 STM.OFF
InterCom ARM_2 Trace.DISable

SYStem.Mode Prepare

DO "~~~~/../scripts/zynq-ultrascale_kick_bootcore.cmm" A53_X64

SYStem.Mode.Attach
IF STATE.RUN()
  Break.direct

; --------------------------------------------------------------------------------
; load the FSBL into the OCM
Data.LOAD.Elf "~~~~/../zcu102-binaries/zynqmp_fsbl.elf"

; --------------------------------------------------------------------------------
; start FSBL execution
Go.direct XFsbl_Loop
WAIT !STATE.RUN() 3.s
IF STATE.RUN()
(
  Break.direct
)

IF Register(PC)!=ADDRESS.OFFSET(XFsbl_Loop)
(
  PRINT %ERROR "Boot flow error"
  ENDDO
)

; --------------------------------------------------------------------------------
; program the FPGA fabric (routes the TRACE lines to P6)
DO "~~~~/../scripts/zynq-ultrascale_load_bitstream.cmm" "&bitfile" 0x10000000
; DBG_TRACE_CTRL - enable clock to have proper access to the TPIU
Data.Set ENAXI:0xFD1A0064 %Long Data.Long(ENAXI:0xFD1A0064)|0x01003f00
WAIT 0.1s
; switch TPIU to clock source provided by PL
Data.Set EDAP:0x80180FB0 %Long 0xC5ACCE55
Data.Set EDAP:0x80180404 %Long 0x1
WAIT 0.1s

; --------------------------------------------------------------------------------
; kick secondary cores
DO "~~~~/../scripts/zynq-ultrascale_kick_bootcore.cmm" _A53_234_X64
DO "~~~~/../scripts/zynq-ultrascale_kick_bootcore.cmm" R5_SINGLE
DO "~~~~/../scripts/zynq-ultrascale_kick_bootcore.cmm" _R5_2

; --------------------------------------------------------------------------------
; attach to all cores on all sessions
SYStem.Down
CORE.ASSIGN 1. 2. 3. 4.
SYStem.Mode.Attach

InterCom ARM_1 CORE.ASSIGN 1.
InterCom ARM_1 SYStem.Mode.Up

InterCom ARM_2 CORE.ASSIGN 2.
InterCom ARM_2 SYStem.Mode.Up

; --------------------------------------------------------------------------------
; init ECC RAM on both CortexR cores
InterCom ARM_1 Data.Set A:0x0--0xffff %Long 0x0
InterCom ARM_2 Data.Set A:0x0--0xffff %Long 0x0

; --------------------------------------------------------------------------------
; load demo program on all cores (use internal RAM only)
Data.LOAD.Elf ~~~~/master/sieve_ram_aarch64_v8.elf
InterCom ARM_1 Data.LOAD.Elf ~~~~/slave1/sieve_ram_arm_v7r_le.elf
InterCom ARM_2 Data.LOAD.Elf ~~~~/slave2/sieve_ram_arm_v7r_le.elf

Register.Set PC _start_secondary /CORE 1.
Register.Set PC _start_secondary /CORE 2.
Register.Set PC _start_secondary /CORE 3.

; --------------------------------------------------------------------------------
; initialize OFFCHIP trace if Analyzer is plugged (ETM)
IF Analyzer()&&STRing.SCAN("&bitfile","16_to_16",0.)>0.
(
  Trace.Method Analyzer
  InterCom ARM_1 Trace.Method Analyzer
  InterCom ARM_2 Trace.Method Analyzer

  TPIU.PortSize 16
  TPIU.PortMode Continuous
  ETM.TraceID 1.
  ETM.Trace ON
  ETM.ON
  InterCom ARM_1 ETM.TraceID 5.
  InterCom ARM_1 ETM.Trace ON
  InterCom ARM_1 ETM.ON
  InterCom ARM_2 ETM.TraceID 6.
  InterCom ARM_2 ETM.Trace ON
  InterCom ARM_2 ETM.ON

  ; use Autofocus based calibration
  Analyzer.AutoFocus
)
ELSE IF Analyzer()&&STRing.SCAN("&bitfile","32_to_16",0.)>0.
(
  Trace.Method Analyzer
  InterCom ARM_1 Trace.Method Analyzer
  InterCom ARM_2 Trace.Method Analyzer
  Analyzer.PortSize 16

  TPIU.PortSize 32
  TPIU.PortMode Continuous
  ETM.TraceID 1.
  ETM.Trace ON
  ETM.ON
  InterCom ARM_1 ETM.TraceID 5.
  InterCom ARM_1 ETM.Trace ON
  InterCom ARM_1 ETM.ON
  InterCom ARM_2 ETM.TraceID 6.
  InterCom ARM_2 ETM.Trace ON
  InterCom ARM_2 ETM.ON

  ; use Autofocus based calibration
  Analyzer.AutoFocus
)

; --------------------------------------------------------------------------------
; start program execution
Go.direct main\1
WAIT !STATE.RUN()
InterCom ARM_1 Go.direct main\1
InterCom ARM_1 WAIT !STATE.RUN()
InterCom ARM_2 Go.direct background\1
InterCom ARM_2 WAIT !STATE.RUN()

; --------------------------------------------------------------------------------
; open some windows
WinCLEAR
Mode.Hll
WinPOS 0. 0.
List.auto
WinPOS 0. 32.
Trace.List
InterCom ARM_1 WinCLEAR
InterCom ARM_1 Mode.Hll
InterCom ARM_1 WinPOS 0. 0.
InterCom ARM_1 List.auto
InterCom ARM_1 WinPOS 0. 32.
InterCom ARM_1 Trace.List
InterCom ARM_2 WinCLEAR
InterCom ARM_2 Mode.Hll
InterCom ARM_2 WinPOS 0. 0.
InterCom ARM_2 List.auto
InterCom ARM_2 WinPOS 0. 32.
InterCom ARM_2 Trace.List

ENDDO
