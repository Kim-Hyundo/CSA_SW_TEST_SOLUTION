; --------------------------------------------------------------------------------
; @Title: STM-Demo script for ZYNQ-ULTRASCALE+-APU with Onchip-Trace
; @Description:
;   Loads the STM stimulus demo application into RAM and sets up a demo debug
;   scenario. The code will continuously produce STM data by writing to
;   STIMULUS register 0.
;   As the bootcode does not start any core in JTAG-Bootmode we start the first
;   core using the script.
;   The STM data is traced using the Onchip-Trace (ETR). Therefore a part of
;   the targets RAM is used for trace storage.
;   Prerequisites:
;    * Connect Debug Cable/Combiprobe to J6
;    * set SW6 = 0y1111 (JTAG Bootmode)
;    * short J14
; @Keywords: ARM, Cortex-A53, ETR, STM
; @Author: AME
; @Board: ZCU102
; @Chip: ZYNQ-ULTRASCALE+*
; @Copyright: (C) 1989-2019 Lauterbach GmbH, licensed for use with TRACE32(R) only
; --------------------------------------------------------------------------------
; $Id: zcu102-apu_stm_onchip_etr_trace_sram.cmm 16744 2020-11-06 12:52:40Z bschroefel $


WinCLEAR

; --------------------------------------------------------------------------------
; check prerequisites
IF VERSION.BUILD.BASE()<75524.
(
  PRINT %ERROR "Please use more recent Software! Contact support@lauterbach.com."
  ENDDO
)

; --------------------------------------------------------------------------------
; initialize and start the debugger
RESet
SYStem.RESet
SYStem.CPU ZYNQ-ULTRASCALE+-APU
SYStem.Option TRST OFF
SYStem.Option ResBreak OFF
SYStem.Option WaitDAPPWR ON
SYStem.JtagClock CTCK 10MHz
CORE.ASSIGN 1.
; disable Trace infrastructure for the moment - TPIU may be unclocked!
ETM.OFF
Trace.DISable
SYStem.Mode Prepare

; --------------------------------------------------------------------------------
; Disable watchdog and reset core 0 to defined state
GOSUB DisableWatchdog

DO "~~~~/../scripts/zynq-ultrascale_kick_bootcore.cmm" A53_X64

SYStem.Mode.Attach
IF STATE.RUN()
  Break.direct

; --------------------------------------------------------------------------------
; load demo program (uses internal RAM only)
Data.LOAD.Elf "~~~~/stm_stimulus_ram_aarch64_v8.elf"
Register.Set M 0x5            ; EL1
Register.Set NS 1.            ; nsec

; --------------------------------------------------------------------------------
; start program execution
Go.direct main
WAIT !STATE.RUN()

; --------------------------------------------------------------------------------
; initialize global variables
; set STM STIMULUS base address
Var.Assign pStimulusBase=0xf8000000
; some more initializations for the example code
Var.Assign bLongStimulusEnable=1
Var.Assign nLongStimulus=0x12345678
Var.Assign bAlternateStimulusEnable=1

; --------------------------------------------------------------------------------
; initialize ONCHIP trace (ETR)
; these settings are generated by calling
;   DO ~~/demo/arm/etc/embedded_trace_router/etr_utility.cmm
; - we use parameters obtained from the ELF file here (section .ETR)
(
  PRIVATE &EtrAxiBase &EtrSize
  &EtrAxiBase=ADDRESS.OFFSET(sYmbol.SECADDRESS(.etr))
  &EtrSize=(sYmbol.SECEND(.etr)-sYmbol.SECADDRESS(.etr)+1.)/4.
  DO "~~/demo/arm/etc/embedded_trace_router/etr_utility.cmm" ETR1 set DAB    &EtrAxiBase
  DO "~~/demo/arm/etc/embedded_trace_router/etr_utility.cmm" ETR1 set RSZ    &EtrSize
  DO "~~/demo/arm/etc/embedded_trace_router/etr_utility.cmm" ETR1 set AXICTL 0x00000F00 0x00000FBF
  Trace.METHOD ONCHIP
  STMTrace.METHOD ONCHIP
  Trace.TraceCONNECT ETR
  DO "~~~~/../scripts/timestamps.cmm"
  ETM.Trace OFF
  STM.TimeStamps ON
  ETM.ON
  STM.ON
)

; --------------------------------------------------------------------------------
; open some windows
WinCLEAR
Mode.Hll
WinPOS 0. 0.
List.auto
WinPOS 120. 0. 100. 16.
Var.Watch
Var.AddWatch %SpotLight %Hex bByteStimulusEnable bWordStimulusEnable bLongStimulusEnable bQuadStimulusEnable
Var.AddWatch %SpotLight %Hex bAlternateStimulusEnable
Var.AddWatch %SpotLight %Hex nByteStimulus nWordStimulus nLongStimulus nQuadStimulus
WinPOS 120. 25.
STMTrace.List

ENDDO

; ================================================================================
DisableWatchdog:
(
  PRIVATE &swdtMode
  
  &swdtMode=Data.Long(ENAXI:0xFF150000)
  &swdtMode=&swdtMode&0xFFE      ; Mode.WDEN = 0
  &swdtMode=&swdtMode+0xABC000   ; zKEY
  
  Data.Set ENAXI:0xFF150000 %LE %Long &swdtMode
)
RETURN