; --------------------------------------------------------------------------------
; @Title: Simple connection script for ZYNQ-ULTRASCALE+-PMU on ZCU102 (RAM)
; @Description:
;   Demonstrates the connection sequence to the PMU on a ZYNQ-Ultrascale+ SoC.
;   Prerequisites:
;    * Connect Debug Cable/Combiprobe to J6
;    * PMU Debugging is enabled - AD:0xffca0038 = 0x1ff
; @Author: AME
; @Board: ZCU102
; @Chip: ZYNQ-ULTRASCALE+*
; @Copyright: (C) 1989-2019 Lauterbach GmbH, licensed for use with TRACE32(R) only
; --------------------------------------------------------------------------------
; $Id: zcu102-pmu-attach.cmm 14235 2019-04-03 12:56:59Z mplichta $

IF !(CPUFAMILY()=="MICROBLAZE")
(
  PRINT %ERROR "Please use TRACE32 for MICROBLAZE for this script."
  ENDDO
)

RESet
SYStem.RESet
SYStem.CPU ZYNQ-ULTRASCALE+-PMU
SYStem.CONFIG IRPRE 4.
SYStem.CONFIG DRPRE 1.
SYStem.Option LittleEnd ON
SYStem.Mode Attach

