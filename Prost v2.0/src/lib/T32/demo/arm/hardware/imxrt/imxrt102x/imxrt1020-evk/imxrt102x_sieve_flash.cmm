; --------------------------------------------------------------------------------
; @Title: Demo script for IMXRT1021 on IMXRT1020-EVK (QSPI FLASH)
; @Description:
;   Programs the sieve demo application into the qspi flash and
;   sets up a demo debug scenario.
;   This script can be used as a template for flashing an application.
;   Prerequisites:
;    * Connect Debug Cable to J16
;      or
;      Connect Combiprobe/uTrace to J16 using Adapter LA-3771
;    * set Bootmode to QSPI SW8[1..4]=0y0010
; @Keywords: ARM, Cortex-M7, Flash
; @Author: AME
; @Board: IMXRT1020-EVK
; @Chip: IMXRT1021
; @Copyright: (C) 1989-2019 Lauterbach GmbH, licensed for use with TRACE32(R) only
; --------------------------------------------------------------------------------
; $Id: imxrt102x_sieve_flash.cmm 15217 2019-11-04 16:17:15Z bschroefel $


WinCLEAR

; --------------------------------------------------------------------------------
; initialize and start the debugger
RESet
SYStem.RESet
SYStem.CPU IMXRT1021
SYStem.CONFIG.DEBUGPORTTYPE SWD
IF COMBIPROBE()||UTRACE()
(
  SYStem.CONFIG.CONNECTOR MIPI20T
)
SYStem.Option DUALPORT ON
SYStem.MemAccess DAP
SYStem.JtagClock CTCK 10MHz
Trace.DISable
SYStem.Up

; --------------------------------------------------------------------------------
; Flash programming

; prepare flash programming (declarations)
DO ~~/demo/arm/flash/imxrt102x-snor PREPAREONLY

; ReProgram Flash
FLASH.ReProgram ALL
Data.LOAD.Binary "~~~~/sieve_flash_image.bin" 0x60000000
FLASH.ReProgram OFF

; --------------------------------------------------------------------------------
; Reset the target again
SYStem.Up

; --------------------------------------------------------------------------------
; load debug symbols
Data.LOAD.Elf ~~~~/sieve_flash_thumb_ii_v7m.elf /NoCODE

; --------------------------------------------------------------------------------
; start program execution
Go.direct main
WAIT !STATE.RUN()

; --------------------------------------------------------------------------------
; open some windows
WinCLEAR
Mode.Hll
WinPOS 0. 0. 116. 26.
List.auto
WinPOS 120. 0. 100. 8.
Frame.view
WinPOS 120. 14.
Var.Watch
Var.AddWatch %SpotLight ast flags
WinPOS 120. 25.
Register.view /SpotLight
WinPOS 0. 32.
Var.DRAW %DEFault sinewave

ENDDO
