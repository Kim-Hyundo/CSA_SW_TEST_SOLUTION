; --------------------------------------------------------------------------------
; @Title: Demo script for R7FS5D57C3A01CFB on TB-S5D5 with Onchip-Trace (RAM)
; @Description:
;   Loads the sieve demo application into RAM and sets up a demo debug
;   scenario.
;   The program flow is traced using the Onchip-Trace.
;   Prerequisites:
;    * Connect Debug Cable to J10 using Adapter LA-3770
;      or
;      Connect Combiprobe/uTrace to J10
; @Keywords: ARM, Cortex-M4, ETB, ETM
; @Author: STK
; @Board: TB-S5D5
; @Chip: R7FS5D57C3A01CFB
; @Copyright: (C) 1989-2019 Lauterbach GmbH, licensed for use with TRACE32(R) only
; --------------------------------------------------------------------------------
; $Id: tb-s5d5_sieve_onchip_etb_trace_sram.cmm 15217 2019-11-04 16:17:15Z bschroefel $


WinCLEAR

; --------------------------------------------------------------------------------
; initialize and start the debugger
RESet
SYStem.RESet
SYStem.CPU R7FS5D57C3A01CFB
SYStem.CONFIG.DEBUGPORTTYPE SWD
IF COMBIPROBE()||UTRACE()
(
  ; The TB-S5D5 does not have a trace port, so the tracesignals need to be
  ; connected manually to the CombiProbe or µTrace. In example script it is
  ; assumed, that the signals are connected according to the MIPI34 spec.
  SYStem.CONFIG.CONNECTOR MIPI34
)
SYStem.Option DUALPORT ON
SYStem.MemAccess DAP
SYStem.JtagClock CTCK 10MHz
Trace.DISable
SYStem.Up

; --------------------------------------------------------------------------------
; load demo program (uses internal RAM only)
Data.LOAD.Elf "~~~~/sieve_ram_thumb_ii_v7m.elf"

; --------------------------------------------------------------------------------
; initialize ONCHIP trace (ETB, ETM, ITM)

; Enable trace clock needed for onchip trace
Data.Set 0x4001e3fe %Word 0xa501     ; Protect Register (PRCR)
Data.Set 0x4001E03f %Byte 0x82       ; Trace Clock Control Register (TRCKCR)
Data.Set 0x4001e3fe %Word 0xa500     ; Protect Register (PRCR)

Trace.METHOD ONCHIP
Trace.AutoInit ON
ITM.DataTrace CorrelatedData
ITM.ON
ETM.Trace ON
ETM.ON

; --------------------------------------------------------------------------------
; start program execution
Go.direct main
WAIT !STATE.RUN()

; --------------------------------------------------------------------------------
; open some windows
WinCLEAR
Mode.Hll
WinPOS 0. 0. 116. 26.
List.auto
WinPOS 120. 0. 100. 8.
Frame.view
WinPOS 120. 14.
Var.Watch
Var.AddWatch %SpotLight ast flags
WinPOS 120. 25.
Trace.List
WinPOS 0. 32.
Var.DRAW %DEFault sinewave

ENDDO
