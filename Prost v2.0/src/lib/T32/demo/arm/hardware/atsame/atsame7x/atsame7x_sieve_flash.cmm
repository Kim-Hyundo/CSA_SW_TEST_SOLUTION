; --------------------------------------------------------------------------------
; @Title: Demo script for ATSAME70Q21 on SAME70XPLAINED (FLASH)
; @Description:
;   Programs the sieve demo application into the processor internal flash and
;   sets up a demo debug scenario.
;   This script can be used as a template for flashing an application.
;   Prerequisites:
;    * Connect Debug Cable to Coresight20 connector using Adapter LA-3770
;      or
;      Connect Combiprobe/uTrace to Coresight20 connector
; @Keywords: ARM, Cortex-M7, Flash
; @Author: AME
; @Board: SAME70XPLAINED
; @Chip: ATSAME7*
; @Copyright: (C) 1989-2019 Lauterbach GmbH, licensed for use with TRACE32(R) only
; --------------------------------------------------------------------------------
; $Id: atsame7x_sieve_flash.cmm 15217 2019-11-04 16:17:15Z bschroefel $


WinCLEAR

; --------------------------------------------------------------------------------
; initialize and start the debugger
RESet
SYStem.RESet
SYStem.CPU ATSAME70Q21
SYStem.CONFIG.DEBUGPORTTYPE SWD
IF COMBIPROBE()||UTRACE()
(
  SYStem.CONFIG.CONNECTOR MIPI20T
)
; on some boards the following commands are required
; SYStem.Option SYSRESETREQ OFF
; SYStem.Option WaitReset 1ms
SYStem.Option DUALPORT ON
SYStem.MemAccess DAP
SYStem.JtagClock CTCK 10MHz
Trace.DISable
SYStem.Up

GOSUB DisableWatchdog

; --------------------------------------------------------------------------------
; Flash programming

; prepare flash programming (declarations)
DO ~~/demo/arm/flash/atsame.cmm PREPAREONLY

; ReProgram Flash
FLASH.ReProgram ALL
Data.LOAD.Elf "~~~~/sieve_flash_thumb_ii_v7m.elf"
FLASH.ReProgram OFF

; after factory programming the NVM should be set to FLASH
IF ((Data.Long(AD:0xE000EF90)&0x1)==0x0)&&(Data.Quad(AD:0x0)!=Data.Quad(A:0x00400000))
  DO ~~/demo/arm/flash/atsame-nvm BOOT=FLASH

; --------------------------------------------------------------------------------
; Reset the target again
SYStem.Up

GOSUB DisableWatchdog

; --------------------------------------------------------------------------------
; start program execution
Go.direct main
WAIT !STATE.RUN()

; --------------------------------------------------------------------------------
; open some windows
WinCLEAR
Mode.Hll
WinPOS 0. 0. 116. 26.
List.auto
WinPOS 120. 0. 100. 8.
Frame.view
WinPOS 120. 14.
Var.Watch
Var.AddWatch %SpotLight ast flags
WinPOS 120. 25.
Register.view /SpotLight
WinPOS 0. 32.
Var.DRAW %DEFault sinewave

ENDDO

DisableWatchdog:
(
  ; disable the Watchdog
  ; WDT_MR, set WDDIS
  Data.Set A:0x400E1854 %Long Data.Long(A:0x400E1854)|0x8000
  RETURN
)
