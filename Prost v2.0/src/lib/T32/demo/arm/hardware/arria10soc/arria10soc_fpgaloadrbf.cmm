; --------------------------------------------------------------------------------
; @Title: Load the FPGA of a Arria10 SoC using the FPGA Manager
; @Description:
;   This script loads a RBF file generated by the Altera Toolchain into the FPGA
;   using the FPGA Manager peripheral.
;   Loading the EARLYRBF (IO-Ring) and final/FPGA RBF is supported. See Usage.
;   Prerequisites:
;     * Matching RBF file for the FPGA is available
;     * Debug session is in SYStem.UP() state
;     * MIO is configured for FPPx32 mode
;   Usage:
;     DO arria10soc_fpgaloadrbf.cmm CLEAR
;     DO arria10soc_fpgaloadrbf.cmm EARLYRBF="<PathTo>/<filename>.rbf"
;     DO arria10soc_fpgaloadrbf.cmm RBF="<PathTo>/<filename>.rbf"
; @Board: -
; @Chip: ARRIA10SOC
; @Author: AME
; @Copyright: (C) 1989-2019 Lauterbach GmbH, licensed for use with TRACE32(R) only
; $Id: arria10soc_fpgaloadrbf.cmm 15217 2019-11-04 16:17:15Z bschroefel $
; --------------------------------------------------------------------------------

PRIVATE &param &command &file
ENTRY %LINE &param

; --------------------------------------------------------------------------------
; some checks
IF SYStem.Mode()<5.
(
  PRINT %ERROR "Debugger must be in UP state."
  ENDDO FALSE()
)
IF STATE.RUN()
(
  PRINT %ERROR "Target is in RUNNING State. Please stop the CPU first."
  ENDDO FALSE()
)

; --------------------------------------------------------------------------------
; parse arguments
GOSUB ParseParameters &param
RETURNVALUES &command &file

; --------------------------------------------------------------------------------
; do stuff
IF &command==1.
(
  ; ------------------------------------------------------------------------------
  ; FPGA CLEAR
  GOSUB FpgaManagerInit "3."
  GOSUB FpgaManagerReset
  GOSUB FpgaManagerDeinit

  PRINT "CLEAR SUCCESS!"
)
ELSE IF &command==2.
(
  ; ------------------------------------------------------------------------------
  ; FPGA Early RBF
  LOCAL &msel &cdratio
  &msel=Data.Long(A:0xFFD03080)
  &msel=(&msel>>16.)&0x7

  IF (&msel!=0)&&(&msel!=0x1)
  (
    PRINT %ERROR "MSEL Setting must be FPPx16 or FPPx32"
    ENDDO
  )
  GOSUB CalcCdratio "&file"
  RETURNVALUES &cdratio
  GOSUB FpgaManagerInit "&cdratio"

  ; check if EARLYUSERMODE==0
  WAIT ((Data.Long(A:0xFFD03080)&0x2)==0x0) 1.s
  IF (Data.Long(A:0xFFD03080)&0x2)!=0x0
  (
    PRINT %ERROR "Status Register, EARLYUSERMODE must be HIGH. EARLYRBF already loaded?"
    ENDDO
  )

  ; enable programming
  ; imgcfg_ctrl_2 - set   en_cfg_data, en_cfg_ctrl
  Data.Set A:0xFFD03078 %Long Data.Long(A:0xFFD03078)|0x101
  ; load the file to the FPGA-Manager-Data-Register
  Data.LOAD.Binary "&file" EAHBNI:0xFFCFE400 /NoClear /NosYmbol
  ; Production Silicon Workaround
  Data.Set EAHBNI:0xFFCFE400 %Long 0xFFFFFFFF 0xFFFFFFFF 0xFFFFFFFF 0xFFFFFFFF
  Data.Set EAHBNI:0xFFCFE400 %Long 0xFFFFFFFF 0xFFFFFFFF 0xFFFFFFFF 0xFFFFFFFF
  Data.Set EAHBNI:0xFFCFE400 %Long 0xFFFFFFFF 0xFFFFFFFF

  ; check if EARLYUSERMODE!=0
  WAIT ((Data.Long(A:0xFFD03080)&0x2)==0x2) 1.s
  IF (Data.Long(A:0xFFD03080)&0x2)==0x0
  (
    PRINT %ERROR "Status Register, EARLYUSERMODE must be HIGH."
    ENDDO
  )

  GOSUB FpgaManagerDeinit

  PRINT "EARLY-FPGA LOAD SUCCESS!"
)
ELSE IF &command==3.
(
  ; ------------------------------------------------------------------------------
  ; FPGA RBF
  LOCAL &msel &cdratio
  &msel=Data.Long(A:0xFFD03080)
  &msel=(&msel>>16.)&0x7

  IF (&msel!=0)&&(&msel!=0x1)
  (
    PRINT %ERROR "MSEL Setting must be FPPx16 or FPPx32"
    ENDDO
  )
  GOSUB CalcCdratio "&file"
  RETURNVALUES &cdratio
  GOSUB FpgaManagerInit "&cdratio"

  ; check if F2S_CONDONE_PIN is LOW
  WAIT ((Data.Long(A:0xFFD03080)&0x40)==0x00) 1.s
  IF (Data.Long(A:0xFFD03080)&0x40)!=0x00
  (
    PRINT %ERROR "Status Register, CONDONE already set. FPGA already loaded?"
    ENDDO FALSE()
  )

  ; enable programming
  ; imgcfg_ctrl_2 - set   en_cfg_data, en_cfg_ctrl
  Data.Set A:0xFFD03078 %Long Data.Long(A:0xFFD03078)|0x101
  ; load the file to the FPGA-Manager-Data-Register
  Data.LOAD.Binary "&file" EAHBNI:0xFFCFE400 /NoClear /NosYmbol

  ; wait for F2S_CONDONE_PIN to go HIGH
  WAIT ((Data.Long(A:0xFFD03080)&0x40)==0x40) 1.s
  IF (Data.Long(A:0xFFD03080)&0x40)!=0x40
  (
    PRINT %ERROR "Status Register, CONDONE not set."
    ENDDO FALSE()
  )

  ; poll usermode
  ; dclkstat - clear dcntdone
  Data.Set A:0xFFD0300C %Long 0x1
  ; dclkcnt  - set cnt=0xf
  Data.Set A:0xFFD03008 %Long 0xf
  ; wait for dcntdone to go HIGH
  WAIT ((Data.Long(A:0xFFD0300C)&0x1)==0x1) 1.s
  IF (Data.Long(A:0xFFD0300C)&0x1)!=0x1
  (
    PRINT %ERROR "DCLKDONE timeout."
    ENDDO FALSE()
  )

  ; wait for F2S_USERMODE to go HIGH
  WAIT ((Data.Long(A:0xFFD03080)&0x4)==0x4) 1.s
  IF (Data.Long(A:0xFFD03080)&0x4)!=0x4
  (
    PRINT %ERROR "Status Register, USERMODE not set."
    ENDDO FALSE()
  )

  GOSUB FpgaManagerDeinit

  ; final check - F2S_CONDONE_PIN, F2S_NSTATUS_PIN, F2S_USERMODE HIGH?
  IF (Data.Long(A:0xFFD03080)&0x54)!=0x54
  (
    PRINT %ERROR "Status Register check failed. CONDONE, NSTATUS & USERMODE must be HIGH."
    ENDDO FALSE()
  )

  PRINT "FPGA LOAD SUCCESS!"
)

ENDDO TRUE()

; --------------------------------------------------------------------------------
; Subroutines
; --------------------------------------------------------------------------------

PrintUsage:
  PRINT "Usage:"
  PRINT "  DO arria10soc_fpgaloadrbf.cmm CLEAR "
  PRINT "  DO arria10soc_fpgaloadrbf.cmm EARLYRBF=""<PathTo>/<filename>.rbf"""
  PRINT "  DO arria10soc_fpgaloadrbf.cmm RBF=""<PathTo>/<filename>.rbf"""
  PRINT "  CLEAR          : Reset the FPGA Manager"
  PRINT "  EARLYRBF       : SharedIO RBF File"
  PRINT "  RBF            : FPGA design"
  PRINT "  <filename>.rbf : Path and filename of the FPGA Design to load."
  PRINT "                   Must be in Raw-Binary-Format."
  PRINT %ERROR "Invalid Usage! Type AREA for more details."
  RETURN

; --------------------------------------------------------------------------------

ParseParameters: ;(param)
  PRIVATE &param &command &filename &clear &earlyrbf &rbf
  ENTRY %LINE &param
  ; parse command line
  &clear=STRing.SCAN("&param","CLEAR",0.)>=0.
  &earlyrbf=STRing.SCANAndExtract("&param","EARLYRBF=""","")
  &rbf=STRing.SCANAndExtract("&param","RBF=""","")
  IF !&clear&&("&earlyrbf&rbf"==""||("&earlyrbf"!=""&&"&rbf"!=""))
  (
    GOSUB PrintUsage
    ENDDO FALSE()
  )
  ; remove trailing quote sign
  &earlyrbf=STRing.Replace("&earlyrbf","""","",0.)
  &rbf=STRing.Replace("&rbf","""","",0.)

  IF &clear
  (
    &command=1.
    &filename=""
  )
  ELSE IF "&earlyrbf"!=""
  (
    &command=2.
    &filename="&earlyrbf"
  )
  ELSE IF "&rbf"!=""
  (
    &command=3.
    &filename="&rbf"
  )
  ELSE
  (
    GOSUB PrintUsage
    ENDDO FALSE()
  )
  IF "&filename"!=""
  (
    IF !OS.FILE("&filename")
    (
      PRINT %ERROR "Error: File &filename not found."
      ENDDO FALSE()
    )
  )

  RETURN "&command" "&filename"

; -----------------------------------------------------------------------------

FpgaManagerInit: ;(cdratio)
  PARAMETERS &cdratio
  PRIVATE &msel

  ; force FPPx32 mode
  ; imgcfg_ctrl_2 - set    cfg width
  Data.Set A:0xFFD03078 %Long  Data.Long(A:0xFFD03078)|0x01000000
  ; imgcfg_ctrl_2 - set    cdratio
  Data.Set A:0xFFD03078 %Long (Data.Long(A:0xFFD03078)&~0x30000)|(&cdratio<<16.)

  ; wait for NCONFIG/NSTATUS to go HIGH
  WAIT ((Data.Long(A:0xFFD03080)&0x1010)==0x1010) 1.s
  IF (Data.Long(A:0xFFD03080)&0x1010)!=0x1010
  (
    PRINT %ERROR "Status Register, NCONFIG/NSTATUS must be HIGH."
    ENDDO FALSE()
  )

  ; Step 4:
  ; imgcfg_ctrl_1 - set   s2f_nce
  Data.Set A:0xFFD03074 %Long Data.Long(A:0xFFD03074)|0x01000000
  ; imgcfg_ctrl_1 - clear s2f_pr_request
  Data.Set A:0xFFD03074 %Long Data.Long(A:0xFFD03074)&~0x10000
  ; imgcfg_ctrl_2 - clear en_cfg_data, en_cfg_ctrl
  Data.Set A:0xFFD03078 %Long Data.Long(A:0xFFD03078)&~0x101
  ; imgcfg_ctrl_0 - set   s2f_nconfig
  Data.Set A:0xFFD03070 %Long Data.Long(A:0xFFD03070)|0x100
  ; imgcfg_ctrl_0 - clear s2f_nstatus_oe, s2f_condone_oe
  Data.Set A:0xFFD03070 %Long Data.Long(A:0xFFD03070)&~0x01010000

  ; Step 5:
  ; imgcfg_ctrl_1 - clear s2f_nenable_config
  Data.Set A:0xFFD03074 %Long Data.Long(A:0xFFD03074)&~0x1
  ; imgcfg_ctrl_0 - clear s2f_nenable_nconfig
  Data.Set A:0xFFD03070 %Long Data.Long(A:0xFFD03070)&~0x1
  ; imgcfg_ctrl_0 - set   s2f_nenable_nstatus, s2f_nenable_condone
  Data.Set A:0xFFD03070 %Long Data.Long(A:0xFFD03070)|0x6

  ; Step 6:
  ; imgcfg_ctrl_1 - clear s2f_nce
  Data.Set A:0xFFD03074 %Long Data.Long(A:0xFFD03074)&~0x01000000

  ; Step 7:
  ; wait for NCONFIG/NSTATUS to go HIGH
  WAIT ((Data.Long(A:0xFFD03080)&0x1010)==0x1010) 1.s
  IF (Data.Long(A:0xFFD03080)&0x1010)!=0x1010
  (
    PRINT %ERROR "Status Register, NCONFIG/NSTATUS must be HIGH."
    ENDDO FALSE()
  )
  RETURN

; -----------------------------------------------------------------------------

FpgaManagerDeinit: ;()
  ; Step 14:
  ; imgcfg_ctrl_2 - clear en_cfg_data, en_cfg_ctrl
  Data.Set A:0xFFD03078 %Long Data.Long(A:0xFFD03078)&~0x101

  ; Step 15:
  ; imgcfg_ctrl_1 - set   s2f_nenable_config
  Data.Set A:0xFFD03074 %Long Data.Long(A:0xFFD03074)|0x1
  ; imgcfg_ctrl_0 - set   s2f_nenable_nconfig
  Data.Set A:0xFFD03070 %Long Data.Long(A:0xFFD03070)|0x1
  ; imgcfg_ctrl_1 - set   s2f_nce
  Data.Set A:0xFFD03074 %Long Data.Long(A:0xFFD03074)|0x01000000

  RETURN

; -----------------------------------------------------------------------------

FpgaManagerReset: ;()
  ; imgcfg_ctrl_0 - clear s2f_nconfig
  Data.Set A:0xFFD03070 %Long Data.Long(A:0xFFD03070)&~0x100
  ; wait for NSTATUS to go LOW
  WAIT ((Data.Long(A:0xFFD03080)&0x10)==0x0) 1.s
  IF (Data.Long(A:0xFFD03080)&0x10)!=0x0
  (
    PRINT %ERROR "Status Register, NSTATUS must be LOW."
    ENDDO FALSE()
  )
  ; imgcfg_ctrl_0 - set   s2f_nconfig
  Data.Set A:0xFFD03070 %Long Data.Long(A:0xFFD03070)|0x100
  ; wait for NSTATUS to go HIGH
  WAIT ((Data.Long(A:0xFFD03080)&0x10)==0x10) 1.s
  IF (Data.Long(A:0xFFD03080)&0x10)!=0x10
  (
    PRINT %ERROR "Status Register, NSTATUS must be HIGH."
    ENDDO FALSE()
  )
  IF (Data.Long(A:0xFFD03080)&0x40)!=0x0
  (
    PRINT %ERROR "Status Register, USERMODE must be LOW. CLEAR failed."
    ENDDO FALSE()
  )
  IF (Data.Long(A:0xFFD03080)&0x80)==0x0
  (
    PRINT %ERROR "Status Register, INITDONE_OE must be HIGH. CLEAR failed."
    ENDDO FALSE()
  )
  RETURN

; -----------------------------------------------------------------------------

CalcCdratio: ;(file)
  PARAMETERS &file
  Data.LOAD.Binary "&file" VM:0x0++0xfff /NoClear /NosYmbol
  LOCAL &encrypt &compress &cdratio
  &encrypt=((Data.Long(VM:0x45*0x4)>>2.)&0x3)!=0
  &compress=((Data.Long(VM:0xE5*0x4)>>1.)&0x1)==0

  IF ((!&compress)&&(!&encrypt))
  (
    &cdratio=0x0
  )
  ELSE
  (
    IF (&compress)
    (
      &cdratio=0x2
    )
    ELSE
    (
      &cdratio=0x1
    )
    &cdratio=&cdratio+0x1
  )
  RETURN "&cdratio"

; -----------------------------------------------------------------------------
