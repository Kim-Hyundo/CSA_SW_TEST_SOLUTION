; --------------------------------------------------------------------------------
; @Title: Run a Sieve demo in SRAM for SPANSION SK-FM4-U120 
; @Description: 
;   This demo show how to connect TRACE32 to the MB9BF568R Cortex-M4F on SPANSION
;   SK-FM4-U120 and load a simple sieve demo on SRAM and start a debug session
;     SRAM: 0x1FFF0000--0x200FFFFF
;
; @Keywords: Cortex-M4F, SWD, sieve 
; @Author: MSA
; @Board: SPANSION
; @Chip: MB9BF568R
; @Copyright: (C) 1989-2019 Lauterbach GmbH, licensed for use with TRACE32(R) only
; --------------------------------------------------------------------------------
; $Id: mb9bf568r_sieve_sram.cmm 15217 2019-11-04 16:17:15Z bschroefel $

  RESet
  SYStem.RESet
  SYStem.CPU MB9BF568R
  SYStem.Option.ResBreak OFF
  SYStem.CONFIG.DEBUGPORTTYPE SWD

  SYStem.Up

  ; initialize SRAM to 0x0
  D.S SD:0x1FFF0000--0x1FFF0FFF %LE %Long 0x0
  D.S SD:0x1FFF1000--0x1FFF1FFF %LE %Long 0x0
  Data.LOAD.Elf ~~~~/sieve_ram_thumb_ii_v7.elf

  ; open some windows
  WinCLEAR

  WinPOS 0% 0% 50% 50%
  List.auto

  WinPOS 50% 0% 50% 50%
  Register.view /SpotLight

  WinPOS 0% 50% 50% 50%
  Frame /Locals /Caller

  WinPOS 50% 50% 50% 50%
  Var.DRAW sinewave
  
  GO
  WAIT 2.s
  Break
  ENDDO
