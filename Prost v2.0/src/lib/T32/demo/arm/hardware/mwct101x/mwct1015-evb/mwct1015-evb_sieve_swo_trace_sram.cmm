; --------------------------------------------------------------------------------
; @Title: Demo script for MWCT1015S on MWCT1015-EVB with SWV (RAM)
; @Description:
;   Loads the sieve demo application into RAM and sets up a demo debug
;   scenario.
;   The SerialWireViewer is set up to trace some data values using the DWT.
;   Prerequisites:
;    * Connect Combiprobe/uTrace to J14
; @Keywords: ARM, Cortex-M4, ITM, SWV
; @Author: STK
; @Board: MWCT1015-EVB
; @Chip: MWCT1015S
; @Copyright: (C) 1989-2019 Lauterbach GmbH, licensed for use with TRACE32(R) only
; --------------------------------------------------------------------------------
; $Id: mwct1015-evb_sieve_swo_trace_sram.cmm 15223 2019-11-05 16:29:45Z bschroefel $


; Prerequisite: check if a Combiprobe/uTrace is connected
IF !CAnalyzer()
(
  DIALOG.OK "Support for SerialWireViewer requires a Combiprobe or uTrace."
  ENDDO
)

WinCLEAR

; --------------------------------------------------------------------------------
; initialize and start the debugger
RESet
SYStem.RESet
SYStem.CPU MWCT1015S
SYStem.CONFIG.DEBUGPORTTYPE SWD
SYStem.Option DUALPORT ON
SYStem.MemAccess DAP
SYStem.JtagClock 10MHz
Trace.DISable
SYStem.Up

GOSUB DisableWatchdog

; --------------------------------------------------------------------------------
; load demo program (uses internal RAM only)
Data.LOAD.Elf "~~~~/sieve_ram_thumb_ii_v7m.elf"

; --------------------------------------------------------------------------------
; start program execution
Go.direct main
WAIT !STATE.RUN()

; --------------------------------------------------------------------------------
; initialize SerialWireViewer (clock is stable now)
Trace.METHOD CAnalyzer
Trace.AutoInit ON
TPIU.PortSize SWV
ITM.DataTrace ON
ITM.ON
; use auto-calibration script to find most suitable TPIU.SWVPrescaler <divider>
DO ~~/demo/arm/etc/serial_wire_viewer/swv_autocalibration.cmm

; --------------------------------------------------------------------------------
; setup ITM based datatrace of variable plot1
Var.Break.Set plot1 /Write /TraceData

; --------------------------------------------------------------------------------
; open some windows
WinCLEAR
Mode.Hll
WinPOS 0. 0. 116. 26.
List.auto
WinPOS 120. 0. 100. 8.
Frame.view
WinPOS 120. 14.
Var.Watch
Var.AddWatch %SpotLight ast flags
WinPOS 120. 25.
ITMTrace.List
WinPOS 0. 32.
Trace.DRAW.Var %DEFault plot1

ENDDO

DisableWatchdog:
(
  LOCAL &tmp1 &tmp2
  &tmp1=Data.Long(ST:0x20000000)
  &tmp2=Data.Long(ST:0x20000004)
  Register.SWAP
  ; The watchdog has a restrictive timing. It has to be configured and unlocked within a peripod
  ; of 128 cycles. Therefor the unlock sequence need to be done by a small target program.
  Data.Assemble ST:0x20000000  str  r1,[r0]  ;SD:0x40052004 = 0xD928C520   (Key)
  Data.Assemble ,              str  r3,[r2]  ;SD:0x40052000 = 0x00002120   (Control register)
  Data.Assemble ,              str  r5,[r4]  ;SD:0x40052008 = 0x0000FFFF   (Timeout value)
  Data.Assemble ,              bkpt #0
  Register.Set PC 0x20000000
  Register.Set SP 0x20001000
  Register.Set R0 0x40052004
  Register.Set R1 0xD928C520
  Register.Set R2 0x40052000
  Register.Set R3 0x00002120
  Register.Set R4 0x40052008
  Register.Set R5 0x0000FFFF
  Go.direct
  WAIT !STATE.RUN()

  Data.Set ST:0x20000000 %Long &tmp1
  Data.Set ST:0x20000004 %Long &tmp2
  Register.SWAP

  RETURN
)
