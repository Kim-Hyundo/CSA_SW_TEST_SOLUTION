; --------------------------------------------------------------------------------
; @Title: On-chip trace demo script for R7FA2A1A* on EK-RA2A1 (MTB,RAM)
; @Description:
;   Loads the sieve demo application into RAM and sets up a demo debug
;   scenario.
;   Uses on-chip trace via MTB.
;   Use this script for getting started.
;   Prerequisites:
;    * Connect Debug Cable to j10 using Adapter LA-3770
;      or
;      Connect Combiprobe/uTrace to j10
; @Keywords: ARM, Cortex-M23, MTB
; @Author: CMO
; @Board: EK-RA2A1
; @Chip: R7FA2A1A*
; @Copyright: (C) 1989-2020 Lauterbach GmbH, licensed for use with TRACE32(R) only
; --------------------------------------------------------------------------------
; $Id: ek-ra2a1_sieve_onchip_mtb.cmm 15691 2020-02-17 10:30:18Z cmorgenstern $

LOCAL &chip

WinCLEAR

; --------------------------------------------------------------------------------
; initialize and start the debugger
RESet
SYStem.RESet

; Script compatible chips:
; R7FA2A1AB2CBT
; R7FA2A1AB3CFJ
; R7FA2A1AB3CFM
; R7FA2A1AB3CNE
; R7FA2A1AB3CNF
&chip="R7FA2A1AB3CFM"
SYStem.CPU &chip

SYStem.CONFIG.DEBUGPORTTYPE SWD
IF COMBIPROBE()||UTRACE()
(
  SYStem.CONFIG.CONNECTOR MIPI20T
)
SYStem.Option DUALPORT ON
SYStem.MemAccess DAP
SYStem.JtagClock 10MHz
Trace.DISable
SYStem.Up

GOSUB DisableWatchdog

; --------------------------------------------------------------------------------
; load demo program (uses internal RAM only)
Data.LOAD.Elf "~~~~/sieve_ram_thumb_ii_v8m_base.elf"

; --------------------------------------------------------------------------------
; initialize ONCHIP trace (MTB)
Trace.METHOD Onchip
Trace.TBADDRESS ADDRESS.OFFSET(sYmbol.SECADDRESS(.mtb))
Trace.SIZE 64.


; --------------------------------------------------------------------------------
; start program execution
Go.direct main
WAIT !STATE.RUN()

; --------------------------------------------------------------------------------
; open some windows
WinCLEAR
Mode.Hll
WinPOS 0. 0. 116. 26.
List.auto
WinPOS 120. 0. 100. 8.
Frame.view
WinPOS 120. 14.
Var.Watch
Var.AddWatch %SpotLight ast flags
WinPOS 120. 25.
Trace.List
WinPOS 0. 32.
Var.DRAW %DEFault sinewave

ENDDO


DisableWatchdog:
(
  ; disable the Watchdog by setting mask bits in DBGSTOPCR
  Data.Set ASD:0x4001B010 %Long (Data.Long(ASD:0x4001B010)|0x3)
  RETURN
)
