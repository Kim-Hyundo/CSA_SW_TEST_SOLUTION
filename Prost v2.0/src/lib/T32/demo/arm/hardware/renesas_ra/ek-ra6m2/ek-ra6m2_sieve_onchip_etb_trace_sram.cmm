; --------------------------------------------------------------------------------
; @Title: Demo script for R7FA6M2* chips on EK-RA6M2 boards with Onchip-Trace (RAM)
; @Description:
;   Loads the sieve demo application into RAM and sets up a demo debug
;   scenario.
;   The program flow is traced using the Onchip-Trace.
;   Prerequisites:
;    * Connect Debug Cable to j10 using Adapter LA-3770
;      or
;      Connect Combiprobe/uTrace to j10
; @Keywords: ARM, Cortex-M4, ETB, ETM
; @Author: CMO
; @Board: EK-RA6M2
; @Chip: R7FA6M2*
; @Copyright: (C) 1989-2020 Lauterbach GmbH, licensed for use with TRACE32(R) only
; --------------------------------------------------------------------------------
; $Id: ek-ra6m2_sieve_onchip_etb_trace_sram.cmm 15690 2020-02-17 10:25:11Z cmorgenstern $

LOCAL &chip

WinCLEAR

; --------------------------------------------------------------------------------
; initialize and start the debugger
RESet
SYStem.RESet

; Script compatible chips:
; R7FA6M2AD2CLK
; R7FA6M2AD3CFB
; R7FA6M2AD3CFP
; R7FA6M2AF2CLK
; R7FA6M2AF3CFB
; R7FA6M2AF3CFP
&chip="R7FA6M2AD3CFB"
SYStem.CPU &chip

SYStem.CONFIG.DEBUGPORTTYPE SWD
IF COMBIPROBE()||UTRACE()
(
  SYStem.CONFIG.CONNECTOR MIPI20T
)
SYStem.Option DUALPORT ON
SYStem.MemAccess DAP
SYStem.JtagClock 10MHz
Trace.DISable
SYStem.Up

GOSUB DisableWatchdog

; --------------------------------------------------------------------------------
; load demo program (uses internal RAM only)
Data.LOAD.Elf "~~~~/sieve_ram_thumb_ii_v7m.elf"

; --------------------------------------------------------------------------------
; initialize ONCHIP trace (ETB, ETM, ITM)
Trace.METHOD ONCHIP
Trace.AutoInit ON

GOSUB EnableTraceClock

ITM.DataTrace CorrelatedData
ITM.ON
ETM.Trace ON
ETM.ON

; --------------------------------------------------------------------------------
; start program execution
Go.direct main
WAIT !STATE.RUN()

; --------------------------------------------------------------------------------
; open some windows
WinCLEAR
Mode.Hll
WinPOS 0. 0. 116. 26.
List.auto
WinPOS 120. 0. 100. 8.
Frame.view
WinPOS 120. 14.
Var.Watch
Var.AddWatch %SpotLight ast flags
WinPOS 120. 25.
Trace.List
WinPOS 0. 32.
Var.DRAW %DEFault sinewave

ENDDO


DisableWatchdog:
(
  ; disable the Watchdog by setting mask bits in DBGSTOPCR
  Data.Set ASD:0x4001B010 %Long (Data.Long(ASD:0x4001B010)|0x3)
  RETURN
)


EnableTraceClock:
(
  ; After each reset, the trace clock must be enbaled for on- and off-chip trace

  ; Aquire write permission for PLL registers
  Data.Set ASD:0x4001E3FE %Word ((Data.Word(ASD:0x4001E3FE)&0xff)|0xa501)

  ; Enable trace clock
  Data.Set ASD:0x4001E03F %Byte (Data.Byte(ASD:0x4001E03F)|0x80)

  ; Disable write permission for PLL registers
  Data.Set ASD:0x4001E3FE %Word ((Data.Word(ASD:0x4001E3FE)&0xfe)|0xa500)

  RETURN
)
