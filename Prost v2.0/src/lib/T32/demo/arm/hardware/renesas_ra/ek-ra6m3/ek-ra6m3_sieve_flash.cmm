; --------------------------------------------------------------------------------
; @Title: Demo script for R7FA6M3* chips on EK-RA6M3 boards (FLASH)
; @Description:
;   Programs the sieve demo application into the processor internal flash and
;   sets up a demo debug scenario.
;   This script can be used as a template for flashing an application.
;   Prerequisites:
;    * Connect Debug Cable to j13 or j20 using Adapter LA-3770
;      or
;      Connect Combiprobe/uTrace to j13 or j20
; @Keywords: ARM, Cortex-M4, Flash
; @Author: CMO
; @Board: EK-RA6M3
; @Chip: R7FA6M3*
; @Copyright: (C) 1989-2020 Lauterbach GmbH, licensed for use with TRACE32(R) only
; --------------------------------------------------------------------------------
; $Id: ek-ra6m3_sieve_flash.cmm 15792 2020-03-10 08:43:42Z cmorgenstern $

LOCAL &chip

WinCLEAR

; --------------------------------------------------------------------------------
; initialize and start the debugger
RESet
SYStem.RESet

; Script compatible chips:
; R7FA6M3AF2CBG
; R7FA6M3AF2CLK
; R7FA6M3AF3CFB
; R7FA6M3AF3CFC
; R7FA6M3AF3CFP
; R7FA6M3AH2CBG
; R7FA6M3AH2CLK
; R7FA6M3AH3CFB
; R7FA6M3AH3CFC
; R7FA6M3AH3CFP
&chip="R7FA6M2AF3CFB"
SYStem.CPU &chip

SYStem.CONFIG.DEBUGPORTTYPE SWD
IF COMBIPROBE()||UTRACE()
(
  SYStem.CONFIG.CONNECTOR MIPI20T
)
SYStem.Option DUALPORT ON
SYStem.MemAccess DAP
SYStem.JtagClock 10MHz
Trace.DISable
SYStem.Up

GOSUB DisableWatchdog

; --------------------------------------------------------------------------------
; Flash programming

; prepare flash programming (declarations)
DO ~~/demo/arm/flash/r7fx.cmm PREPAREONLY CPU=&chip

; ReProgram Flash
FLASH.ReProgram ALL
Data.LOAD.Elf "~~~~/sieve_flash_thumb_ii_v7m.elf"
FLASH.ReProgram OFF

; --------------------------------------------------------------------------------
; Reset the target again
SYStem.Up

GOSUB DisableWatchdog

; --------------------------------------------------------------------------------
; start program execution
Go.direct main
WAIT !STATE.RUN()

; --------------------------------------------------------------------------------
; open some windows
WinCLEAR
Mode.Hll
WinPOS 0. 0. 116. 26.
List.auto
WinPOS 120. 0. 100. 8.
Frame.view
WinPOS 120. 14.
Var.Watch
Var.AddWatch %SpotLight ast flags
WinPOS 120. 25.
Register.view /SpotLight
WinPOS 0. 32.
Var.DRAW %DEFault sinewave

ENDDO

DisableWatchdog:
(
  ; disable the Watchdog by setting mask bits in DBGSTOPCR
  Data.Set ASD:0x4001B010 %Long (Data.Long(ASD:0x4001B010)|0x3)
  RETURN
)
