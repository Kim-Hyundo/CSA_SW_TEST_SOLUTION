; --------------------------------------------------------------------------------
; @Title: Start script for the Renesas R-CarH1 (4x Cortex-A9)
; @Description:
;   Set up a connection with the 4 Cortex-A9 cores of the R-Car H1 and load
;   simple sieve demo.
; @Keywords: Cortex-A9, Renesas, SMP
; @Author: PEG
; @Board: MARZEN
; @Chip: R8A77790
; @Copyright: (C) 1989-2019 Lauterbach GmbH, licensed for use with TRACE32(R) only
; --------------------------------------------------------------------------------
; $Id: r_carh1_simple_smp_demo.cmm 15217 2019-11-04 16:17:15Z bschroefel $


  SYStem.RESet
  SYStem.CPU RCARH1
  SYStem.JtagClock 5.MHz
  CORE.ASSIGN 1. 2. 3. 4.
  SYStem.Mode Up

  CORE 0.

; Avoid WFI power down states
  Data.Set ASD:0xF0000008 %Long 0x00000000

; Enabling power for core 2, 3 and 4
  Data.Set EAHB:0xFFD8500C %Long 0x00000000
  Data.Set EAHB:0xFFD85010 %Long 0x00000000

  WAIT (Data.Long(EAHB:0xFFD85000)&0x2)==0x2 100ms

  IF (Data.Long(EAHB:0xFFD85000)&0x2)!=0x2
  (
    DIALOG.OK "Cannot power up the cores"
    ENDDO
  )

  Data.Set EAHB:0xFFD8504C %Long 0x0000000e

; Load demo application
  CORE 0.
  Register.RESet
  Data.LOAD.Elf ~~~~/demo.axf
  Register.Set PC main
  Register.Set R13 0xfe798000
  CORE 1.
  Register.Set PC background
  CORE 2.
  Register.Set PC background
  CORE 3.
  Register.Set PC background
  CORE 0.

  ; open some windows
  WinCLEAR
  WinPOS 0% 0% 100% 50%
  List.auto
  WinPOS 0% 50% 50% 50%
  Frame /Locals /Caller
  WinPOS 50% 50% 50% 50%
  Var.Watch
  Var.AddWatch ast; flags;

  ENDDO
