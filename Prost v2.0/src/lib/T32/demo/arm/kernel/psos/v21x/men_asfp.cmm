; --------------------------------------------------------------------------------
; @Title: PRACTICE Script for Menu Item
; @Description: 
;   "Analyzer -> Statistic -> Function Runtime -> Prepare"
;   in a pSOS+/PPC environment
;   The analyzer is programmed to record the Functions and the magic,
;   so the analyzer can use it for task specific actions.
; @Props: NoWelcome
; @Author: DIE
; @Copyright: (C) 1989-2019 Lauterbach GmbH, licensed for use with TRACE32(R) only
; --------------------------------------------------------------------------------
; $Id: men_asfp.cmm 15210 2019-11-04 10:51:00Z bschroefel $


; program analyzer with focus on alpha and beta breakpoints: 
  Analyzer.ReProgram 
  (
    Sample.Enabled    IF (AB||BB)
    Mark.A IF AB
    Mark.B IF BB
  )
  Analyzer.STATistic.PreFetch ON
  Analyzer.STATistic.Sort symbol

; delete all predefined Alpha and Beta breakpoints
  Break.Delete /Alpha  /Beta 

; set Alpha Breakpoint on magic address
  Break.Set task.config(magic)++(task.config(magicsize)-0x1) /Alpha 

; set Alpha and Beta breakpoints on Function Entries/Exits
  Break.SetFunc

; Important !! Delete Breakpoints in interrupt routines
; to avoid overrun problems
;  b.d y.range(int1)  /a /b
;  b.d y.range(int2)  /a /b

; Important !! Delete Breakpoints in user tasks (no main loop traced)
; or move Alpha & Beta breakpoints to beginning and end of endless
; loops (main loops treated as functions)
;  b.d y.range(user1)  /a /b
;  b.d y.range(user2)  /a /b

