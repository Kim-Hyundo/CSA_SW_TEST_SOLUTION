; --------------------------------------------------------------------------------
; @Title: Nucleus  Demo for TRACE32 OS Awareness
; @Description: 
;   
;   This batchfile loads all necessary files to demonstrate
;   the OS Awareness for Nucleus.
;   
; @Keywords: nucleus, RTOS
; @Author: DIE
; @Chip: ARM7TDMI
; @Copyright: (C) 1989-2019 Lauterbach GmbH, licensed for use with TRACE32(R) only
; --------------------------------------------------------------------------------
; $Id: nucleus.cmm 15210 2019-11-04 10:51:00Z bschroefel $

 SCREEN.ON

; Debugger reset
 PRINT "resetting..."
 RESet
 WinPAGE.RESet
 WinPOS 0 20. 70. 8. 0. 0. W000
 AREA.view

; initialize system
 PRINT "initializing..."

 SYStem.CPU ARM7TDMI
 SYStem.Up

; load sample application
 PRINT "loading sample application..."
 Data.LOAD.Elf demo
 
; initialize RTOS support
 PRINT "initializing Nucleus support..."
 TASK.CONFIG ~~/demo/arm/kernel/nucleus/nucleus.t32      ; load Nucleus awareness
 MENU.ReProgram ~~/demo/arm/kernel/nucleus/nucleus.men   ; load Nucleus specific menu
 HELP.FILTER.Add rtosnucleus    ; add nucleus manual to help filter
 
 ; if you use Nucleus Processes:
 sYmbol.AutoLOAD.CHECKCoMmanD "do ~~/demo/arm/kernel/nucleus/autoload"

 PRINT "load complete."
 
; open some windows
 WinPOS 0 0 74. 9. 0. 1. W001
 TASK.TaskStat 
 WinPOS 0 12. 80. 3. 0. 1. W003
 TASK.QueueStat
 WinPOS 50. 6. 70. 21.
 List.auto
 
 Go task_1_entry
 
 ENDDO
