; --------------------------------------------------------------------------------
; @Title: Object browse dialog for QXK
; @Description: -
; @Author: DIE
; @Props: NoWelcome
; @Copyright: (c) 1989-2017 Lauterbach GmbH, licensed for use with TRACE32(R) only
; --------------------------------------------------------------------------------
; $Id: objdialog.cmm 2776 2017-12-15 08:54:34Z ydaoud $

local &obj &cmd
entry &obj &cmd

dialog
(&
        header "Display &obj"
        pos 1. 1. 20.
obj:    defedit "" ""
        pos 22. 1. 7.
        button "Browse..."
        (
            local &wildcard
            &wildcard=dialog.string(obj)
            symbol.browse.v &wildcard * /c "dialog.set obj ""*""" /d
        )
        pos 5. 3. 7.
        defbutton "Ok"
        (
            local &addr
            &addr=dialog.string(obj)
            ON ERROR goto enddlg
            TASK.&cmd &addr
enddlg:     ON ERROR
            dialog.end
        )
        pos 18. 3. 7.
        button "Cancel"
        (
            dialog.end
        )
        pos 0. 0. 30. 5.
        box "&obj"
)

enddo
