; --------------------------------------------------------------------------------
; @Title: uT-Kernel Demo for TRACE32 OS Awareness
; @Description: This batchfile demonstrates the OS Awareness for uT-Kernel.
; @Keywords: awareness, RTOS, tkernel, utkernel
; @Author: DIE
; @Chip: AT91M55800A
; @Copyright: (C) 1989-2019 Lauterbach GmbH, licensed for use with TRACE32(R) only
; --------------------------------------------------------------------------------
; $Id: utkernel.cmm 15210 2019-11-04 10:51:00Z bschroefel $


 SCREEN.ON                    ; all messages are displayed
 AREA.RESet
 WinPAGE.RESet
 WinCLEAR
 WinPOS 0. 26. 63. 7.
 AREA.view

; Debugger reset

 PRINT "resetting..."
 RESet

; Initializing Debugger

 PRINT "initializing..."
 SYStem.CPU AT91M55800A
 SYStem.Up

; Load sample application

 PRINT "loading sample application..."
 Data.LOAD.Elf kernel-rom.rom /cygdrive
 
; Initialize RTOS support

 PRINT "initializing uC/OS-III support..."
 TASK.CONFIG utkernel.t32       ; load uT-Kernel Awareness
 MENU.ReProgram utkernel.men    ; load uT-Kernel Menu
 HELP.FILTER.Add rtostkernel    ; add uT-Kernel awareness manual to help filter

; Open some windows

 List.auto
 
 TASK.TASK 

; Start application

 Go usermain
 
 PRINT "done."
