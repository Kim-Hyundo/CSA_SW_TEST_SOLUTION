; --------------------------------------------------------------------------------
; @Title: SafeRTOS Demo for TRACE32 OS Awareness
; @Description:
;
;   This batchfile loads all necessary files to demonstrate
;   the OS Awareness for SafeRTOS.
;
; @Keywords: awareness, RTOS, SafeRTOS
; @Author: DIE
; @Copyright: (C) 1989-2019 Lauterbach GmbH, licensed for use with TRACE32(R) only
; --------------------------------------------------------------------------------
; $Id: example.cmm 15912 2020-04-07 08:14:04Z rdienstbeck $

 SCREEN.ON
 WinPAGE.RESet
 WinPOS 0. 25. 70. 7. 0. 0. W000
 AREA.view

; Debugger reset
 PRINT "resetting..."
 RESet

; initialize debugger
 PRINT "initializing..."
 SYStem.CPU CortexM7
 SYStem.Up

; load sample application
 PRINT "loading sample application..."
 Data.LOAD.Elf rtosdemo.elf /cygdrive

; initialize RTOS support
 PRINT "initializing SafeRTOS support..."
 TASK.CONFIG ~~/demo/arm/kernel/safertos/safertos.t32       ; load SafeRTOS awareness
 MENU.ReProgram ~~/demo/arm/kernel/safertos/safertos.men    ; load SafeRTOS menu
 HELP.FILTER.Add rtosfreertos   ; add FreeRTOS awareness manual to filtered help

 PRINT "load complete."

; open some windows
 WinPOS 0. 0. 70. 20.
 List.auto
 WinPOS 48. 5. 65. 20. 0. 1. W001
 TASK.TaskList

; start application
 Go vLEDFlashTask

 ENDDO

