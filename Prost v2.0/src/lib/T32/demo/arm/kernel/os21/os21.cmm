; --------------------------------------------------------------------------------
; @Title: OS21 Demo for TRACE32 OS Awareness
; @Description: 
;   This batchfile loads all necessary files to demonstrate
;   the OS Awareness for OS21.
; @Keywords: awareness, os21, RTOS
; @Author: DIE
; @Chip: ARM926EJ-S
; @Copyright: (C) 1989-2019 Lauterbach GmbH, licensed for use with TRACE32(R) only
; --------------------------------------------------------------------------------
; $Id: os21.cmm 15210 2019-11-04 10:51:00Z bschroefel $


 SCREEN.ON

; Emulator reset
 PRINT "resetting..."
 RESet
 WinPAGE.RESet
 WinPOS 0 26. 70. 8. 0. 0. W000
 AREA.view

 PRINT "initializing..."

; System settings 
 SYStem.CPU ARM926EJ
 SYStem.Up
 
; load sample application
 PRINT "loading sample application..."
 Data.LOAD.Elf example.axf
 
; initialize OS21 support
 PRINT "initializing RTOS support..."
 TASK.CONFIG os21           ; load OS21 awareness (os21.t32)
 MENU.ReProgram os21        ; load OS21 specific menu (os21.men)
 HELP.FILTER.Add rtosos21   ; add OS21 awareness manual to help filter
 
 PRINT "load complete."
 
; open some windows

 WinPOS 0. 0.
 List.auto
 WinPOS 50. 10. 80. 13.
 TASK.TASK
 
; start application

  Go Process_0
  
