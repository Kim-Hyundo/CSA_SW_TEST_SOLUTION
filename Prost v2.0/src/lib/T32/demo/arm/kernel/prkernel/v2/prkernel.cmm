; --------------------------------------------------------------------------------
; @Title: PrKERNEL Demo for TRACE32 OS Awareness
; @Description: 
;   
;   This batchfile loads all necessary files to demonstrate
;   the OS Awareness for PrKERNEL.
;   
;   This script has been tested with following PrKERNEL versions:
;   
;   2006-03-20:  Version v4 2.1
;   
; @Keywords: awareness, prkernel, RTOS
; @Author: DIE
; @Copyright: (C) 1989-2019 Lauterbach GmbH, licensed for use with TRACE32(R) only
; --------------------------------------------------------------------------------
; $Id: prkernel.cmm 15210 2019-11-04 10:51:00Z bschroefel $

;   Created by Rudi Dienstbeck / Lauterbach GmbH

 SCREEN.ON                    ; all messages are displayed
 AREA.RESet
 WinPAGE.RESet
 WinCLEAR
 WinPOS 0. 27. 63. 7. 0. 0. W006
 AREA.view

; Debugger reset

 PRINT "resetting..."
 RESet

; Initializing Debugger

 PRINT "initializing..."
 
 SYStem.Up

; load sample application

 PRINT "loading sample application..."

 Data.LOAD.COFF sample_16.out

; some patches for Simulator 
 Data.Assemble UART_DrvTask+0x20 nop

; initialize RTOS support
 PRINT "initializing PrKERNEL support..."
 TASK.CONFIG ~~/demo/arm/kernel/prkernel/v2/prkernel.t32    ; load PrKERNEL awareness
 MENU.ReProgram ~~/demo/arm/kernel/prkernel/v2/prkernel.men ; load PrKERNEL specific menu
 HELP.FILTER.Add rtosprkernel   ; add PrKERNEL awareness manual to help filter

 PRINT "load complete."  ; send to Message Line

; open some windows

 WinPOS 0. 0. 73. 23. 11. 1. W001
 List.auto
 
 WinPOS 40. 15. 60. 6. 0. 1. W003
 TASK.TASK 

 ;Go initsk
 Go task_A
 
 ENDDO

