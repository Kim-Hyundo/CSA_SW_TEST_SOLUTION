; --------------------------------------------------------------------------------
; @Title: WinCE 7.0 Demo for TRACE32 OS Awareness on NE1-TB
; @Description:
;
;   This batchfile demonstrates the use of the OS Awareness for CE7
;
;   The example is generated for an NE1-TB (NaviEngine) board using an ICD.
;   It will NOT run on any other board, but may be used as a template
;   for others.
;   The Windows CE image is downloaded via the ICD.
;
; @Keywords: awareness, Windows
; @Author: DIE
; @Chip: ARM11MPCORE
; @Board: NE1-TB (NaviEngine)
; @Copyright: (C) 1989-2019 Lauterbach GmbH, licensed for use with TRACE32(R) only
; --------------------------------------------------------------------------------
; $Id: wince.cmm 15223 2019-11-05 16:29:45Z bschroefel $


; Starting WinCE example with TRACE32:
; - Start TRACE32
; - Power on the board
; - TRACE32: "do wince"
; - Start "control.exe" on target (Start->Settings->Control Panel)

; For debugging with TRACE32 we recommend to disable demand paging
; by setting bit one of ROMFLAGS in PLATFORM\NE1TB\FILES\config.bib

; For Bootloader communication, connect to serial port using the Honda adapter
; - 38400 baud, 8/N/1, no(!) handshake


&winceroot=".\WINCE700"    ; typically C:\WINCE700
&reldir="&winceroot\OSDesigns\NE1TB\NE1TB\RelDir\NE1TB_ARMV6_Debug"


 SCREEN.ON


; Debugger Reset

 WinPAGE.RESet
 AREA.RESet
 WinPOS 0. 24. 75. 8.
 AREA.view

 PRINT "resetting..."

 RESet


; Initializing Debugger

 PRINT "initializing..."
 SYStem.CPU ARM11MPCORESMP4
 SYStem.JtagClock RTCK          ; hardware dependent (see manual)
 SYStem.Option DACR ON          ; give Debugger global write permissions
 TrOnchip.Set DABORT OFF        ; used by Linux for page miss!
 TrOnchip.Set PABORT OFF        ; used by Linux for page miss!
 TrOnchip.Set UNDEF OFF         ; my be used by Linux for FPU detection
 SYStem.Option MMUSPACES ON     ; enable space ids to virtual addresses

 SYStem.Up

 SETUP.IMASKASM ON             ; lock interrupts while single stepping


; Target Setup: initialize DRAM controller and peripherals

 ; start u-boot to initialize the board
 Go
 PRINT "target setup..."
 WAIT 1.s
 Break

 ; load eboot
 ; see RAMIMAGE entry in eboot.bib for physical load address
 ; see ROMOFFSET for offset to flash load address
 ; then load eboot to <phys. addr.> - <flash addr.>
 Register.RESet
 PRINT "loading eboot..."
 Data.LOAD.eXe "&reldir\eboot.bin" 0x80020000-0x90080000
 Register.Set PC 0x80020000

 ; let eboot initialize everything
 Go
 PRINT "running eboot..."
 WAIT 1.s
 Break


; Load the Windows CE image

 ; Use the next lines only to load the image into
 ; RAM using the debugger.

 PRINT "loading Windows CE image..."

 ; Prepare for direct download: disable MMU!
 PER.Set.simple C15:0x1   %Long Data.Long(c15:1)&~1        ; switch off MMU

 Register.RESet

 ; Download the image to physical address.
 ; In case of NE1TB, physical=virtual address, so we don't need any adjustment

 Data.LOAD.eXe &reldir\nk.bin

 ; set PC to physical start address
 Register.Set PC 0x80100000


; We'd like to see something, open a code window.
 WinPOS 0. 0. 77. 22.
 List.auto


; Declare the MMU format to the debugger

 ; table format is "WINCE6"
 ; skip root table (0)
 ; declare default translation for kernel
 MMU.FORMAT WINCE6 0 0x80000000--0x8fffffff 0x80000000

 ; ROM DLL, shared heap and kernel addresses are common to all processes
 TRANSlation.COMMON 0x40000000--0x5fffffff 0x70000000--0xffffffff

 ; debugger uses a table walk to decode virtual addresses
 TRANSlation.TableWalk ON

 ; switch on debugger(!) address translation
 TRANSlation.ON


; Initialize RTOS Support

 PRINT "initializing Windows CE support..."
 TASK.CONFIG ~~\demo\arm\kernel\wince\ce7\wince7.t32      ; loads WinCE awareness
 MENU.ReProgram ~~\demo\arm\kernel\wince\ce7\wince7.men   ; loads WinCE menu
 HELP.FILTER.Add rtoswince6     ; add WinCE awareness manual to help

 ; switch on autoloader and add path to symbol files to source path list
 sYmbol.AutoLoad.CHECKWINCE "do ~~\demo\arm\kernel\wince\ce7\autoload "
 sYmbol.SourcePATH.Set &reldir

 ; Group kernel area to be displayed with red bar
 GROUP.Create "winceos" 0x80000000--0xffffffff /RED

 ; adapt source paths if necessary (case sensitive!)
 sYmbol.SourcePATH.Translate "c:\wince700" "&winceroot"
 sYmbol.SourcePATH.Translate "d:\chelanprvw6\" "&winceroot"
 sYmbol.SourcePATH.Set .    ; add current directory to search path


; DO NOT TOUCH THE DEBUG REGISTERS!

 ; The BSP tries to use the debug registers.
 ; When using TRACE32, the target application *must not* touch these

 PRINT "patching BSP..."

 TASK.ROM.PA 0x80100000                 ; specify physical address of image
 TASK.sYmbol.Option AutoLoad NoProcess  ; no processes yet to handle
 TASK.sYmbol.LOADRM "nk.exe"            ; load symbols of OEM
 TASK.sYmbol.Option AutoLoad Process    ; allow processes again

 ; Patch OEMKDIoControl not to do anything
 Data.Assemble OEMKDIoControl mov r0,#0x0
 Data.Assemble , bx r14

 ;g \\nk\init\OEMInit
 ;wait !STATE.RUN()
 ;Var.set initialOALLogZones = 0x7f
 ;stop

; Now let's boot and start Windows CE!

 Go
 PRINT "booting Windows CE... (please wait)"
 WAIT 15.s
 Break


 PRINT "done."


; --------------------------------------------------------------------------------
; Application Debugging
; e.g. "control.exe"

 DO ~~\demo\arm\kernel\wince\ce7\app_debug control

 ENDDO

