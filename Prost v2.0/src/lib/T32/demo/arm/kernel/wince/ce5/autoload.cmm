; --------------------------------------------------------------------------------
; @Title: WinCE 5.0 Symbol Autoloader Script
; @Description: Autoload script, called by TRACE32 if symbols are to be loaded
; @Keywords: awareness, windows
; @Author: DIE
; @Copyright: (C) 1989-2019 Lauterbach GmbH, licensed for use with TRACE32(R) only
; --------------------------------------------------------------------------------
; $Id: autoload.cmm 15210 2019-11-04 10:51:00Z bschroefel $


// define local macros
 LOCAL &filename &basename &progname &symfilename &filepath &code &data &space

// get filename and relocation information
 // these parameters are passed from TRACE32 when calling this skript
 
 ENTRY &filename &type &code &data &space
 
 //print "autoload: " &filename " " &type " " &code " " &data " " &space
 
 // &filename:      name of process/file
 // &type:          type of file: 1=process, 2=library, 3=ROM module
 // &code:          text segment address
 // &data:          data segment address
 // &space:         space id of process

// get symbol file name and program name
 &basename=STRing.CUT(&filename,-STRing.LENgth(OS.FILE.EXTENSION(&filename)))
 IF (&type==1)
   &symfilename="&basename"+".exe"
 IF ((&type&0xffff)==2)
   &symfilename="&basename"+".dll"
 IF (&type==3)
   &symfilename=&filename
 &progname=OS.FILE.NAME("&basename")

// delete symbols if they already exist
 IF sYmbol.EXIST("\\&progname")
   sYmbol.Delete \\&progname
 GROUP.Delete "&progname"
 
// search file in source search path and open dialog when not there
 &filepath=sYmbol.SEARCHFILE("&symfilename")
 IF !OS.FILE("&filepath")
 (
   LOCAL &file
   &file=OS.FILE.NAME("&symfilename")
   WinPOS ,,,,,, filebox normal "Searching symbols for &filename"
   DIALOG.File "*\&file"
   ENTRY %LINE &filepath
   IF "&filepath"==""
     ENDDO
 )

// load symbol file (options for sourcepath, e.g. /STRIPPART may need to be added when required)

 IF (&type==1)  // processes
 (
   IF "&space"==""     // kernel process
   (
     Data.LOAD.eXe "&filepath" 0:0 /NoCODE /NoClear /RELOC .text at &code /RELOC .data at &data
   )
   ELSE         // userland process 
   (
     Data.LOAD.eXe "&filepath" &space:0 /NoCODE /NoClear
     ;MMU.TaskPageTable.SCAN &space:0     // not necessary: done by TRANSlation.TableWalk
     GROUP.Create "&progname" &space:0x0--0x6fffffff /GREEN
   )
 )
 
 IF ((&type&0xffff)==2) // libraries
 (
   IF "&space"==""
     &space=0 
   Data.LOAD.eXe &filepath &space:0 /NoCODE /NoClear \
     /reloc .text at &code /RELOC .data at &data \
     /strippart "c:\macallan" /PATH "C:\WINCE500"
 )
 
 IF (&type==3)  // ROM modules
 (
   Data.LOAD.eXe "&filepath" 0:0 /NoCODE /NoClear \
     /reloc .text at &code /RELOC .data at &data \
     /strippart "c:\macallan" /PATH "C:\WINCE500" \
     /name &progname
 )
 
 ENDDO
