; --------------------------------------------------------------------------------
; @Title: WinCE 7.0 Demo for TRACE32 OS Awareness on the BeagleBoard
; @Description:
;
;   This batchfile demonstrates the use of the OS Awareness for CE7
;
;   The example is generated for a OMAP3530 Beagleboard using an ICD.
;   It will NOT run on any other board, but may be used as a template
;   for others.
;   The Windows CE image is downloaded via the ICD.
;
; @Keywords: awareness, Windows
; @Author: DIE
; @Board: BeagleBoard
; @Chip: OMAP3530
; @Copyright: (C) 1989-2019 Lauterbach GmbH, licensed for use with TRACE32(R) only
; --------------------------------------------------------------------------------
; $Id: wince.cmm 15210 2019-11-04 10:51:00Z bschroefel $


; Starting WinCE example with TRACE32:
; - Start TRACE32
; - Power on the board
; - TRACE32: "do wince"
; - Start "application1.exe" on target via CMD

; For debugging with TRACE32 we recommend to disable demand paging
; by setting bit one of ROMFLAGS in PLATFORM\NE1TB\FILES\config.bib

; Connect  STRAIGHT serial cable to RS232
; - 115200 baud, 8/N/1, no(!) handshake


&winceroot=".\WINCE700"    ; typically C:\WINCE700
&reldir="&winceroot\OSDesigns\BeagleBoard\BeagleBoard\RelDir\Beagleboard_ARMV7_Debug"


 SCREEN.ALways      ; permanent update for internal terminal window
 ; screen.on        ; if you use external terminal


; Debugger Reset

 WinPAGE.RESet
 AREA.RESet
 WinPOS 0. 24. 75. 8.
 AREA.view

 PRINT "resetting..."

 RESet


; Initializing Debugger

 PRINT "initializing..."
 SYStem.CPU OMAP3530
 SYStem.JtagClock RTCK          ; hardware dependent (see manual)
 SYStem.Option DACR ON          ; give Debugger global write permissions
 TrOnchip.Set DABORT OFF        ; used by Linux for page miss!
 TrOnchip.Set PABORT OFF        ; used by Linux for page miss!
 TrOnchip.Set UNDEF OFF         ; my be used by Linux for FPU detection
 SYStem.Option MMUSPACES ON     ; enable space ids to virtual addresses

 SYStem.Up

 SETUP.IMASKASM ON             ; lock interrupts while single stepping


; Open serial terminal window on COM1

 WinPOS 35. 0. ,,,,, TERM.view
 TERM.METHOD COM COM1 115200. 8 NONE 1STOP NONE
 TERM.SIZE 80. 1000.
 TERM.Mode VT100
 TERM.SCROLL ON
 TERM.view


; Target Setup: initialize DRAM controller and peripherals

 ; start u-boot to initialize the board
 Go
 PRINT "target setup..."
 WAIT 5.s
 Break


; Load the Windows CE image

 ; Use the next lines only to load the image into
 ; RAM using the debugger.

 PRINT "loading Windows CE image..."

 ; Prepare for direct download: disable MMU!
 PER.Set.simple C15:0x1   %Long Data.Long(c15:1)&~1        ; switch off MMU

 Register.RESet

 ; Download the image to physical address.
 ; In case of BeagleBoard, physical=virtual address, so we don't need any adjustment

 Data.LOAD.eXe &reldir\nk.bin

 ; set PC to physical start address
 ; see config.bib NK RAMIMAGE
 Register.Set PC 0x80201000


; We'd like to see something, open a code window.
 WinPOS 0. 0. 77. 22.
 List.auto


; Declare the MMU format to the debugger

 ; table format is "WINCE6"
 ; skip root table (0)
 ; declare default translation for kernel
 MMU.FORMAT WINCE6 0 0x80000000--0x8fffffff 0x80000000

 ; ROM DLL, shared heap and kernel addresses are common to all processes
 TRANSlation.COMMON 0x40000000--0x5fffffff 0x70000000--0xffffffff

 ; debugger uses a table walk to decode virtual addresses
 TRANSlation.TableWalk ON

 ; switch on debugger(!) address translation
 TRANSlation.ON


; Initialize RTOS Support

 PRINT "initializing Windows CE support..."
 TASK.CONFIG ~~\demo\arm\kernel\wince\ce7\wince7.t32      ; loads WinCE awareness
 MENU.ReProgram ~~\demo\arm\kernel\wince\ce7\wince7.men   ; loads WinCE menu
 HELP.FILTER.Add rtoswince6     ; add WinCE awareness manual to help

 ; switch on autoloader and add path to symbol files to source path list
 sYmbol.AutoLoad.CHECKWINCE "do ~~\demo\arm\kernel\wince\ce7\autoload "
 sYmbol.SourcePATH.Set &reldir

 ; Group kernel area to be displayed with red bar
 GROUP.Create "winceos" 0x80000000--0xffffffff /RED

 ; adapt source paths if necessary (case sensitive!)
 sYmbol.SourcePATH.Translate "c:\wince700" "&winceroot"
 sYmbol.SourcePATH.Translate "d:\chelanprvw6" "&winceroot"
 sYmbol.SourcePATH.Set .    ; add current directory to search path


; Now let's boot and start Windows CE!

 wintop TERM.view
 Go
 PRINT "booting Windows CE... (please wait)"
 WAIT 3.s
 Break


 PRINT "done."


; --------------------------------------------------------------------------------
; Application Debugging
; e.g. "application1.exe"

 DO ~~\demo\arm\kernel\wince\ce7\app_debug application1

 ENDDO

