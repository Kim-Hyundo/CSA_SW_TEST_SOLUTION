; --------------------------------------------------------------------------------
; @Title: Startup Script for Debugging WinCE 6.0 Startup on Mistral EVM 3530 Board
; @Description:
;   - Start TRACE32
;   - TRACE32: "do wince-OEMInit"
;   - Power on the board
;   Connect NULL modem cable to UART 3
;   - 115200 baud, 8/N/1, no(!) handshake
; @Keywords: awareness, Windows
; @Author: DIE
; @Chip: OMAP3530
; @Board:  Mistral EVM 3530
; @Copyright: (C) 1989-2019 Lauterbach GmbH, licensed for use with TRACE32(R) only
; --------------------------------------------------------------------------------
; $Id: wince-oeminit.cmm 15223 2019-11-05 16:29:45Z bschroefel $


LOCAL &winceroot &reldir

;&winceroot="C:\WINCE600"
&winceroot=".\WINCE600"
&reldir="&winceroot\OSDesigns\EVM_3530\EVM_3530\RelDir\EVM_OMAP3530_ARMV4I_Release"


 SCREEN.ALways      ; permanent update for internal terminal window
 ; screen.on        ; if you use external terminal


; Debugger Reset

 WinPAGE.RESet
 AREA.RESet
 WinPOS 0. 24. 75. 8.
 AREA.view

 PRINT "resetting..."

 RESet


; Open serial terminal window on COM1

 WinPOS 35. 0. ,,,,, TERM.view
 TERM.METHOD COM COM1 115200. 8 NONE 1STOP NONE
 TERM.SIZE 80. 1000.
 TERM.Mode VT100
 TERM.SCROLL ON
 TERM.view


; Initializing Debugger

 PRINT "initializing..."
 SYStem.CPU OMAP3530
 SYStem.JtagClock RTCK          ; hardware dependent (see manual)
 SYStem.Option DACR ON          ; give Debugger global write permissions
 TrOnchip.Set DABORT OFF        ; used by Linux for page miss!
 TrOnchip.Set PABORT OFF        ; used by Linux for page miss!
 TrOnchip.Set UNDEF OFF         ; my be used by Linux for FPU detection
 SYStem.Option MMUSPACES ON     ; enable space ids to virtual addresses


; Wait for power up of target

 ON powerup GOTO start
 PRINT "waiting for power cycle..."
 STOP
start:
 ON powerup     ; remove powerup action
 WAIT 100.ms

 SYStem.Up

 SETUP.IMASKASM ON             ; lock interrupts while single stepping


; Target Setup: initialize DRAM controller and peripherals

 ; start u-boot to initialize the board
 Go
 PRINT "target setup..."
 WAIT 4.s
 Break


; Run until Eboot starts WinCE

 Break.Set 0x800122f8 /Onchip       ; start address of image on SD card
 ON PBREAKAT 0x800122f8 GOTO continue1
 Go
 PRINT "waiting for WinCE start..."
 STOP

continue1:
 ON PBREAKAT 0x800122f8         ; delete script action
 Break.RESet


; If you like to load a new Windows CE image

 ;print "loading Windows CE image..."
 ;Data.LOAD.EXE &reldir\nk.bin

 ;Register.Set PC 0x80002000


; We'd like to see something, open a code window.
 WinPOS 0. 0. 77. 22.
 List.auto


; Declare the MMU format to the debugger

 ; table format is "WINCE6"
 ; skip root table (0)
 ; declare default translation for kernel
 MMU.FORMAT WINCE6 0 0x80000000--0x87ffffff 0x80000000

 ; ROM DLL, shared heap and kernel addresses are common to all processes
 TRANSlation.COMMON 0x40000000--0x5fffffff 0x70000000--0xffffffff

 ; debugger uses a table walk to decode virtual addresses
 TRANSlation.TableWalk ON

 ; switch on debugger(!) address translation
 TRANSlation.ON


; Initialize RTOS Support

 PRINT "initializing Windows CE support..."
 TASK.CONFIG ~~\demo\arm\kernel\wince\ce6\wince6.t32      ; loads WinCE awareness
 MENU.ReProgram ~~\demo\arm\kernel\wince\ce6\wince6.men   ; loads WinCE menu
 HELP.FILTER.Add rtoswince6     ; add WinCE awareness manual to help

 ; switch on autoloader and add path to symbol files to source path list
 sYmbol.AutoLoad.CHECKWINCE "do ~~\demo\arm\kernel\wince\ce6\autoload "
 sYmbol.SourcePATH.Set &reldir

 ; Group kernel area to be displayed with red bar
 GROUP.Create "winceos" 0x80000000--0xffffffff /RED

 ; adapt source paths if necessary (case sensitive!)
 sYmbol.SourcePATH.Translate "c:\wince600" "&winceroot"
 sYmbol.SourcePATH.Translate "d:\dublin2-1" "C:\WINCE600"
 sYmbol.SourcePATH.Set .    ; add current directory to search path


; Load OEM symbols

 PRINT "loadig symbols of nk.exe..."
 TASK.ROM.PA 0x80002000                 ; specify physical address of image
 TASK.sYmbol.Option AutoLoad NoProcess  ; no processes yet to handle
 TASK.sYmbol.LOADRM "nk.exe"            ; load symbols of OEM
 TASK.sYmbol.Option AutoLoad Process    ; allow processes again


; Now let's boot Windows CE!

 wintop TERM.view
 Break.Set OEMInit
 Go
 PRINT "booting WinCE..."
 WAIT !STATE.RUN()
 Break.Delete OEMInit

 TASK.ROM.VA

 PRINT "done."


 ENDDO





