; --------------------------------------------------------------------------------
; @Title: WinCE 6.0 Demo for TRACE32 OS Awareness Mistral EVM 3530 (Rev G)
; @Description:
;
;   This batchfile demonstrates the use of the OS Awareness for CE6
;
;   The example is generated for a Mistral EVM 3530 (Rev G) board using an ICD.
;   It will NOT run on any other board, but may be used as a template
;   for others.
;   The Windows CE image is downloaded from the SD card.
;
; @Keywords: awareness, Windows
; @Author: DIE
; @Chip: OMAP3530
; @Board: Mistral EVM 3530 (Rev G)
; @Copyright: (C) 1989-2019 Lauterbach GmbH, licensed for use with TRACE32(R) only
; --------------------------------------------------------------------------------
; $Id: wince.cmm 15223 2019-11-05 16:29:45Z bschroefel $


; Starting WinCE example with TRACE32:
; - Start TRACE32
; - TRACE32: "do wince"
; - Power on the board

; For debugging with TRACE32 we recommend to disable demand paging
; by setting bit one of ROMFLAGS in PLATFORM\NE1TB\FILES\config.bib

; Connect NULL modem cable to UART 3
; - 115200 baud, 8/N/1, no(!) handshake


LOCAL &winceroot &reldir

;&winceroot="C:\WINCE600"
&winceroot=".\WINCE600"
&reldir="&winceroot\OSDesigns\EVM_3530\EVM_3530\RelDir\EVM_OMAP3530_ARMV4I_Release"


 SCREEN.ALways      ; permanent update for internal terminal window
 ; screen.on        ; if you use external terminal


; Debugger Reset

 WinPAGE.RESet
 AREA.RESet
 WinPOS 0. 24. 75. 8.
 AREA.view

 PRINT "resetting..."

 RESet


; Open serial terminal window on COM1

 WinPOS 35. 0. ,,,,, TERM.view
 TERM.METHOD COM COM1 115200. 8 NONE 1STOP NONE
 TERM.SIZE 80. 1000.
 TERM.Mode VT100
 TERM.SCROLL ON
 TERM.view


; Initializing Debugger

 PRINT "initializing..."
 SYStem.CPU OMAP3530
 SYStem.JtagClock RTCK          ; hardware dependent (see manual)
 SYStem.Option DACR ON          ; give Debugger global write permissions
 TrOnchip.Set DABORT OFF        ; used by Linux for page miss!
 TrOnchip.Set PABORT OFF        ; used by Linux for page miss!
 TrOnchip.Set UNDEF OFF         ; my be used by Linux for FPU detection
 SYStem.Option MMUSPACES ON     ; enable space ids to virtual addresses


; Wait for power up of target

 ON powerup GOTO start
 PRINT "waiting for power cycle..."
 STOP
start:
 ON powerup     ; remove powerup action
 WAIT 100.ms

 SYStem.Up

 SETUP.IMASKASM ON             ; lock interrupts while single stepping


; Target Setup: initialize DRAM controller and peripherals

 ; start u-boot to initialize the board
 Go
 PRINT "target setup..."
 WAIT 4.s
 Break


; If you like to load new nk.bin:

 ; run until Eboot starts WinCE

 ;Break.Set 0x800122f8 /Onchip  ; start address of image on SD card
 ;Go
 ;print "waiting for WinCE start..."
 ;wait !STATE.RUN()
 ;Break.RESet

 ; load the Windows CE image

 ;print "loading Windows CE image..."
 ;Data.LOAD.EXE &reldir\nk.bin


; If you like to start WinCE from SD card

 PRINT "please boot WinCE from SD card!"


; We'd like to see something, open a code window.
 WinPOS 0. 0. 77. 22.
 List.auto


; Declare the MMU format to the debugger

 ; table format is "WINCE6"
 ; skip root table (0)
 ; declare default translation for kernel
 MMU.FORMAT WINCE6 0 0x80000000--0x87ffffff 0x80000000

 ; ROM DLL, shared heap and kernel addresses are common to all processes
 TRANSlation.COMMON 0x40000000--0x5fffffff 0x70000000--0xffffffff

 ; debugger uses a table walk to decode virtual addresses
 TRANSlation.TableWalk ON

 ; switch on debugger(!) address translation
 TRANSlation.ON


; Initialize RTOS Support

 PRINT "initializing Windows CE support..."
 TASK.CONFIG ~~\demo\arm\kernel\wince\ce6\wince6.t32      ; loads WinCE awareness
 MENU.ReProgram ~~\demo\arm\kernel\wince\ce6\wince6.men   ; loads WinCE menu
 HELP.FILTER.Add rtoswince6     ; add WinCE awareness manual to help

 ; switch on autoloader and add path to symbol files to source path list
 sYmbol.AutoLoad.CHECKWINCE "do ~~\demo\arm\kernel\wince\ce6\autoload "
 sYmbol.SourcePATH.Set &reldir

 ; Group kernel area to be displayed with red bar
 GROUP.Create "winceos" 0x80000000--0xffffffff /RED

 ; adapt source paths if necessary (case sensitive!)
 sYmbol.SourcePATH.Translate "c:\wince600" "&winceroot"
 sYmbol.SourcePATH.Translate "d:\dublin2-1" "C:\WINCE600"
 sYmbol.SourcePATH.Set .    ; add current directory to search path


; Now let's boot and start Windows CE!

 wintop TERM.view

 Go
 PRINT "booting Windows CE..."

 PRINT "done."


; --------------------------------------------------------------------------------
; Application Debugging
; e.g. "ExmpleApp.exe"

; do ~~\demo\arm\kernel\wince\ce7\app_debug ExmpleApp

 ENDDO





