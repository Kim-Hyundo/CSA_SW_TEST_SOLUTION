; --------------------------------------------------------------------------------
; @Title: RTEMS Demo for TRACE32 OS Awareness
; @Description:
;   This batchfile loads all necessary files to demonstrate
;   the OS Awareness for RTEMS.
; @Keywords: awareness, rtems, RTOS
; @Author: DIE
; @Chip: ARM7TDMI
; @Copyright: (C) 1989-2019 Lauterbach GmbH, licensed for use with TRACE32(R) only
; --------------------------------------------------------------------------------
; $Id: rtems.cmm 15223 2019-11-05 16:29:45Z bschroefel $


 SCREEN.ON                    ; all messages are displayed

 AREA.RESet
 WinPAGE.RESet
 WinCLEAR
 WinPOS 0. 26. 63. 7. 0. 0. W006
 AREA.view

; Debugger reset

 PRINT "resetting..."
 RESet

; Initializing Debugger

 PRINT "initializing..."

 SYStem.CPU LPC2420
 SYStem.Up

; load sample application

 PRINT "loading sample application..."

 Data.LOAD.Elf ticker-arm.elf

; patch some peripheral stuff for simulator

 IF INTERFACE.SIM()
 (
   Data.Assemble bsp_start_hook_0+0x14 nop
   Data.Assemble lpc24xx_set_pll+0x84 nop
   Data.Assemble lpc24xx_micro_seconds_delay+0x82 nop
   Data.Assemble printk+0x16 bx r14
   Data.Assemble bsp_start_hook_1+0x124 nop     ; init bss
   Data.Assemble bsp_start_hook_1+0x136 nop
 )

; initialize RTOS support
 PRINT "initializing RTOS support..."
 TASK.CONFIG ~~/demo/arm/kernel/rtems/rtems.t32     ; load RTEMS awareness
 MENU.ReProgram ~~/demo/arm/kernel/rtems/rtems.men  ; load RTEMS specific menu (rtems.men)
 HELP.FILTER.Add rtosrtems  ; add RTEMS awareness manual to help filter

 PRINT "load complete."

; open some windows

 WinPOS 0. 0. 73. 23.
 List.auto

 WinPOS 30. 12. 80. 9.
 TASK.Thread

; start application

 Break.Set _Thread_Idle_body

 Go Init
