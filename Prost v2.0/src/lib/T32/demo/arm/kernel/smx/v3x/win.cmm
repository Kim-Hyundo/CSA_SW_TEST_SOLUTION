; --------------------------------------------------------------------------------
; @Props: NoMetaTags, NoIndex
; @Copyright: (C) 1989-2019 Lauterbach GmbH, licensed for use with TRACE32(R) only
; --------------------------------------------------------------------------------
; $Id: win.cmm 15210 2019-11-04 10:51:00Z bschroefel $


 B::
 
 TOOLBAR ON
 STATUSBAR ON
 WinPAGE.RESet
 
 WinCLEAR
 WinPOS 0.0 28. 63. 7. 0. 0. W000
 AREA.view
 
 WinPOS 44. 5. 77. 22. 13. 1. W001
 WinTABS 10. 10. 25. 62.
 List.auto
 
 WinPOS 0. 0. 70. 10. 0. 1. W003
 TASK.TASK
 
 WinPAGE.select P000     
 
 ENDDO
