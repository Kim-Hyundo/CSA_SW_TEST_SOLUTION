; --------------------------------------------------------------------------------
; @Title: Symbian OS Demo for TRACE32 OS Awareness on TI OMAP H2 Board
; @Description:
;
;   This batchfile demonstrates the use of the OS Awareness for Symbian OS
;
;   The example is generated for a TI OMAP H2 board using an ICD.
;   It will NOT run on any other board, but may be used as a template
;   for others.
;   Symbian OS is downloaded to the board via ICD.
;
; @Keywords: awareness, eka2, h2, mmu, RTOS, symbian
; @Author: DIE
; @Chip: OMAP1610
; @Board: OMAP H2
; @Copyright: (C) 1989-2019 Lauterbach GmbH, licensed for use with TRACE32(R) only
; --------------------------------------------------------------------------------
; $Id: symbian.cmm 15236 2019-11-08 07:27:03Z bschroefel $

;   Created by Rudi Dienstbeck / Lauterbach GmbH at 09.02.2005

 SCREEN.ON

; Debugger Reset

 WinPAGE.RESet
 AREA.RESet
 WinPOS 0. 26. 75. 8. 0. 0. W000
 AREA.view

 PRINT "resetting..."

 SYStem.Down
 Break.Delete
 MAP.RESet
 TASK.RESet
 sYmbol.RESet
 sYmbol.AutoLOAD.CHECK OFF      ; disable dynamic autoloader
 sYmbol.AutoLOAD.RESet          ; reset autoloader list
 TRANSlation.RESet

; setup of ICD

 PRINT "initializing..."

 SYStem.CPU OMAP1610
 SYStem.Option DACR ON          ; give Debugger global write permissions
 SYStem.Option IMASKASM ON      ; mask interrupts on asm single steps
 TrOnchip.Set DABORT OFF        ; used by Symbian OS for page miss!
 TrOnchip.Set PABORT OFF        ; used by Symbian OS for page miss!
 TrOnchip.Set SWI OFF           ; let SWI be handled by Symbian OS
 SYStem.Option MMUSpaces ON     ; space ids used
 SYStem.JtagClock RTCK

 IF Analyzer()
   Analyzer.CLOCK 192.mhz

 SYStem.Up

; Target Setup: initialize DRAM controller and peripherals
 PRINT "target setup..."
 DO h2

; Load the Symbian OS image

 PRINT "loading Symbian OS image..."

 ; load binary, skip serial rom header (if built with rom header)!
 ; use ARTCK for faster download

 SYStem.JtagClock ARTCK 20MHz
 Data.LOAD.Binary h2_eabi.img 0x10000000 /SKIP 0x100
 SYStem.JtagClock RTCK

 ; set PC on start address of image
 Register.RESet
 Register.Set PC 0x10000000

; Open a Code Window -- we like to see something

 WinPOS 0. 0. 75. 20.
 List.auto

; Configure Autoloader

 ; The autoloader is able to automatically load symbol files,
 ; if a specific code address is accessed. The autoloader gets
 ; it's information from the rombuild log file, and from the
 ; running process table.
 ; The autoloader is configured to call the skript "autoload.cmm"
 ; when a symbol file needs to be loaded.

 PRINT "configuring autoloader..."

 &epoc32path="."

 ; add search paths for symbol files
 ;sYmbol.SourcePATH.Set &epoc32path\release\ARMv5\UDEB           ; for sym files
 ;sYmbol.SourcePATH.Set T:\src\CEDAR\GENERIC\base\e32\kernel     ; for kernel source files

  ; scan rombuild log file for modules & addresses
 sYmbol.AutoLOAD.LOADEPOC h2_eabi.log "do "+OS.PPD()+"/../../autoload "

 ; define dynamic autoloader
 sYmbol.AutoLOAD.CHECKEPOC "do "+OS.PPD()+"/../../autoload "

 ; switch off automatic process detection (slows down debugger execution)
 sYmbol.AutoLOAD.CHECK OFF

; Load the Symbian OS kernel symbols into the debugger

 PRINT "loading Symbian OS kernel symbols..."

 ; force autoloader to load ekern
 sYmbol.AutoLOAD.TOUCH "*ekern.exe*"
 sYmbol.CLEANUP                 ; cleanup type information
 sYmbol.CLEANUP.CodeLiterals    ; bugfix for "DC.W" debug info

 ; when not using the autoloader, you can load and relocate the ekern
 ; symbols by extracting the ekern addresses through a script:
    ;do ../../reloc &epoc32path\rom\h4.techview.log _h4_ekern.exe
    ;entry &codeaddr &dataaddr
    ;Data.LOAD.exe &epoc32path\release\ARMv5\udeb\_h4_ekern.sym /nocode /cpp /strippart 2 /reloc .text at &codeaddr /reloc .data at &dataaddr /reloc .bss after .data

; Ok, we're done, let's start Symbian OS

 ; set a breakpoint on restart, if kernel panics
 Break.Set Kern::Restart

 ; boot Symbian

 Go
 PRINT "starting Symbian OS, please wait..."
 WAIT 20.s

 ; halt target for further initializing
 Break

; Scan initial MMU settings and switch on debugger MMU

 TRANSlation.COMMON 0x50000000--0xffffffff
 TRANSlation.AutoSCAN ON
 TRANSlation.ON

; Initialize RTOS Support

 PRINT "initializing SymbianOS support..."

 TASK.CONFIG symbian2       ; loads Symbian OS awareness (symbian2.t32)
 MENU.ReProgram symbian2    ; loads Symbian OS menu (symbian2.men)
 HELP.FILTER.Add rtossymbian2 ; add Symbian OS awareness manual to help filter

 PRINT "done."

 ENDDO
