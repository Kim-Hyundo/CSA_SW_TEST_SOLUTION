; --------------------------------------------------------------------------------
; @Title: Symbian OS Demo for TRACE32 OS Awareness on TI OMAP H4 Board
; @Description:
;
;   This batchfile demonstrates the use of
;   the OS Awareness for Symbian OS
;
;   The example is generated for a TI OMAP H4 board using an ICD.
;   It will NOT run on any other board, but may be used as a template
;   for others.
;   Symbian OS is downloaded to the board via ICD.
;
; @Keywords: awareness
; @Author: DIE
; @Board: TI-OMAP-H4
; @Chip: OMAP2420
; @Copyright: (C) 1989-2019 Lauterbach GmbH, licensed for use with TRACE32(R) only
; --------------------------------------------------------------------------------
; $Id: symbian.cmm 15236 2019-11-08 07:27:03Z bschroefel $

;   Created by Rudi Dienstbeck / Lauterbach GmbH at 09.02.2005

 SCREEN.ON

; Debugger Reset

 WinPAGE.RESet
 AREA.RESet
 WinPOS 0. 26. 75. 8. 0. 0. W000
 AREA.view

 PRINT "resetting..."

 SYStem.Down
 Break.Delete
 MAP.RESet
 TASK.RESet
 sYmbol.RESet
 Data.PROLOG.RESet
 Data.EPILOG.RESet
 sYmbol.AutoLOAD.CHECK OFF      ; disable dynamic autoloader
 sYmbol.AutoLOAD.RESet          ; reset autoloader list
 TRANSlation.RESet

; setup of ICD

 PRINT "initializing..."
 SYStem.CPU OMAP2420
 SYStem.Option DACR ON          ; give Debugger global write permissions
 TrOnchip.Set DABORT OFF        ; used by Symbian OS for page miss!
 TrOnchip.Set PABORT OFF        ; used by Symbian OS for page miss!
 TrOnchip.Set SWI OFF           ; let SWI be handled by Symbian OS
 SYStem.Option MMUSpaces OFF    ; NO space ids used (yet)
 ;SYStem.JtagClock 1MHz
 SYStem.JtagClock RTCK 20MHz

; declare read-only memory
 MAP.BOnchip 0x00000000--0x401fffff

 SYStem.Up
; wait until reset is complete
 WAIT (Data.Long(SD:0x48022014)&1)!=0

; disable watchdog timer
 DO disable_watchdog

; Target Setup: initialize DRAM controller and peripherals
 PRINT "target setup..."
 DO h4

; HACK: My board doesn't init correctly at first startup.
; Check memory access, if it fails repower target.
 Data.Set c:0x80000000 %Long 0x12345678
 IF Data.Long(c:0x80000000)!=0x12345678
 (
    Data.dump 80000000   ; show faulty data
    PRINT "switch off/on target and restart this script"
    ENDDO
 )

; Load the Symbian OS image

 PRINT "loading Symbian OS image..."

 &epoc32drive="T:"
 &epoc32path="&epoc32drive"+"\bin\TechView\epoc32"

 ; load binary, skip serial rom header (if built with rom header)!
 ; use Turbo mode only, if target RAM is fast enough

 SYStem.Option TURBO ON
 Data.LOAD.Binary &epoc32path\rom\h4.techview.img 0x80000000 /SKIP 0x100
 SYStem.Option TURBO OFF

 ; set PC on start address of image
 Register.RESet
 Register.Set PC 0x80000000

; Open a Code Window -- we like to see something

 WinPOS 0. 0. 75. 20.
 List.auto

; Configure Autoloader

 ; The autoloader is able to automatically load symbol files,
 ; if a specific code address is accessed. The autoloader gets
 ; it's information from the rombuild log file, and from the
 ; running process table.
 ; The autoloader is configured to call the skript "autoload.cmm"
 ; when a symbol file needs to be loaded.

 PRINT "configuring autoloader..."

 ; add search paths for symbol files
 ;sYmbol.SourcePATH.Set &epoc32path\release\ARMv5\UDEB           ; for sym files
 sYmbol.SourcePATH.Set  &epoc32drive\src\CEDAR\GENERIC\base\e32\kernel     ; for kernel source files
 sYmbol.SourcePATH.Set  &epoc32drive\src\COMMON\TECHVIEW\Apps\agenda\group ; for agenda application sources

  ; scan rombuild log file for modules & addresses
 sYmbol.AutoLOAD.LOADEPOC &epoc32path\rom\h4.techview.log "do "+OS.PPD()+"/../autoload "

 ; define dynamic autoloader
 sYmbol.AutoLOAD.CHECKEPOC "do "+OS.PPD()+"/../autoload "

 ; switch off automatic process detection (slows down debugger execution)
 sYmbol.AutoLOAD.CHECK OFF

; Load the Symbian OS kernel symbols into the debugger

 PRINT "loading Symbian OS kernel symbols..."

 ; force autoloader to load ekern
 sYmbol.AutoLOAD.TOUCH "*ekern.exe*"
 sYmbol.CLEANUP.sYmbols

 ; when not using the autoloader, you can load and relocate the ekern
 ; symbols by extracting the ekern addresses through a script:
    ;do ../reloc &epoc32path\rom\h4.techview.log _h4_ekern.exe
    ;entry &codeaddr &dataaddr
    ;Data.LOAD.exe &epoc32path\release\ARMv5\udeb\_h4_ekern.sym /nocode /cpp /stroppart 2 /reloc .text at &codeaddr /reloc .data at &dataaddr /reloc .bss after .data

; Ok, we're done, let's start Symbian OS

 ; set a breakpoint on restart, if kernel panics
 Break.Set Kern::Restart

 ; Disable GP Timer 1 when processor halted
 Data.EPILOG.SEQuence SET A:48028024 %Long 0x42     ; data.long(a:48028024)&~1
 Data.EPILOG.ON

 ; boot Symbian
 Go
 PRINT "starting Symbian OS, please wait..."
 WAIT 20.s

 ; Enable GP Timer 1 when processor resumed from halting
 Data.PROLOG.SEQuence SET A:48028024 %Long 0x43     ; data.long(a:48028024)|1
 Data.PROLOG.ON

 ; halt target for further initializing
 Break

; disable watchdog timer again
; (restarted by OS if watchdog component included in image)
 ;do disable_watchdog

; Scan initial MMU settings and switch on debugger MMU
 ;(not yet used)
 ;MMU.SCAN
 ;TRANSlation.ON

; Initialize RTOS Support

 PRINT "initializing SymbianOS support..."

 TASK.CONFIG symbian2       ; loads Symbian OS awareness (symbian2.t32)
 MENU.ReProgram symbian2    ; loads Symbian OS menu (symbian2.men)
 HELP.FILTER.Add rtossymbian2 ; add Symbian OS awareness manual to help filter

 PRINT "done."

 ENDDO

