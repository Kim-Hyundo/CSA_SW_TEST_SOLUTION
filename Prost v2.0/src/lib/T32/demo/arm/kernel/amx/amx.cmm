; --------------------------------------------------------------------------------
; @Title: AMX Demo for TRACE32 OS Awareness
; @Description: 
;   This batchfile loads all necessary files to demonstrate
;   the OS Awareness for AMX.
;   This script has been tested with following AMX versions:
;   1999-07-24:   Version 1.01a   Proc: ARM7T
; @Keywords: awareness, RTOS
; @Author: DIE
; @Copyright: (C) 1989-2019 Lauterbach GmbH, licensed for use with TRACE32(R) only
; --------------------------------------------------------------------------------
; $Id: amx.cmm 16323 2020-07-21 11:41:45Z rdienstbeck $


 SCREEN.ON

; Debugger reset
 PRINT "resetting..."
 RESet
 WinPAGE.RESet
 WinPOS 0 26. 70. 8. 0. 0. W000
 AREA.view

; System settings
 PRINT "initializing..."

 IF hardware.ICD()
 (
   SYStem.Up
   Go
   WAIT 1.0s
   Break
 )
 ELSE IF INTERFACE.SIM()
 (
   SYStem.CPU ARM7TDMI
   SYStem.Up
   Data.Assemble 0x8 mov pc,r14     ; patch system call
 )

; load sample application
 PRINT "loading sample application..."
 Data.LOAD.Elf amx_demo.axf

; initialize RTOS support
 PRINT "initializing AMX support..."

 TASK.CONFIG amx.t32        ; load AMX awareness
 MENU.ReProgram amx.men     ; load AMX specific menu
 HELP.FILTER.Add rtosamx    ; add AMX awareness manual to help filter

 PRINT "load complete."

; now open some windows

 WinPOS 0. 0. 80. 25. 13. 1. W000
 List.auto
 
 WinPOS 32. 11. 59. 21. 0. 1. W001
 TASK.DTASK
 
 ENDDO
