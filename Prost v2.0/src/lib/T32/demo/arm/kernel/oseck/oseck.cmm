; --------------------------------------------------------------------------------
; @Title: OSEck Demo for TRACE32 OS Awareness
; @Description: 
;   This batchfile loads all necessary files to demonstrate
;   the OS Awareness for OSEck.
; @Keywords: awareness, oseck, RTOS
; @Author: DIE
; @Chip: ARM1176JZF-S
; @Copyright: (C) 1989-2019 Lauterbach GmbH, licensed for use with TRACE32(R) only
; --------------------------------------------------------------------------------
; $Id: oseck.cmm 15210 2019-11-04 10:51:00Z bschroefel $


 SCREEN.ON

; Debugger reset
 PRINT "resetting..."
 RESet
 WinPAGE.RESet
 WinPOS 0 26. 70. 8. 0. 0. W000
 AREA.view

 PRINT "initializing..."

; System settings 
 SYStem.CPU ARM1176JZF
 SYStem.Up
 
; load sample application
 PRINT "loading sample application..."
 Data.LOAD.Elf ztetest.elf /cygdrive

; initialize OSEck support
 PRINT "initializing OSEck support..."
 TASK.CONFIG ~~\demo\arm\kernel\oseck\oseck.t32     ; load OSE awareness
 MENU.ReProgram ~~\demo\arm\kernel\oseck\oseck.t32  ; load OSE specific menu
 HELP.FILTER.Add rtososeck  ; add OSEck awareness manual to help system
 
; open some windows

 WinPOS 0. 0. 70. 23.
 List.auto
 WinPOS 30. 15. 75. 8.
 TASK.Process

; start application

 Go sysEntry

 PRINT "done."

 ENDDO

