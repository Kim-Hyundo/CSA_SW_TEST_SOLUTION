; --------------------------------------------------------------------------------
; @Title: uC/OS-II Demo for TRACE32 OS Awareness
; @Description: This batchfile demonstrates the OS Awareness for uC/OS-II.
; @Keywords: awareness, RTOS, ucos-ii
; @Author: DIE
; @Chip: ARM7TDMI
; @Copyright: (C) 1989-2019 Lauterbach GmbH, licensed for use with TRACE32(R) only
; --------------------------------------------------------------------------------
; $Id: ucos.cmm 15223 2019-11-05 16:29:45Z bschroefel $


 SCREEN.ON                    ; all messages are displayed
 AREA.RESet
 WinPAGE.RESet
 WinCLEAR
 WinPOS 0. 27. 63. 7. 0. 0. W006
 AREA.view

; Debugger reset

 PRINT "resetting..."
 RESet

; Initializing Debugger

 PRINT "initializing..."

 SYStem.CPU ARM7TDMI
 SYStem.Up

; load sample application

 PRINT "loading sample application..."

 Data.LOAD.Elf ping.elf
 
 IF INTERFACE.SIM()&&y.exist(T32_TsMon_SendStatus)
   Data.Assemble T32_TsMon_SendStatus mov r0,#0 mov pc,r14
 
; initialize RTOS support
 PRINT "initializing uC/OS-II support..."
 TASK.CONFIG ~~/demo/arm/kernel/ucos-ii/ucos.t32    ; load uC/OS-II Awareness
 MENU.ReProgram ~~/demo/arm/kernel/ucos-ii/ucos.men ; load uC/OS-II Menu
 HELP.FILTER.Add rtosucos   ; add ucos awareness manual to help filter

 PRINT "load complete."  ; send to Message Line

; open some windows

 WinPOS 0. 0. 73. 23. 11. 1. W001
 List.auto
 
 ; the applications reroute their outputs to a TRACE32 terminal emulation
 ; see uhal.c for redirection of output to TRACE32 terminal
 
 IF sYmbol.EXIST(T32OUTCHAR)
 (
   TERM.Protocol SingleE
   WinPOS 43. 0. 80. 12. 0. 0. W000
   TERM.view T32OUTCHAR 0
 )

 WinPOS 63. 15. 60. 11. 0. 1. W003
 TASK.TASK 

 Go Main
 
 PRINT "done."
 
