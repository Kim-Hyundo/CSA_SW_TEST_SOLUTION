; --------------------------------------------------------------------------------
; @Title: uCLinux autoload script, called by TRACE32 if symbols are to be loaded
; @Description:
;   This script is part of the TRACE32 uClinux Awareness
; 
; @Keywords: uClinux autoloader awareness
; @Author: DIE
; @Copyright: (C) 1989-2019 Lauterbach GmbH, licensed for use with TRACE32(R) only
; --------------------------------------------------------------------------------
; $Id: autoload_uclinux.cmm 4125 2019-03-22 17:16:46Z kjmal $ 

// define local macros
 LOCAL &filename &basename &progname &symfilename &filepath &code &data &space

// get filename and relocation information
 // these parameters are passed from TRACE32 when calling this skript
 
 ENTRY &filename &type &code &data &space
 
 //print "autoload: " &filename " " &type " " &code " " &data " " &space
 
 // &filename:      name of process/file
 // &type:          type of file: 1=process, 2=library, 3=kernel module
 // &code:          text segment address
 // &data:          data segment address
 // &space:         space id of process (not used in uClinux)
 
// get symbol file name and program name
 &basename=STRing.CUT(&filename,-STRing.LENgth(OS.FILE.EXTENSION(&filename)))
 IF (&type==1)
   &symfilename="&basename"
 IF (&type==2)
   &symfilename="&basename"+".so"
 IF (&type==3)
   &symfilename="&basename"+".ko"
 &progname=OS.FILE.NAME("&basename")

// delete symbols if they already exist
 IF sYmbol.EXIST("\\&progname")
   sYmbol.Delete \\&progname
 GROUP.Delete "&progname"

// search file in source search path and open dialog when not there
 &filepath=sYmbol.SEARCHFILE("&symfilename")
 IF !OS.FILE("&filepath")
 (
   LOCAL &file
   &file=OS.FILE.NAME("&symfilename")
   WinPOS ,,,,,, filebox normal "Searching symbols for &filename"
   DIALOG.File "*\&file"
   ENTRY %LINE &filepath
   IF "&filepath"==""
     ENDDO
 )

// load symbol file (options for sourcepath, e.g. /STRIPPART may need to be added when required)

 IF (&type==1)  // processes
 (
   Data.LOAD.Elf "&filepath" &data /NoCODE /NoClear
   sYmbol.RELOCate.shift P:(&code-&data) sYmbol.SECRANGE(\\&progname\.text)
   GROUP.Create "&progname" sYmbol.SECRANGE(\\&progname\.text) /GREEN
 )
 
 IF (&type==3)  // modules
 (
   LOCAL  &text 
   GLOBAL &reloc

   &magic=task.mod.magic("&progname")
   &text=task.mod.section(".text",&magic)
   IF &text==-1
   (
      PRINT "Error loading symbols: could not get section addresses"
      ENDDO
   )
 
   &reloc=""
   GOSUB add_section .text
   GOSUB add_section .init.text
   GOSUB add_section .rodata
   GOSUB add_section .data
   GOSUB add_section .bss

   Data.LOAD.Elf &filepath /NoCODE /NoClear &reloc
   GROUP.Create "&progname" sYmbol.SECRANGE(\\&progname\.text) /YELLOW
 )
 
 IF ((&type&0xffff)==2) // libraries
 (
   Data.LOAD.Elf &filepath &code /NoCODE /NoClear
 )
 
 ENDDO


// subprogram for module section relocation
add_section:

 LOCAL &name &section
 ENTRY &name

 &section=task.mod.section("&name",&magic)
 IF &section!=-1
     &reloc="&reloc"+" /reloc &name at &section"
 
 RETURN
