; --------------------------------------------------------------------------------
; @Title: Disable the watchdog Timer for the OMAP H4 Board
; @Description: Disable the watchdog timer for the OMAP H4 board
; @Keywords:  OMAP24*, omaph4, RTOS
; @Author: DIE
; @Board: OMAP-H4
; @Chip: OMAP2420
; @Copyright: (C) 1989-2019 Lauterbach GmbH, licensed for use with TRACE32(R) only
; --------------------------------------------------------------------------------
; $Id: omap_h4_disable_watchdog.cmm 15210 2019-11-04 10:51:00Z bschroefel $


; disable watchdog timer

 Data.Set ASD:0x48022048 %Long 0x0000aaaa
 WAIT (Data.Long(ASD:0x48022034)&0x10)==0
 Data.Set ASD:0x48022048 %Long 0x00005555
 WAIT (Data.Long(ASD:0x48022034)&0x10)==0

 ENDDO
