; --------------------------------------------------------------------------------
; @Title: Linux Attach debugging script for MB86R1x Emerald
; @Description: 
;   This script attaches to an MB86R1x Emerald; running with linux.
;   It expects that linux is fully booted.
;   We assume here that 256MB of memory are used for LINUX.
;   Prerequisites:
;   - Set SW10.Pin4 to 1 JTAG DFT mode
;   - Linux is up and running
;   - the vmlinux file matches the uImage booted
; @Keywords: awareness, Fujitsu, Linux, MB86R1*, Emerald
; @Author: DIE
; @Board: SK-86R12-01
; @Chip: MB86R11, MB86R12
; @Copyright: (C) 1989-2019 Lauterbach GmbH, licensed for use with TRACE32(R) only
; --------------------------------------------------------------------------------
; $Id: emerald_linux_attach.cmm 15210 2019-11-04 10:51:00Z bschroefel $


; system configuration
RESet
SYStem.RESet
SYStem.CPU MB86R12

; Prepare Linux specific settings. 
; Don't stop DABORT/PABORT (MMU FAIL)
; Don't stop on UNDEF Instr (FPU Emulation)
; Overwrite DACR register -> full debugger access
TrOnchip.Set DABORT OFF
TrOnchip.Set PABORT OFF
TrOnchip.Set UNDEF OFF
SYStem.Option DACR ON
SYStem.Option MMUSPACES ON

; attach to the running system
SYStem.Mode.Attach

; load symbols
PRINT "Load vmlinux symbols ..."
Data.LOAD.Elf "~~~~/vmlinux" /NoCODE /NoRegister 
sYmbol.SourcePATH.Translate "/home/.../linux-3..." "C:\path\on\remote\pc"

; setup debugger address translation
; PageTableFormat: LINUXSWAP3
; Virtual Kernel Range: 0xc0000000++0x0FFFFFFF
; Physical Kernel Start: 0x00000000
; Section 0xbf000000--0xbfffffff + 0xc0000000--0xffffffff
; are used by the kernel itself
PRINT "Setup Debugger Address Translation ..."
MMU.FORMAT LINUXSWAP3 swapper_pg_dir 0x80000000++0x0fffffff 0x80000000
TRANSlation.COMMON 0x80000000--0xffffffff
TRANSlation.TableWalk ON
TRANSlation.ON

; load awareness for Linux 3.x
PRINT "Load Linux Awareness 3.x ..."
TASK.CONFIG ~~/demo/arm/kernel/linux/linux-3.x/linux3.t32
MENU.ReProgram ~~/demo/arm/kernel/linux/linux-3.x/linux.men

; open some windows
WinPOS 1% 1%
List.auto

ENDDO




