; --------------------------------------------------------------------------------
; @Title: Linux Demo for TRACE32 OS Awareness on the phyCORE-PXA270
; @Description: 
;   This batchfile demonstrates the use of the OS Awareness for Linux
;   The example is generated for a phyCORE-PXA270 board using an ICD.
;   It will NOT run on any other board, but may be used as a template
;   for others.
;   Linux is downloaded to the board via ICD.
; @Keywords: awareness, phycore, pxa*, RTOS
; @Author: DIE
; @Board: phyCORE-PXA270
; @Chip: PXA270
; @Copyright: (C) 1989-2019 Lauterbach GmbH, licensed for use with TRACE32(R) only
; --------------------------------------------------------------------------------
; $Id: pxa270_linux.cmm 15223 2019-11-05 16:29:45Z bschroefel $


; Starting Linux example with TRACE32:
; - Connect terminal (NULL modem cable) to FF-UART (115200-8-N-1-N)
; - Start TRACE32
; - (T32) do linux
; - start "hello"

 LOCAL &ka_path &awareness
 LOCAL &srcdrive
 LOCAL &srcpath
 &srcdrive="S:"
 &srcpath="&srcdrive"+"\"


 SCREEN.ON


; Debugger Reset

 WinPAGE.RESet
 AREA.RESet
 WinPOS 0. 26. 75. 7. 0. 0. W000
 AREA.view
 
 PRINT "resetting..."

 SYStem.Down
 TASK.RESet
 Break.Delete
 MAP.RESet
 sYmbol.RESet
 TRANSlation.RESet


; Initializing Debugger
 
 PRINT "initializing..."
 SYStem.CPU PXA270
 SYStem.Option TRST OFF         ; necessary for the phyCORE board
 SYStem.Option WaitReset ON     ; necessary for the phyCORE board
 SYStem.Option DACR ON          ; give Debugger global write permissions
 SYStem.Option DynVector OFF    ; automatic detection of vector table move
 TrOnchip.Set DABORT OFF        ; used by Linux for page miss!
 TrOnchip.Set PABORT OFF        ; used by Linux for page miss!
 TrOnchip.Set UNDEF OFF         ; used by Linux for FPU detection
 SYStem.Option MMUSPACES ON     ; enable space ids to virtual addresses
 SYStem.JtagClock 10.0MHz       ; 25.0MHz may cause troubles

 SYStem.Up

 SETUP.IMASKASM ON              ; lock interrupts while single stepping


; Target Setup: initialize board memory access and peripherals
 
 ; let the boot monitor setup the board
 Register.Set PC 0     ; start from boot 
 Go
 PRINT "target setup..."
 WAIT 2.s
 Break
 

; Load the Linux kernel

 ; If you are using a flashed kernel, or if you're loading 
 ; your kernel via TFTP, use the boot monitor to do so.
 
 ; Use the next lines (loading the kernel, setting registers
 ; and boot parameters) only to load the kernel into
 ; RAM using the debugger.

 ; vmlinux starts physically at RAM start (=0xa0000000) + 0x8000 
 ; (see arch/arm/kernel/head-armv.S)
 ; We have to adjust it from the virtual start address 
 ; to the physical start address
 ; i.e.: Data.LOAD.Elf vmlinux <physical start>-<virtual start>

 ; use Turbo mode only, if target RAM is fast enough

 PRINT "loading Linux kernel..."
 SYStem.Option TURBO ON
 Data.LOAD.Elf vmlinux 0xa0008000-0xc0008000 /NosYmbol
 SYStem.Option TURBO OFF
 
 Register.RESet

 ; Set PC on start address of image
 Register.Set PC 0xa0008000
 
 ; Set machine type in R1; see arch/arm/tools/mach-types
 Register.Set R1 732.    ; PCM027

 ; Set boot parameter tags for linux boot
 DO atag-list

 
; Loading initial ram disk (initrd)

 ; Use the next lines only, if you want to use an initrd,
 ; and if you want to download this with the debugger.

 ; Load ram file system image into ram disk
 ; The load address must be passed by a boot parameter 
 ; or as command line option (see atag-list.cmm)
 
 PRINT "loading ramdisk..."
 SYStem.Option TURBO ON
 Data.LOAD.Binary ramdisk.image.gz 0xa0800000 /NoClear /NosYmbol
 SYStem.Option TURBO OFF
 

; Load the Linux kernel symbols into the debugger
 ; use /strippart and /path to map source paths, if necessary
 
 PRINT "loading Linux kernel symbols..."
 Data.LOAD.Elf vmlinux /NoCODE /StripPART 3 /PATH "&srcpath"
 

; Open a Code Window -- we like to see something

 WinPOS 0. 0. 75. 20.
 List.auto
 SCREEN.display
 
 Go start_kernel /Onchip
 WAIT !STATE.RUN()
 

; Declare the MMU format to the debugger
 ; - table format is "LINUX"
 ; - table base address is at label "swapper_pg_dir"
 ; - kernel address translation
 ; Map the virtual kernel symbols to physical addresses to give 
 ; the debugger access to it before CPU MMU is initialized

 PRINT "initializing debugger MMU..."
 MMU.FORMAT LINUX swapper_pg_dir 0xc0000000--0xc3ffffff 0xa0000000
 TRNASlation.COMMON 0xc0000000--0xffffffff            ; common area for kernel and processes
 TRNASlation.TableWalk ON   ; debugger uses a table walk to decode virtual addresses
 TRNASlation.ON             ; switch on debugger(!) address translation 
 

; Initialize Linux Awareness

 ; Note that the Linux awareness needs the kernel symbols to work
 
 ; check linux major version
 IF STRing.SCAN(Data.STRing(linux_banner), "Linux version 2.", 0)==0
 (
     &ka_path="~~/demo/arm/kernel/linux/linux-2.x"
     &awareness="linux.t32"
 )
 ELSE
 (
     &ka_path="~~/demo/arm/kernel/linux/linux-3.x"
     &awareness="linux3.t32"  
 )
 
 PRINT "initializing RTOS support..."
 TASK.CONFIG &ka_path/&awareness               ; loads Linux awareness 
 MENU.ReProgram &ka_path/linux            ; loads Linux menu 
  
 ; Group kernel area to be displayed with red bar
 GROUP.Create "kernel" 0xc0000000--0xffffffff /RED


; Ok, we're done, let's start Linux
 
 Go
 PRINT "starting Linux... (please wait)"
 WAIT 4.s
 Break
 
 PRINT "done."     ; done with loading and starting Linux
 
 
; --------------------------------------------------------------------------------
; Application Debugging 
; e.g. "hello"
; --------------------------------------------------------------------------------

 ; activate autoloader for processes:
 TASK.sYmbol.Option AutoLoad Process

 PRINT "please log in and start 'hello'"

 ; script based
   ; using the script based application debugging
   ; gives more control over the single commands
   ; see file "app_debug.cmm"
   
   ; do ../app_debug "hello"
   
 ; process watch system
   ; the process watch system automates the actions
   ; for application debugging
   
   WinPOS 55. 25. 40. 4.
   TASK.Watch.View "hello"

   Go

 ENDDO
