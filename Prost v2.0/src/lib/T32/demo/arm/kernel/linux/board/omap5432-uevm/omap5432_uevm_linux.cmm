; --------------------------------------------------------------------------------
; @Title: Linux Demo for TRACE32 OS Awareness on the OMAP5432 uEVM
; @Description: 
;   This batchfile demonstrates the use of the OS Awareness for Linux
;   The example is generated for the  OMAP5432 uEVM using an ICD.
;   It will NOT run on any other board, but may be used as a template
;   for others.
;   Linux is downloaded to the board via ICD.
;   This script initializes the target by u-boot.
; @Keywords: awareness, OMAP5*, uEVM, RTOS
; @Board: OMAP5432 uEVM
; @Chip: OMAP5432
; @Copyright: (C) 1989-2019 Lauterbach GmbH, licensed for use with TRACE32(R) only
; --------------------------------------------------------------------------------
; $Id: omap5432_uevm_linux.cmm 16121 2020-05-28 15:01:14Z mcharfi $


; Prerequisites:
;  * uSD Card with MLO and U-Boot is in the Board
;  * uSD Card Boot mode is selected (SYSBOOT=0101)
;  * connect Serial Console via uUSB USB<->Serial converter

LOCAL &ka_path &awareness

  SCREEN.ALways      ; permanent update for internal terminal window
  WinCLEAR
  RESet
  TERM.RESet
  SYStem.RESet
  
  WinPOS 0. 0. 80. 20. 0. 0. W000
  AREA.view
  
; Initializing Debugger 

  SYStem.CPU OMAP5432ES2
  SYStem.JtagClock CTCK 20MHZ
  SYStem.Option DACR ON
  SYStem.Option MMUSPACES ON
  TrOnchip.Set DABORT OFF
  TrOnchip.Set PABORT OFF
  TrOnchip.Set UNDEF OFF

;serial terminal

  WinPOS 0. 25. 80. 25. 0. 0. TERM.view
  DO ~~/demo/etc/terminal/serial/term.cmm COM1  115200.
 
  ON POWERUP GOTO PoweredUp
  PRINT "Please re-power the target ..."
  STOP

PoweredUp:
  ON POWERUP inherit

; waiting the u-boot countdown loop

  GOSUB TerminalWaitString "Hit any key"
  TERM.Out 0xa
  WAIT 0.1s
  CORE.ASSIGN 1.,2.
  SYStem.Mode.Attach
  Break.direct

; we are now at u-boot prompt

  SYStem.MemAccess DAP
  PRINT "loading Linux image..."
  Data.LOAD.Binary ~~~~/uImage 0x82000000 /NosYmbol
  PRINT "loading DTB..."  
  Data.LOAD.Binary ~~~~/omap5-uevm.dtb 0x80f80000 /NosYmbol
  PRINT "loading ram disk..."
  Data.LOAD.Binary ~~~~/ramdisk.gz 0x9f000000 /NosYmbol
  SYStem.MemAccess Denied
  Go.direct 0x80008000 /Onchip /COUNT 2.
  WAIT 0.2s
  TERM.Out "setenv bootargs console=ttyO2,115200n8 root=/dev/ram rw earlyprintk initrd=0x9f000000,8M" 0xa
  WAIT 0.2s
  TERM.Out "setenv bootargs ${bootargs}  maxcpus=2 pm_level=wfi " 0xa
  WAIT 0.2s
  TERM.Out "bootm 0x82000000 - 0x80f80000" 0xa
  WAIT 0.2s
  WAIT !STATE.RUN() 4.s

; Load the Linux kernel symbols into the debugger

  PRINT "loading Linux kernel symbols..."
  Data.LOAD.Elf ~~~~/vmlinux  /NoCODE /PlusVM /StripPART 4.

; Starting the kernel

  Go.direct start_kernel /Onchip
  WAIT !STATE.RUN()
  
  ; Map the virtual kernel symbols to physical addresses
  ; to give the debugger access to it before CPU MMU is
  ; initialized 
  PRINT "initializing debugger MMU..."
  MMU.FORMAT LINUXSWAP3 swapper_pg_dir 0xc0000000++0xef7fffff 0x80000000
  TRANSlation.COMMON 0xbf000000--0xffffffff
  TRANSlation.TableWalk ON
  TRANSlation.ON

  ; Initialize Linux Awareness
  ; Note that the Linux awareness needs the kernel symbols to work 
  IF STRing.SCAN(Data.STRing(linux_banner), "Linux version 2.", 0)==0
  (
    &ka_path="~~/demo/arm/kernel/linux/linux-2.x"
    &awareness="linux.t32"
  )
  ELSE
  (
    &ka_path="~~/demo/arm/kernel/linux/linux-3.x"
    &awareness="linux3.t32"  
  )
  PRINT "initializing RTOS support..."
  TASK.CONFIG &ka_path/&awareness      ; loads Linux awareness 
  MENU.ReProgram &ka_path/linux        ; loads Linux menu 
  ; Group kernel area to be displayed with red bar
  GROUP.Create "kernel" 0xc0000000--0xffffffff /RED

  Go.direct

  ENDDO
  
TerminalWaitString: ;(&str)
  LOCAL &str
  ENTRY %LINE &str
  &str=&str
  SCREEN.ALways
  RePeaT
  (
    WAIT 0.5s
    SCREEN.display
    WinFIND "&str" TERM.view
  )
  WHILE !FOUND() 
  RETURN

