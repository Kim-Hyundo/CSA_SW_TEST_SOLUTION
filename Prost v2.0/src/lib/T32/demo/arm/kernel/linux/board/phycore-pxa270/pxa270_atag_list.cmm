; --------------------------------------------------------------------------------
; @Title: ATAG Structure Initialization Script for the phyCORE-PXA270
; @Description: 
;   Setup parameter tags for Linux boot
;   Format:
;   u32 size  \_ header
;   u32 type  /
;   n * u32 tag
; @Keywords: phycore, pxa*, RTOS
; @Author: DIE
; @Board: phyCORE-PXA270
; @Chip: PXA270
; @Props:NoWelcome
; @Copyright: (C) 1989-2019 Lauterbach GmbH, licensed for use with TRACE32(R) only
; --------------------------------------------------------------------------------
; $Id: pxa270_atag_list.cmm 15210 2019-11-04 10:51:00Z bschroefel $


&tagAddr=0xA0000100

; ATAG_CORE
Data.Set &tagAddr %Long %LE 0x5
&tagAddr=&tagAddr+0x4
Data.Set &tagAddr  %Long %LE 0x54410001
&tagAddr=&tagAddr+0x4
Data.Set &tagAddr  %Long %LE 0x0
&tagAddr=&tagAddr+0x4
Data.Set &tagAddr  %Long %LE 0x0
&tagAddr=&tagAddr+0x4
Data.Set &tagAddr  %Long %LE 0x0
&tagAddr=&tagAddr+0x4

; ATAG_MEM
Data.Set &tagAddr %Long %LE 0x4
&tagAddr=&tagAddr+0x4
Data.Set &tagAddr %Long %LE 0x54410002
&tagAddr=&tagAddr+0x4
Data.Set &tagAddr %Long %LE 0x04000000 // size
&tagAddr=&tagAddr+0x4
Data.Set &tagAddr %Long %LE 0xa0000000 // start
&tagAddr=&tagAddr+0x4

; ATAG_CMDLINE
Data.Set &tagAddr %Long %LE 0x25
&tagAddr=&tagAddr+0x4
Data.Set &tagAddr %Long %LE 0x54410009
&tagAddr=&tagAddr+0x4
Data.Set &tagAddr "console=ttyS0,115200 initrd=0xa0800000,0x00200000 root=/dev/ram rw" 0
&tagAddr=&tagAddr+0x8c

; ATAG_VIDEOLFB
Data.Set &tagAddr %Long %LE 0x8
&tagAddr=&tagAddr+0x4
Data.Set &tagAddr %Long %LE 0x54410008
&tagAddr=&tagAddr+0x4
Data.Set &tagAddr %Long %LE 0xc00001b0
&tagAddr=&tagAddr+0x4
Data.Set &tagAddr %Long %LE 0xc00001b0
&tagAddr=&tagAddr+0x4
Data.Set &tagAddr %Long %LE 0xa202d000
&tagAddr=&tagAddr+0x4
Data.Set &tagAddr %Long %LE 0x0004c000
&tagAddr=&tagAddr+0x4
Data.Set &tagAddr %Long %LE 0xc00001c0
&tagAddr=&tagAddr+0x4
Data.Set &tagAddr %Long %LE 0xc00001c0
&tagAddr=&tagAddr+0x4

; ATAG_NONE
Data.Set &tagAddr %Long %LE 0x0
&tagAddr=&tagAddr+0x4
Data.Set &tagAddr %Long %LE 0x0
&tagAddr=&tagAddr+0x4

Register.Set r2 0xA0000100

ENDDO
