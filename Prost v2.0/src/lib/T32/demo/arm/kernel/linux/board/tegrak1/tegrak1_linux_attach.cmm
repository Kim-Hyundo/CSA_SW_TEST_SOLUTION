; --------------------------------------------------------------------------------
; @Title: Linux Demo for TRACE32 OS Awareness on the NVIDIA Jetson Pro Board
; @Description: 
;   This script is supposed to attach to a running Linux on
;   the NVIDIA Jetson Pro board. 
;   The Task Awareness + Debugger Address Translation are prepared as for the 
;   GSRD. After execution of this script the debugger is ready for Process, 
;   Kernel, optional Module and optional Library debugging.
;   It will NOT run on any other board, but may be used as a template
;   for others.
; @Board: NVIDIA Jetson Pro
; @Chip: TEGRAK1
; @Keywords: awareness, Linux, NVIDIA
; @Copyright: (C) 1989-2019 Lauterbach GmbH, licensed for use with TRACE32(R) only
; --------------------------------------------------------------------------------
; $Id: tegrak1_linux_attach.cmm 16019 2020-05-06 08:47:23Z kjmal $  


 LOCAL &ka_path &awareness

  RESet
  SYStem.CPU TEGRAK1
  SYStem.Option ResBreak OFF
  SYStem.Option WaitReset 2.s
  ETM.OFF

  SYStem.Option DACR ON ; give Debugger global write permissions
  TrOnchip.Set DABORT OFF ; used by Linux for page miss!
  TrOnchip.Set PABORT OFF ; used by Linux for page miss!
  TrOnchip.Set UNDEF OFF ; may be used by Linux for FPU detection
  SYStem.Option MMUSPACES ON ; enable space ids to virtual addresses

  SYStem.Attach
  Break.direct
  WAIT !STATE.RUN()
 
  DO ~~/demo/etc/terminal/serial/term.cmm COM1 115200.

; Load the Linux kernel symbols into the debugger

  PRINT "loading Linux kernel symbols..."
  Data.LOAD.Elf vmlinux /NoCODE /NoClear
  
; Map the virtual kernel symbols to physical addresses
  ; to give the debugger access to it before CPU MMU is
  ; initialized 

  PRINT "initializing debugger MMU..."
  MMU.FORMAT LINUX swapper_pg_dir 0xc0000000--0xdfffffff 0x80a00000
  TRANSlation.COMMON 0xbf000000--0xffffffff
  TRANSlation.TableWalk ON
  TRANSlation.ON

; Initialize Linux Awareness
  ; Note that the Linux awareness needs the kernel symbols to work 
  PRINT "initializing RTOS support..."
  ; Choose the correct Linux major version below
  ;TASK.CONFIG ~~/demo/arm/kernel/linux/linux-2.x/linux.t32     ; loads Linux awareness for linux-2.x
  ;MENU.ReProgram ~~/demo/arm/kernel/linux/linux-2.x/linux.men  ; loads Linux menu  for linux-2.x
  TASK.CONFIG ~~/demo/arm/kernel/linux/linux-3.x/linux3.t32     ; loads Linux awareness for linux-3.x
  MENU.ReProgram ~~/demo/arm/kernel/linux/linux-3.x/linux.men  ; loads Linux menu  for linux-3.x
  
; Group kernel area to be displayed with red bar
  GROUP.Create "kernel" 0xc0000000--0xffffffff /RED

  Go.direct

  Mode.Hll

  ENDDO