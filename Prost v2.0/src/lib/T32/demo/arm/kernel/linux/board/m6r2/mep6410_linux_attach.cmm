; --------------------------------------------------------------------------------
; @Title: Linux Demo for TRACE32 OS Awareness on the MEP-6410 Board
; @Description: 
;   This script is supposed to attach to a running Linux on 
;   MDS M6R2 (MEP-6410) board. 
;   The Task Awareness + Debugger Address Translation are prepared as for the 
;   GSRD. After execution of this script the debugger is ready for Process, 
;   Kernel, optional Module and optional Library debugging.
;   It will NOT run on any other board, but may be used as a template
;   for others.
; @Keywords: awareness, M6R2, MDS
; @Board: MEP-6410
; @Chip: S3C6410
; @Copyright: (C) 1989-2019 Lauterbach GmbH, licensed for use with TRACE32(R) only
; --------------------------------------------------------------------------------
; $Id: mep6410_linux_attach.cmm 16125 2020-05-29 14:29:16Z mcharfi $


; Starting Linux example with TRACE32:
; - Connect NULL modem cable to UART0
;   - 115200 baud, 8/N/1, no(!) handshake
; - Start TRACE32
; - Switch on the board
; - TRACE32: Start this script

LOCAL &ka_path &awareness

  SCREEN.ALways      ; permanent update for internal terminal window
  ; screen.on        ; if you use external terminal


; Debugger Reset

  WinPAGE.RESet
  AREA.RESet
  WinPOS 0. 25. 75. 8. 0. 0. W000
  AREA.view
 
  PRINT "resetting..."
 
  RESet


; Initializing Debugger
 
  PRINT "initializing..."
  SYStem.CPU ARM1176JZF
  ; deprecated   SYStem.MultiCore IRPRE     4
  ; deprecated   SYStem.MultiCore DRPRE     1
  ; deprecated   SYStem.MultiCore ETBIRPOST 5
  ; deprecated   SYStem.MultiCore ETBDRPOST 1
  SYStem.CONFIG.IRPRE     4
  SYStem.CONFIG.DRPRE     1
  SYStem.CONFIG.ETBIRPOST 5
  SYStem.CONFIG.ETBDRPOST 1
  SYStem.JtagClock RTCK
  SYStem.Option ResBreak OFF     ; hardware dependent (see manual)
  SYStem.Option PWRDWN ON        ; hardware dependent (see manual)
  SYStem.Option DACR ON          ; give Debugger global write permissions
  TrOnchip.Set DABORT OFF        ; used by Linux for page miss!
  TrOnchip.Set PABORT OFF        ; used by Linux for page miss!
  TrOnchip.Set UNDEF OFF         ; my be used by Linux for FPU detection
  SYStem.Option MMUSPACES ON     ; enable space ids to virtual addresses
  SETUP.IMASKASM ON          ; lock interrupts while single stepping

  SYStem.Attach
  Break.direct
  WAIT !STATE.RUN()


; Open serial terminal window on COM1
 
  DO ~~/demo/etc/terminal/serial/term.cmm COM1 115200.
 

; Load the Linux kernel symbols into the debugger
 ; use /strippart and /path to map source paths, if necessary
 
  PRINT "loading Linux kernel symbols..."
  Data.LOAD.Elf vmlinux /NoCODE /StripPART "/mnt/develop" /PATH "S:\"


; Open a Code Window -- we like to see something

 WinPOS 0. 0. 75. 20.
 List.auto
 
 Go.direct start_kernel
 WAIT !STATE.RUN()


; Declare the MMU format to the debugger
 ; - table format is "LINUX"
 ; - table base address is at label "swapper_pg_dir"
 ; - kernel address translation
 ; Map the virtual kernel symbols to physical addresses to give 
 ; the debugger access to it before CPU MMU is initialized

  PRINT "initializing debugger MMU..."
  MMU.FORMAT LINUX swapper_pg_dir 0xc0000000--0xc7ffffff 0x50000000

; prepare debugger translation
  TRANSlation.COMMON 0xc0000000--0xffffffff              ; common area for kernel and processes
  TRANSlation.TableWalk ON       ; debugger uses a table walk to decode virtual addresses
  TRANSlation.ON                 ; switch on debugger(!) address translation 

; Initialize Linux Awareness
  ; Note that the Linux awareness needs the kernel symbols to work 
  PRINT "initializing RTOS support..."
  ; Choose the correct Linux major version below
  ;TASK.CONFIG ~~/demo/arm/kernel/linux/linux-2.x/linux.t32     ; loads Linux awareness for linux-2.x
  ;MENU.ReProgram ~~/demo/arm/kernel/linux/linux-2.x/linux.men  ; loads Linux menu  for linux-2.x
  TASK.CONFIG ~~/demo/arm/kernel/linux/linux-3.x/linux3.t32     ; loads Linux awareness for linux-3.x
  MENU.ReProgram ~~/demo/arm/kernel/linux/linux-3.x/linux.men  ; loads Linux menu  for linux-3.x
  
; Group kernel area to be displayed with red bar
  GROUP.Create "kernel" 0xc0000000--0xffffffff /RED

  Go.direct

  Mode.Hll

  ENDDO