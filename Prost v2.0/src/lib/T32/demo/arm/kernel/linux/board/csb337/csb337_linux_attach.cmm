; --------------------------------------------------------------------------------
; @Title: Linux Demo for TRACE32 OS Awareness on the CSB337 Board
; @Description:  
;   This script is supposed to attach to a running Linux on the Cogent CSB337 board. 
;   The Task Awareness + Debugger Address Translation are prepared as for the 
;   GSRD. After execution of this script the debugger is ready for Process, 
;   Kernel, optional Module and optional Library debugging.
;   It will NOT run on any other board, but may be used as a template
;   for others. 
; @Keywords: awareness, Cogent, RTOS
; @Author: ABO
; @Board: CSB337
; @Chip: AT91RM9200
; @Copyright: (C) 1989-2019 Lauterbach GmbH, licensed for use with TRACE32(R) only
; --------------------------------------------------------------------------------
; $Id: csb337_linux_attach.cmm 15210 2019-11-04 10:51:00Z bschroefel $


LOCAL &ka_path &awareness

  SCREEN.ALways      ; permanent update for internal terminal window
  ; screen.on        ; if you use external terminal


; Debugger Reset

  WinPAGE.RESet
  AREA.RESet
  WinPOS 0. 24. 75. 8. 0. 0. W000
  AREA.view
 
  PRINT "resetting..."

  RESet


; Initializing Debugger
 
  PRINT "initializing..."
  SYStem.CPU AT91RM9200          ; AT91RM9200 core
  SYStem.JtagClock 5MHz
  SYStem.Option DACR ON          ; give Debugger global write permissions
  SYStem.Option BigEndian OFF    ; this demo is in little endian
  TrOnchip.Set DABORT OFF        ; used by Linux for page miss!
  TrOnchip.Set PABORT OFF        ; used by Linux for page miss!
  TrOnchip.Set UNDEF OFF         ; my be used by Linux for FPU detection
  SYStem.Option MMUSPACES ON     ; enable space ids to virtual addresses

  SYStem.Attach
  Break.direct
  WAIT !STATE.RUN()

  SETUP.IMASKASM ON          ; lock interrupts while single stepping
 

; Open serial terminal window on COM1
 
  DO ~~/demo/etc/terminal/serial/term.cmm COM1 38400.
 
; Load the Linux kernel symbols into the debugger
 ; use /strippart and /path to map source paths, if necessary

 PRINT "loading Linux kernel symbols..."
 Data.LOAD.Elf vmlinux /NoCODE /StripPART 3 /PATH "S:\"

; Open a Code Window -- we like to see something

  WinPOS 0. 0. 75. 20.
  List.auto
 
; Declare the MMU format to the debugger
 ; - table format is "LINUX"
 ; - table base address is at label "swapper_pg_dir"
 ; - kernel address translation
 ; Map the virtual kernel symbols to physical addresses to give 
 ; the debugger access to it before CPU MMU is initialized

  PRINT "initializing debugger MMU..."
  MMU.FORMAT LINUX swapper_pg_dir 0xc0000000--0xc1ffffff 0x20000000
  TRANSlation.COMMON 0xbf000000--0xffffffff            ; common area for kernel and processes
  TRANSlation.TableWalk ON   ; debugger uses a table walk to decode virtual addresses
  TRANSlation.ON             ; switch on debugger(!) address translation 
 
; Initialize Linux Awareness

 ; Note that the Linux awareness needs the kernel symbols to work
 
  PRINT "initializing RTOS support..."
  ; Choose the correct Linux major version below
  ;TASK.CONFIG ~~/demo/arm/kernel/linux/linux-2.x/linux.t32     ; loads Linux awareness for linux-2.x
  ;MENU.ReProgram ~~/demo/arm/kernel/linux/linux-2.x/linux.men  ; loads Linux menu  for linux-2.x
  TASK.CONFIG ~~/demo/arm/kernel/linux/linux-3.x/linux3.t32     ; loads Linux awareness for linux-3.x
  MENU.ReProgram ~~/demo/arm/kernel/linux/linux-3.x/linux.men  ; loads Linux menu  for linux-3.x

; Group kernel area to be displayed with red bar
  GROUP.Create "kernel" 0xc0000000--0xffffffff /RED

  Go.direct
 
  ENDDO
 
