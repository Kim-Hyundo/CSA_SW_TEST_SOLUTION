; --------------------------------------------------------------------------------
; @Title: ATAG Structure Initialization Script for the i.MX27ADS Board
; @Description: 
;   Setup parameter tags for Linux boot
;   Format:
;   u32 size  \_ header
;   u32 type  /
;   n * u32 tag
; @Keywords: freescale, imx27*, Linux, RTOS
; @Author: KJM
; @Props:NoWelcome
; @Board: i.MX27ADS
; @Chip: IMX27
; @Copyright: (C) 1989-2019 Lauterbach GmbH, licensed for use with TRACE32(R) only
; --------------------------------------------------------------------------------
; $Id: imx27ads_atag_list.cmm 15210 2019-11-04 10:51:00Z bschroefel $


&tagAddr=0xA0000100

; ATAG_CORE
Data.Set &tagAddr %Long %LE 0x5
&tagAddr=&tagAddr+0x4
Data.Set &tagAddr %Long %LE 0x54410001
&tagAddr=&tagAddr+0x4
Data.Set &tagAddr %Long %LE 0x1
&tagAddr=&tagAddr+0x4
Data.Set &tagAddr %Long %LE 0x1000
&tagAddr=&tagAddr+0x4
Data.Set &tagAddr %Long %LE 0x0
&tagAddr=&tagAddr+0x4

; ATAG_MEM
Data.Set &tagAddr %Long %LE 0x4
&tagAddr=&tagAddr+0x4
Data.Set &tagAddr %Long %LE 0x54410002
&tagAddr=&tagAddr+0x4
Data.Set &tagAddr %Long %LE 0x04000000  // size 64MB
&tagAddr=&tagAddr+0x4
Data.Set &tagAddr %Long %LE 0xA0000000  // start
&tagAddr=&tagAddr+0x4


; ATAG_CMDLINE
Data.Set &tagAddr %Long %LE 0x31
&tagAddr=&tagAddr+0x4
Data.Set &tagAddr %Long %LE 0x54410009
&tagAddr=&tagAddr+0x4
Data.Set &tagAddr "jtag=on noinitrd console=ttymxc0,115200 rootfstype=ubifs root=ubi0:rootfs ubi.mtd=6"
&tagAddr=&tagAddr+0xBC

; ATAG_NONE
Data.Set &tagAddr %Long %LE 0x0
&tagAddr=&tagAddr+0x4
Data.Set &tagAddr %Long %LE 0x0
&tagAddr=&tagAddr+0x4

Register.Set R2 &tagAddr

ENDDO


