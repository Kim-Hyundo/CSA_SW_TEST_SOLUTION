; --------------------------------------------------------------------------------
; @Title: ATAG Structure Initialization Script for the SabreLite i.MX6 Board
; @Description: 
;   Setup parameter tags for Linux boot
;   Format:
;   u32 size  \_ header
;   u32 type  /
;   n * u32 tag
; @Keywords: Freescale, imx6*, RTOS
; @Author: KJM
; @Board: SabreLite
; @Props:NoWelcome
; @Chip: IMX6*
; @Copyright: (C) 1989-2019 Lauterbach GmbH, licensed for use with TRACE32(R) only
; --------------------------------------------------------------------------------
; $Id: imx6_atag_list.cmm 15210 2019-11-04 10:51:00Z bschroefel $


&tag=0x10000100
&tagAddr=&tag


; ATAG_CORE
Data.Set &tagAddr %Long %LE 0x5
&tagAddr=&tagAddr+0x4
Data.Set &tagAddr %Long %LE 0x54410001
&tagAddr=&tagAddr+0x4
Data.Set &tagAddr %Long %LE 0x0
&tagAddr=&tagAddr+0x4
Data.Set &tagAddr %Long %LE 0x0
&tagAddr=&tagAddr+0x4
Data.Set &tagAddr %Long %LE 0x0
&tagAddr=&tagAddr+0x4

; ATAG_Revision
Data.Set &tagAddr %Long %LE 0x3
&tagAddr=&tagAddr+0x4
Data.Set &tagAddr %Long %LE  0x54410007
&tagAddr=&tagAddr+0x4
Data.Set &tagAddr %Long %LE 0x00063000
&tagAddr=&tagAddr+0x4

; ATAG_MEM
Data.Set &tagAddr %Long %LE 0x4
&tagAddr=&tagAddr+0x4
Data.Set &tagAddr %Long %LE 0x54410002
&tagAddr=&tagAddr+0x4
Data.Set &tagAddr %Long %LE 0x40000000
&tagAddr=&tagAddr+0x4
Data.Set &tagAddr %Long %LE 0x10000000 
&tagAddr=&tagAddr+0x4

; ATAG_CMDLINE
&cmdline="root=/dev/ram rw console=ttymxc1,115200 initrd=0x11600000,4M jtag=on enable_wait_mode=off"
&cmdsize=(STRing.LENgth("&cmdline")+16)&~0x3
Data.Set &tagAddr %Long %LE &cmdsize/4
&tagAddr=&tagAddr+0x4
Data.Set &tagAddr %Long %LE 0x54410009
&tagAddr=&tagAddr+0x4
Data.Set &tagAddr "&cmdline" 0
&tagAddr=&tagAddr+(&cmdsize-8)

; ATAG_NONE
Data.Set &tagAddr %Long %LE 0x0
&tagAddr=&tagAddr+0x4
Data.Set &tagAddr %Long %LE 0x0
&tagAddr=&tagAddr+0x4

Register.Set R2 &tag

ENDDO











