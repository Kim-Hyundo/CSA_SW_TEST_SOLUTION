; --------------------------------------------------------------------------------
; @Title: Linux Demo for TRACE32 OS Awareness on the i.MX31ADS Board
; @Description: 
;   This script is supposed to attach to a running Linux on i.MX31ADS board. 
;   The Task Awareness + Debugger Address Translation are prepared as for the 
;   GSRD. After execution of this script the debugger is ready for Process, 
;   Kernel, optional Module and optional Library debugging.
;   It will NOT run on any other board, but may be used as a template
;   for others.
; @Keywords: awareness, Freescale, imx3*, Linux, RTOS
; @Board: i.MX31ADS
; @Chip: IMX31
; @Copyright: (C) 1989-2019 Lauterbach GmbH, licensed for use with TRACE32(R) only
; --------------------------------------------------------------------------------
; $Id: imx31ads_linux_attach.cmm 16133 2020-06-01 11:09:18Z mcharfi $


; PLEASE NOTE: Add "jtag=on" to the command line parameters, to prevent
;              Linux from goint into wait mode (which spoils JTAG).

; Starting Linux example with TRACE32 and terminal:
; - Connect STRAIGHT modem cable to UARTC (upper connector next to Ethernet)
; - Start TRACE32
; - Open console terminal: 115200 baud, 8/N/1, no(!) handshake
; - Switch on the board
; - (T32) Start this script

LOCAL &srcdrive
LOCAL &srcpath
&srcdrive="S:"
&srcpath="&srcdrive"+"\"
LOCAL &ka_path &awareness


  SCREEN.ON


; Debugger Reset

  WinPAGE.RESet
  AREA.RESet
  WinPOS 0. 26. 75. 8. 0. 0. W000
  AREA.view
  
  PRINT "resetting..."
 
  RESet


; Initializing Debugger
 
  PRINT "initializing..."
  SYStem.CPU MCIMX31             ; set your CPU here
  SYStem.Option DACR ON          ; give Debugger global write permissions
  SYStem.Option ResBreak OFF     ; board specific, see documentation
  SYStem.JtagClock RTCK          ; board specific, see documentation
  TrOnchip.Set DABORT OFF        ; used by Linux for page miss!
  TrOnchip.Set PABORT OFF        ; used by Linux for page miss!
  TrOnchip.Set UNDEF OFF         ; my be used by Linux for FPU detection
  SYStem.Option MMUSPACES ON     ; enable space ids to virtual addresses
  SETUP.IMASKASM ON              ; lock interrupts while single stepping
 
  SYStem.Attach
  Break.direct
  WAIT !STATE.RUN()

; Load the Linux kernel symbols into the debugger
 ; use /strippart and /path to map source paths, if necessary
 
  PRINT "loading Linux kernel symbols..."
  Data.LOAD.Elf vmlinux /NoCODE /StripPART 3 /PATH "&srcpath"

; Open a Code Window -- we like to see something

  WinPOS 0. 0. 75. 20.
  List.auto
  SCREEN.display
 
; Declare the MMU format to the debugger
 ; - table format is "LINUX"
 ; - table base address is at label "swapper_pg_dir"
 ; - kernel address translation
 ; Map the virtual kernel symbols to physical addresses to give 
 ; the debugger access to it before CPU MMU is initialized

  PRINT "initializing debugger MMU..."
  MMU.FORMAT LINUX swapper_pg_dir 0xc0000000--0xc7ffffff 0x80000000
  TRNASlation.COMMON 0xbf000000--0xffffffff            ; common area for kernel and processes
  TRNASlation.TableWalk ON   ; debugger uses a table walk to decode virtual addresses
  TRNASlation.ON             ; switch on debugger(!) address translation 
  

; Initialize Linux Awareness
  ; Note that the Linux awareness needs the kernel symbols to work 
  PRINT "initializing RTOS support..."
  ; Choose the correct Linux major version below
  ;TASK.CONFIG ~~/demo/arm/kernel/linux/linux-2.x/linux.t32     ; loads Linux awareness for linux-2.x
  ;MENU.ReProgram ~~/demo/arm/kernel/linux/linux-2.x/linux.men  ; loads Linux menu  for linux-2.x
  TASK.CONFIG ~~/demo/arm/kernel/linux/linux-3.x/linux3.t32     ; loads Linux awareness for linux-3.x
  MENU.ReProgram ~~/demo/arm/kernel/linux/linux-3.x/linux.men  ; loads Linux menu  for linux-3.x
  
; Group kernel area to be displayed with red bar
  GROUP.Create "kernel" 0xc0000000--0xffffffff /RED

  Go.direct

  Mode.Hll

  ENDDO