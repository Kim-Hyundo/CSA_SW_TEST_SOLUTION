; --------------------------------------------------------------------------------
; @Title: ATAG Structure Initialization Script for the phyCORE-i.MX350
; @Description: 
;   Setup parameter tags for Linux boot
;   Format:
;   u32 size  \_ header
;   u32 type  /
;   n * u32 tag
; @Keywords: imx3*, Linux, phycore, RTOS
; @Author: DIE
; @Board: phyCORE-i.MX350
; @Chip: IMX35
; @Props:NoWelcome
; @Copyright: (C) 1989-2019 Lauterbach GmbH, licensed for use with TRACE32(R) only
; --------------------------------------------------------------------------------
; $Id: imx35_atag_list.cmm 15210 2019-11-04 10:51:00Z bschroefel $


&tag=0x80000100

&tagAddr=&tag

; ATAG_CORE
Data.Set &tagAddr %Long %LE 0x2
&tagAddr=&tagAddr+0x4
Data.Set &tagAddr  %Long %LE 0x54410001
&tagAddr=&tagAddr+0x4

; ATAG_MEM
Data.Set &tagAddr %Long %LE 0x4
&tagAddr=&tagAddr+0x4
Data.Set &tagAddr %Long %LE 0x54410002
&tagAddr=&tagAddr+0x4
Data.Set &tagAddr %Long %LE 0x08000000  // size 128MB
&tagAddr=&tagAddr+0x4
Data.Set &tagAddr %Long %LE 0x80000000  // start
&tagAddr=&tagAddr+0x4

; ATAG_CMDLINE
;&cmdline="console=ttymxc0,115200 initrd=0x80800000,4M root=/dev/ram rw"
&cmdline="console=ttymxc0,115200 video=mx3fb:TX090 ip=10.17.0.42:10.17.0.254::255.255.255.0::: root=/dev/mtdblock3 rootfstype=jffs2 mtdparts=physmap-flash.0:256k(uboot)ro,128k(ubootenv),2048k(kernel),-(root);mxc_nand:"
&cmdsize=(STRing.LENgth("&cmdline")+16)&~0x3
Data.Set &tagAddr %Long %LE &cmdsize/4
&tagAddr=&tagAddr+0x4
Data.Set &tagAddr %Long %LE 0x54410009
&tagAddr=&tagAddr+0x4
Data.Set &tagAddr "&cmdline" 0
&tagAddr=&tagAddr+(&cmdsize-8)

; ATAG_NONE
Data.Set &tagAddr %Long %LE 0x0
&tagAddr=&tagAddr+0x4
Data.Set &tagAddr %Long %LE 0x0
&tagAddr=&tagAddr+0x4

Register.Set r2 &tag

ENDDO


