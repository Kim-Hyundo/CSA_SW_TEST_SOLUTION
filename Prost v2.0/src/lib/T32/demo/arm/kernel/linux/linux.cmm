; --------------------------------------------------------------------------------
; @Title: Linux Template Script for TRACE32 OS Awareness
; @Description: 
;   This batchfile serves as a generic example startup script.
;   In this example, we assume an ARM920T board with 32MB RAM at 0x20000000
; @Keywords: awareness, RTOS
; @Props: Template
; @Author: DIE
; @Copyright: (C) 1989-2019 Lauterbach GmbH, licensed for use with TRACE32(R) only
; --------------------------------------------------------------------------------
; $Id: linux.cmm 15223 2019-11-05 16:29:45Z bschroefel $


 LOCAL &srcdrive
 LOCAL &srcpath
 &srcdrive="S:"
 &srcpath="&srcdrive"+"\samba\linux"
 
 LOCAL &ka_path &awareness


 SCREEN.ON


; Debugger Reset

 WinPAGE.RESet
 AREA.RESet
 WinPOS 0. 26. 75. 8. 0. 0. W000
 AREA.view
 
 PRINT "resetting..."
 
 RESet


; Initializing Debugger
 
 PRINT "initializing..."
 SYStem.CPU *                    ; set your CPU here
 SYStem.Option DACR ON          ; give Debugger global write permissions
 ; add hardware specific options here
 TrOnchip.Set DABORT OFF        ; used by Linux for page miss!
 TrOnchip.Set PABORT OFF        ; used by Linux for page miss!
 TrOnchip.Set UNDEF OFF         ; may be used by Linux for FPU detection
 SYStem.Option MMUSPACES ON     ; enable space ids to virtual addresses

 SYStem.Up

 SETUP.IMASKASM ON              ; lock interrupts while single stepping
 

; Target Setup: initialize board memory access and peripherals
 PRINT "target setup..."

 ; Either let the boot monitor setup the board
    ; Go
    ; wait 1.s
    ; Break
 ; or use the debugger to initialize it
    DO myboard-setup


; Load the Linux kernel

 ; If you are using a flashed kernel, or if you're loading 
 ; your kernel via TFTP, use the boot monitor to do so.
 
 ; Use the next lines (loading the kernel, setting registers
 ; and boot parameters) only to load the kernel into
 ; RAM using the debugger.

 ; vmlinux starts physically at RAM start + 0x8000 
 ; We have to adjust it from the virtual start address 
 ; to the physical start address
 ; i.e.: Data.LOAD.Elf vmlinux <physical start>-<virtual start>

 PRINT "loading Linux kernel..."
 Data.LOAD.Elf vmlinux 0x20008000-0xc0008000 /NosYmbol

 Register.RESet

 ; Set PC on start address of image
 Register.Set PC 0x20008000
 
 ; Set machine type in R1; see arch/arm/tools/mach-types
 Register.Set R1 0xfb
 
 ; Set boot parameter tags for linux boot (ATAG list)
 DO atag-list
 ; Or load a device tree blocb
 ; Data.LOAD.BINary myboard.dtb <load_address>


; Loading initial ram disk (initrd)

 ; Use the next lines only, if you want to use an initrd,
 ; and if you want to download this with the debugger.

 ; Load ram file system image into ram disk
 ; The load address is either hardcoded in arch/arm/<board>/arch.c,
 ; or must be passed by a boot parameter, or as command line option
 
 PRINT "loading ramdisk..."
 Data.LOAD.Binary ramdisk.img.gz 0x22000000 /NoClear /NosYmbol
 

; Load the Linux kernel symbols into the debugger
 ; use /strippart and /path to map source paths, if necessary
 
 PRINT "loading Linux kernel symbols..."
 Data.LOAD.Elf vmlinux /NoCODE /StripPART "/home/linux/" /PATH "&srcpath"


; Open a Code Window -- we like to see something

 WinPOS 0. 0. 75. 20.
 List.auto
 SCREEN.display
 
 
 Go start_kernel /Onchip
 WAIT !STATE.RUN()

; Declare the MMU format to the debugger
 ; - table format is "LINUX"
 ; - table base address is at label "swapper_pg_dir"
 ; - kernel address translation
 ; Map the virtual kernel symbols to physical addresses to give 
 ; the debugger access to it before CPU MMU is initialized
 ; Here, we assume 32MB RAM at physical address 0x20000000

 PRINT "initializing debugger MMU..."
 MMU.FORMAT LINUX swapper_pg_dir 0xc0000000--0xc1ffffff 0x20000000
 
 ; prepare debugger translation
 TRANSlation.COMMON 0xbf000000--0xffffffff              ; common area for kernel and processes
 TRANSlation.TableWalk ON       ; debugger uses a table walk to decode virtual addresses
 TRANSlation.ON                 ; switch on debugger(!) address translation 
 

; Initialize Linux Awareness

 ; Note that the Linux awareness needs the kernel symbols to work
 
 ; check linux major version
 IF STRing.SCAN(Data.STRing(linux_banner), "Linux version 2.", 0)==0
 (
     &ka_path="~~/demo/arm/kernel/linux/linux-2.x"
     &awareness="linux2.t32"
 )
 ELSE
 (
     &ka_path="~~/demo/arm/kernel/linux/awareness.x"
     &awareness="linux.t32"  
 )
 
 PRINT "initializing RTOS support..."
 TASK.CONFIG &ka_path/&awareness               ; loads Linux awareness 
 MENU.ReProgram &ka_path/linux            ; loads Linux menu 
  
 ; Group kernel area to be displayed with red bar
 GROUP.Create "kernel" 0xc0000000--0xffffffff /RED


; Ok, we're done, let's start Linux
 
 Go
 PRINT "starting Linux... (please wait)"
 WAIT 8.s
 Break
 
 PRINT "done."     ; done with loading and starting Linux

 
; --------------------------------------------------------------------------------
; Application Debugging 
; e.g. "hello"
; --------------------------------------------------------------------------------

 ; activate autoloader for processes:
 TASK.sYmbol.Option AutoLoad Process

 PRINT "please log in and start 'hello'"

 ; script based
   ; using the script based application debugging
   ; gives more control over the single commands
   ; see file "app_debug.cmm"
   
   ; do app_debug hello
   
 ; process watch system
   ; the process watch system automates the actions
   ; for application debugging
   
   WinPOS 55. 25. 40. 4.
   TASK.Watch.View "hello"

   Go

 ENDDO
 
