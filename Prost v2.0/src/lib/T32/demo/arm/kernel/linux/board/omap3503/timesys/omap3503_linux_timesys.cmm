; --------------------------------------------------------------------------------
; @Title: Timesys Linux Demo for TRACE32 on the OMAP3530EVM Board
; @Description:
;
;   This batchfile demonstrates the use of TRACE32 with Timesys Linux
;   The example is generated for an OMAP3530EVM board using an ICD.
;   It will NOT run on any other board, but may be used as a template
;   for others.
;
;   The Linux kernel will be downloaded via ICD.
;
; @Keywords: awareness, omap3503, timesys
; @Author: DIE
; @Board: OMAP3530EVM
; @Chip: OMAP3530
; @Copyright: (C) 1989-2019 Lauterbach GmbH, licensed for use with TRACE32(R) only
; --------------------------------------------------------------------------------
; $Id: omap3503_linux_timesys.cmm 15210 2019-11-04 10:51:00Z bschroefel $


; Starting Timesys Linux example with TRACE32:
; - Connect NULL modem cable to UART-1
; - Start TRACE32
; - Power on the board
; - TRACE32: do linux
; - Terminal: open a Shell and start "/usr/sbin/hello"


; Directory and path declarations
 &linux="linux-2.6.31"
 &build="build_armv7l-timesys-linux-gnueabi"
 &factory_path="S:\linux\Distributions\TimeSys\OMAP3530EVM\factory"
 &images_path="&factory_path/&build/images"
 &linux_path="&factory_path/&build/&linux"


 SCREEN.ALways      ; permanent update for internal terminal window
 ; screen.on        ; if you use external terminal


; Debugger Reset

 WinPAGE.RESet
 AREA.RESet
 WinPOS 0. 21. 70. 9. 0. 0. W000
 AREA.view

 PRINT "resetting..."

 RESet


; Initializing Debugger

 PRINT "initializing..."
 SYStem.CPU OMAP3530
 SYStem.Option DACR ON          ; give Debugger global write permissions
 TrOnchip.Set DABORT OFF        ; used by Linux for page miss!
 TrOnchip.Set PABORT OFF        ; used by Linux for page miss!
 TrOnchip.Set UNDEF OFF         ; my be used by Linux for FPU detection
 SYStem.Option MMUSPACES ON     ; enable space ids to virtual addresses

 SYStem.Up

 SETUP.IMASKASM ON             ; lock interrupts while single stepping


; Open a Code Window -- we like to see something

 WinPOS 0. 0. 75. 20.
 List.auto
 SCREEN.display


; Open serial terminal window on COM1

 DO ~~/demo/etc/terminal/serial/term.cmm COM1 115200.


; Target Setup

 PRINT "target setup..."

 ; start u-boot to initialize the board
 Go
 WAIT 5.s
 Break


; Load the Linux kernel image

 ; Use the next lines only to load the Linux image into
 ; RAM using the debugger.

 PRINT "loading Linux kernel image..."
 Data.LOAD.Binary &images_path/uImage-2.6.31-ts-armv7l 0x80000000


; Load the Linux kernel symbols into the debugger

 PRINT "loading Linux kernel symbols..."
 Data.LOAD.Elf &linux_path/vmlinux /NoCODE /StripPART "&linux"
 sYmbol.SourcePATH.Set &linux_path


; Start Linux via U-Boot

 Go
 PRINT "starting Linux..."
 ; stop autoboot of U-Boot
 TERM.Out 0x0a
 WAIT 0.5s
 ; set boot arguments
 TERM.Out "setenv bootargs console=ttyS0,115200 root=/dev/nfs rw nfsroot=10.17.0.13:/disk2/nfsroot/omap3530evm_root ip=10.17.0.42::10.17.0.254:255.255.255.0::eth0:off" 0xa
 WAIT 0.5s
 ; boot Linux from memory: bootm <kernel>
 TERM.Out "bootm 0x80000000" 0x0a


; Declare the MMU format to the debugger
 ; - table format is "LINUX"
 ; - table base address is at label "swapper_pg_dir"
 ; - kernel address translation
 ; Map the virtual kernel symbols to physical addresses to give
 ; the debugger access to it before CPU MMU is initialized

 PRINT "initializing debugger MMU..."
 MMU.FORMAT LINUX swapper_pg_dir 0xc0000000--0xc7ffffff 0x80000000
 TRANSlation.COMMON 0xbf000000--0xffffffff              ; common area for kernel and processes
 TRANSlation.TableWalk ON   ; debugger uses a table walk to decode virtual addresses
 TRANSlation.ON             ; switch on debugger(!) address translation


; Initialize Linux Support

 ; Note that the Linux awareness needs the kernel symbols to work

 ; Choose the correct Linux major version below
 TASK.CONFIG ~~/demo/arm/kernel/linux/linux-2.x/linux.t32     ; loads Linux awareness for linux-2.x
 MENU.ReProgram ~~/demo/arm/kernel/linux/linux-2.x/linux.men  ; loads Linux menu  for linux-2.x
 ;TASK.CONFIG ~~/demo/arm/kernel/linux/linux-3.x/linux3.t32     ; loads Linux awareness for linux-3.x
 ;MENU.ReProgram ~~/demo/arm/kernel/linux/linux-3.x/linux.men  ; loads Linux menu  for linux-3.x

 ; Group kernel area to be displayed with red bar
 GROUP.Create "kernel" 0xc0000000--0xffffffff /RED


; Ok, we're done, let's continue

 PRINT "still starting Linux... (please wait)"
 WAIT 5.s

 PRINT "done."     ; done with loading and starting NetBSD


; --------------------------------------------------------------------------------
; Application Debugging
; e.g. "hello"
; --------------------------------------------------------------------------------

   ;LOCAL &extdir
   ;&extdir=TASK.GETDIR()
   ;DO &extdir/app_debug hello

 ENDDO

