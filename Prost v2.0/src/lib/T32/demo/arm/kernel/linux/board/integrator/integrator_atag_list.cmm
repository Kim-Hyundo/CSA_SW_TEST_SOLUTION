; --------------------------------------------------------------------------------
; @Title: ATAG Structure Initialization Script for the ARM Integrator Board
; @Description: 
;   Setup parameter tags for Linux boot
;   Format:
;   u32 size  \_ header
;   u32 type  /
;   n * u32 tag
; @Author: DIE
; @Board: integrator
; @Props:NoWelcome
; @Chip: ARM920T
; @Copyright: (C) 1989-2019 Lauterbach GmbH, licensed for use with TRACE32(R) only
; --------------------------------------------------------------------------------
; $Id: integrator_atag_list.cmm 15210 2019-11-04 10:51:00Z bschroefel $


&tagAddr=0x00000100

; ATAG_CORE
Data.Set &tagAddr %Long %LE 0x2
&tagAddr=&tagAddr+0x4
Data.Set &tagAddr  %Long %LE 0x54410001
&tagAddr=&tagAddr+0x4

; ATAG_MEM
Data.Set &tagAddr %Long %LE 0x4
&tagAddr=&tagAddr+0x4
Data.Set &tagAddr %Long %LE 0x54410002
&tagAddr=&tagAddr+0x4
Data.Set &tagAddr %Long %LE 0x02000000 // size 32MB
&tagAddr=&tagAddr+0x4
Data.Set &tagAddr %Long %LE 0x00000000 // start
&tagAddr=&tagAddr+0x4

; ATAG_INITRD2
Data.Set &tagAddr %Long %LE 0x4
&tagAddr=&tagAddr+0x4
Data.Set &tagAddr %Long %LE 0x54420005
&tagAddr=&tagAddr+0x4
Data.Set &tagAddr %Long %LE 0x00800000 // start
&tagAddr=&tagAddr+0x4
Data.Set &tagAddr %Long %LE 0x00200000 // file size in bytes 2MB
&tagAddr=&tagAddr+0x4

; ATAG_CMDLINE
Data.Set &tagAddr %Long %LE 0x10
&tagAddr=&tagAddr+0x4
Data.Set &tagAddr %Long %LE 0x54410009
&tagAddr=&tagAddr+0x4
;data.set &tagAddr "root=/dev/ram rootfstype=romfs" 0
Data.Set &tagAddr "root=/dev/ram" 0
&tagAddr=&tagAddr+0x38

; ATAG_NONE
Data.Set &tagAddr %Long %LE 0x0
&tagAddr=&tagAddr+0x4
Data.Set &tagAddr %Long %LE 0x0
&tagAddr=&tagAddr+0x4

ENDDO


