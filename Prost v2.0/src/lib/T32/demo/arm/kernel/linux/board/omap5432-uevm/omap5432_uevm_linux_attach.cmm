; --------------------------------------------------------------------------------
; @Title: Linux Demo for TRACE32 OS Awareness on the OMAP5432 uEVM
; @Description: 
;   This script is supposed to attach to a running Linux on OMAP5432 uEVM board. 
;   The Task Awareness + Debugger Address Translation are prepared as for the 
;   GSRD. After execution of this script the debugger is ready for Process, 
;   Kernel, optional Module and optional Library debugging.
;   It will NOT run on any other board, but may be used as a template
;   for others.
; @Keywords: awareness, OMAP5*, uEVM, RTOS
; @Board: OMAP5432 uEVM
; @Chip: OMAP5432
; @Copyright: (C) 1989-2019 Lauterbach GmbH, licensed for use with TRACE32(R) only
; --------------------------------------------------------------------------------
; $Id: omap5432_uevm_linux_attach.cmm 16121 2020-05-28 15:01:14Z mcharfi $


; Prerequisites:
;  * connect Serial Console via uUSB USB<->Serial converter

LOCAL &ka_path &awareness

  SCREEN.ALways      ; permanent update for internal terminal window
  WinCLEAR
  RESet
  TERM.RESet
  SYStem.RESet
  
  WinPOS 0. 0. 80. 20. 0. 0. W000
  AREA.view
  
; Initializing Debugger 

  SYStem.CPU OMAP5432ES2
  SYStem.JtagClock CTCK 20MHZ
  SYStem.Option DACR ON
  SYStem.Option MMUSPACES ON
  TrOnchip.Set DABORT OFF
  TrOnchip.Set PABORT OFF
  TrOnchip.Set UNDEF OFF

  CORE.ASSIGN 1.,2.
  SYStem.Mode.Attach ; all cores should already be started by the kernel at this time
  Break.direct
  WAIT !STATE.RUN()

;serial terminal

  WinPOS 0. 25. 80. 25. 0. 0. TERM.view
  DO ~~/demo/etc/terminal/serial/term.cmm COM1  115200.
 
; Load the Linux kernel symbols into the debugger

  PRINT "loading Linux kernel symbols..."
  Data.LOAD.Elf ~~~~/vmlinux  /NoCODE /PlusVM /StripPART 4.

  
; Map the virtual kernel symbols to physical addresses
  ; to give the debugger access to it before CPU MMU is
  ; initialized 
  PRINT "initializing debugger MMU..."
  MMU.FORMAT LINUXSWAP3 swapper_pg_dir 0xc0000000++0xef7fffff 0x80000000
  TRANSlation.COMMON 0xbf000000--0xffffffff
  TRANSlation.TableWalk ON
  TRANSlation.ON
  
; Initialize Linux Awareness
  ; Note that the Linux awareness needs the kernel symbols to work 
  PRINT "initializing RTOS support..."
  ; Choose the correct Linux major version below
  ;TASK.CONFIG ~~/demo/arm/kernel/linux/linux-2.x/linux.t32     ; loads Linux awareness for linux-2.x
  ;MENU.ReProgram ~~/demo/arm/kernel/linux/linux-2.x/linux.men  ; loads Linux menu  for linux-2.x
  TASK.CONFIG ~~/demo/arm/kernel/linux/linux-3.x/linux3.t32     ; loads Linux awareness for linux-3.x
  MENU.ReProgram ~~/demo/arm/kernel/linux/linux-3.x/linux.men  ; loads Linux menu  for linux-3.x
  
; Group kernel area to be displayed with red bar
  GROUP.Create "kernel" 0xc0000000--0xffffffff /RED

  Go.direct

  Mode.Hll

  ENDDO  
TerminalWaitString: ;(&str)
  LOCAL &str
  ENTRY %LINE &str
  &str=&str
  SCREEN.ALways
  RePeaT
  (
    WAIT 0.5s
    SCREEN.display
    WinFIND "&str" TERM.view
  )
  WHILE !FOUND() 
  RETURN

