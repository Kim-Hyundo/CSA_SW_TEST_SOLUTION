; --------------------------------------------------------------------------------
; @Title: ATAG Structure Initialization Script for the MEP-6410 Board
; @Description: 
;   Setup parameter tags for Linux boot
;   Format:
;   u32 size  \_ header
;   u32 type  /
;   n * u32 tag
; @Author: DIE
; @Board: MEP-6410
; @Props:NoWelcome
; @Chip: S3C6410
; @Copyright: (C) 1989-2019 Lauterbach GmbH, licensed for use with TRACE32(R) only
; --------------------------------------------------------------------------------
; $Id: mep6410_atag_list.cmm 15210 2019-11-04 10:51:00Z bschroefel $


&tag=0x50000100

&tagAddr=&tag

; ATAG_CORE
Data.Set &tagAddr %Long %LE 0x2
&tagAddr=&tagAddr+0x4
Data.Set &tagAddr  %Long %LE 0x54410001
&tagAddr=&tagAddr+0x4

; ATAG_MEM
Data.Set &tagAddr %Long %LE 0x4
&tagAddr=&tagAddr+0x4
Data.Set &tagAddr %Long %LE 0x54410002
&tagAddr=&tagAddr+0x4
Data.Set &tagAddr %Long %LE 0x08000000  // size 128MB
&tagAddr=&tagAddr+0x4
Data.Set &tagAddr %Long %LE 0x50000000  // start
&tagAddr=&tagAddr+0x4

; ATAG_CMDLINE
&cmdline="console=ttySAC0,115200n81 initrd=0x50800000,32M root=/dev/ram rw"
&cmdsize=(STRing.LENgth("&cmdline")+16)&~0x3
Data.Set &tagAddr %Long %LE &cmdsize/4
&tagAddr=&tagAddr+0x4
Data.Set &tagAddr %Long %LE 0x54410009
&tagAddr=&tagAddr+0x4
Data.Set &tagAddr "&cmdline" 0
&tagAddr=&tagAddr+(&cmdsize-8)

; ATAG_NONE
Data.Set &tagAddr %Long %LE 0x0
&tagAddr=&tagAddr+0x4
Data.Set &tagAddr %Long %LE 0x0
&tagAddr=&tagAddr+0x4

Register.Set r2 &tag

ENDDO


