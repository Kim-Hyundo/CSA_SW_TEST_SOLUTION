; --------------------------------------------------------------------------------
; @Title: ATAG Structure Initialization Script for the Sitara Board
; @Description: 
;   Setup parameter tags for Linux boot
;   Format:
;   u32 size  \_ header
;   u32 type  /
;   n * u32 tag
; @Keywords: AM37*, ARM, ATAG, Linux, RTOS, TI
; @Props: NoWelcome
; @Author: KJM
; @Board: Sitara
; @Chip: AM3715
; @Copyright: (C) 1989-2019 Lauterbach GmbH, licensed for use with TRACE32(R) only
; --------------------------------------------------------------------------------
; $Id: sitara_atag_list.cmm 15210 2019-11-04 10:51:00Z bschroefel $


&tag=0x80000100
&tagAddr=&tag

Data.Set &tagAddr++0xef %Long 0x0

; ATAG_CORE
Data.Set &tagAddr %Long %LE 0x5
&tagAddr=&tagAddr+0x4
Data.Set &tagAddr %Long %LE 0x54410001
&tagAddr=&tagAddr+0x4
Data.Set &tagAddr %Long %LE 0x0
&tagAddr=&tagAddr+0x4
Data.Set &tagAddr %Long %LE 0x0
&tagAddr=&tagAddr+0x4
Data.Set &tagAddr %Long %LE 0x0
&tagAddr=&tagAddr+0x4

; ATAG_Revision
Data.Set &tagAddr %Long %LE 0x3
&tagAddr=&tagAddr+0x4
Data.Set &tagAddr %Long %LE  0x54410007
&tagAddr=&tagAddr+0x4
Data.Set &tagAddr %Long %LE 0x00000010
&tagAddr=&tagAddr+0x4

; ATAG_MEM
Data.Set &tagAddr %Long %LE 0x4
&tagAddr=&tagAddr+0x4
Data.Set &tagAddr %Long %LE 0x54410002
&tagAddr=&tagAddr+0x4
Data.Set &tagAddr %Long %LE 0x20000000
&tagAddr=&tagAddr+0x4
Data.Set &tagAddr %Long %LE 0x80000000 
&tagAddr=&tagAddr+0x4

; ATAG_CMDLINE
&cmdline="mem=128M console=ttyS0,115200n8 root=/dev/ram0 rw initrd=0x81600000,4M"
&cmdsize=(STRing.LENgth("&cmdline")+16)&~0x3
Data.Set &tagAddr %Long %LE &cmdsize/4
&tagAddr=&tagAddr+0x4
Data.Set &tagAddr %Long %LE 0x54410009
&tagAddr=&tagAddr+0x4
Data.Set &tagAddr "&cmdline" 0
&tagAddr=&tagAddr+(&cmdsize-8)

; ATAG_NONE
Data.Set &tagAddr %Long %LE 0x0
&tagAddr=&tagAddr+0x4
Data.Set &tagAddr %Long %LE 0x0
&tagAddr=&tagAddr+0x4

Register.Set R2 &tag

ENDDO





