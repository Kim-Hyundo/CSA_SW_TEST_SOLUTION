; --------------------------------------------------------------------------------
; @Title: Linux Demo for TRACE32 OS Awareness on the SabreLite i.MX6 Board Quad
; @Description: 
;   This batchfile demonstrates the use of the OS Awareness for Linux 
;   The example is generated for the SABER-SDB board using an ICD.
;   It will NOT run on any other board, but may be used as a template
;   for others.
;   Linux and device tree blob are downloaded to the board via ICD.
; @Keywords: awareness, Freescale, imx6*, i.MX6*, dtb, saber
; @Board: SABER-SDB
; @Chip: IMX6QUAD*
; @Copyright: (C) 1989-2019 Lauterbach GmbH, licensed for use with TRACE32(R) only
; --------------------------------------------------------------------------------
; $Id: saber_sdb_linux_dtb.cmm 16125 2020-05-29 14:29:16Z mcharfi $


; Starting Linux example with TRACE32:
;   - Connect Serial Console via uUSB USB<->Serial converter
;   - 115200 baud, 8/N/1, no(!) handshake
;   - Board contain u-boot
;   - SW6 = 01000010
;   - Start TRACE32
;   - Switch on the board
;   - TRACE32: "do saber_sdb_linux_dtb.cmm"

 LOCAL &ka_path &awareness
 SCREEN.ON

  ; Debugger Reset

  WinPAGE.RESet
  AREA.RESet
  WinPOS 0. 0. 80. 20. 0. 0. W000
  AREA.view

  PRINT "resetting..."
  ; Reset chip, connect to core #0 only
  RESet 
  SYStem.CPU IMX6QUAD
  CORE.ASSIGN 1
  SYStem.Option ResBreak OFF
  SYStem.Option WaitReset 10.8ms 
  SYStem.Option DACR ON          ; give Debugger global write permissions
  TrOnchip.Set DABORT OFF        ; used by Linux for page miss!
  TrOnchip.Set PABORT OFF        ; used by Linux for page miss!
  TrOnchip.Set UNDEF OFF         ; my be used by Linux for FPU detection
  SYStem.Option MMUSPACES ON      ; enable space ids to virtual addresses
  SYStem.Up
  
  ; Serial terminal
  WinPOS 0. 25. 80. 25. 0. 0. W001
  DO ~~/demo/etc/terminal/serial/term.cmm COM16 115200.
  
  ; Runing the u-boot to initialize the target  
  
  PRINT "Initializing the target by u-boot..."
  Go.direct
  WAIT 1.s
  Break.direct

  ; Loading Linux image and DTB via ICD   

  PRINT "loading Linux image..."
  ; Data.LOAD.Elf vmlinux <physical start>-<virtual start>
  Data.LOAD.Elf vmlinux A:0x10008000-0x80008000 /gnu /NosYmbol /noreg 
  
  PRINT "loading DTB..."  
  Data.LOAD.Binary imx6q-sabresd-ldo.dtb A:0x18000000
  
  Register.RESet
  ; Set PC on start address of image
  Register.Set PC 0x10008000
  ; Set machine type in R1; see arch/arm/tools/mach-types
  Register.Set R1 0x0F8C 
  Register.Set R2 0x18000000
  
  PER.Set.simple C15:0x1 %Long 00C5087A  ;Setting the System Control Register (SCTLR) 
  
  ; Loading RAM disk
  PRINT "loading ram disk..."
  Data.LOAD.Binary ramdisk.image.gz A:0x1800f000 /NoClear /NosYmbol

  ; Load the Linux kernel symbols into the debugger
  PRINT "loading Linux kernel symbols..."
  Data.LOAD.Elf vmlinux /gnu /NoCODE /StripPART 12.  /SOURCEPATH C:\Users\abouassida\Desktop\freescaleimx6\linux

  ; Open a Code Window -- we like to see something
  WinPOS 85. 0. 100. 50.
  List.auto
  SCREEN.display
 
  ; Map the virtual kernel symbols to physical addresses
  ; to give the debugger access to it before CPU MMU is
  ; initialized
  PRINT "Initializing debugger MMU..."
  MMU.FORMAT LINUX swapper_pg_dir 0x80000000--0xdfffffff 0x10000000
  TRANSlation.COMMON 07f000000--0ffffffff         ; common area for kernel and processes
  TRANSlation.TableWalk ON   ; debugger uses a table walk to decode virtual addresses
  TRANSlation.ON
  
  Go.direct
  WAIT 5.s
  SYStem.Down
  PRINT "Connecting to all core..."
  CORE.ASSIGN 1 2 3 4 ; Connect to all core
  SYStem.Mode Attach
  Break.direct
 
  ; check linux major version
  IF STRing.SCAN(Data.STRing(linux_banner), "Linux version 2.", 0)==0
  (
    &ka_path="~~/demo/arm/kernel/linux/linux-2.x"
    &awareness="linux.t32"
  )
  ELSE
  (
    &ka_path="~~/demo/arm/kernel/linux/linux-3.x"
    &awareness="linux3.t32"  
  )

  PRINT "initializing RTOS support..."
  TASK.CONFIG &ka_path/&awareness               ; loads Linux awareness 
  MENU.ReProgram &ka_path/linux            ; loads Linux menu 
  
  Go.direct
  
  ENDDO
