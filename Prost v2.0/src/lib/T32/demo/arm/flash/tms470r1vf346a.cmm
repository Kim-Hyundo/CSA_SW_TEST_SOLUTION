; --------------------------------------------------------------------------------
; @Title: TMS470 internal flash of TMS470R1VF346A
;
; @Description: 
; Script arguments:
;
;   DO tms470r1vf346a [PREPAREONLY] 
;
;     PREPAREONLY only declares flash but does not execute flash programming
;
; Example:
;
;   DO ~~/demo/arm/flash/tms470r1vf346a PREPAREONLY
;
; @Author: WRD
; @Copyright: (C) 1989-2019 Lauterbach GmbH, licensed for use with TRACE32(R) only
; @Chip: TMS470R1VF346A  
; --------------------------------------------------------------------------------
; $Rev: 7602 $
; $Id: tms470r1vf346a.cmm 7602 2019-11-05 15:02:25Z bschroefel $

LOCAL &parameters
ENTRY %LINE &parameters

DO ~~~~/tms470r1vf336a TMS470R1VF346A &parameters

ENDDO
