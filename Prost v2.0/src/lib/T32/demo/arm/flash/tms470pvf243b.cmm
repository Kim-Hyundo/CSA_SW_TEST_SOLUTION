; --------------------------------------------------------------------------------
; @Title: TMS470 internal flash of TMS470PVF243B
;
; @Description:
; Script arguments:
;
;   DO tms470pvf243b [PREPAREONLY] 
;
;     PREPAREONLY only declares flash but does not execute flash programming
;
; Example:
;
;   DO ~~/demo/arm/flash/tms470pvf243b PREPAREONLY
;
; @Author: WRD
; @Copyright: (C) 1989-2019 Lauterbach GmbH, licensed for use with TRACE32(R) only
; --------------------------------------------------------------------------------
; $Rev: 7602 $
; $Id: tms470pvf243b.cmm 7602 2019-11-05 15:02:25Z bschroefel $

LOCAL &parameters
ENTRY %LINE &parameters

DO ~~~~/tms470pvf241b TMS470PVF243 &parameters

ENDDO
