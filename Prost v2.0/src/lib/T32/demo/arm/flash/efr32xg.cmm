;
; @Title: Example for flash declaration of EnergyMicro EFR32 BluePearl Gecko internal flash.
;
; @Description: 
; Script arguments:
;
;   DO efr32xg [PREPAREONLY] [CPU=<cpu>]
;
;     PREPAREONLY only declares flash but does not execute flash programming
;
;     CPU=<cpu> selects CPU derivative <cpu>
;
; Example:
;
;   DO ~~/demo/arm/flash/efr32xg CPU=EFM32PG12B500F1024 PREPAREONLY
;
; List of EFM32 Pearl Gecko derivatives and their configuration:
;
;   CPU                              FlashSize  RamSize
;   Derivative                         [kB]      [kB]
; --------------------------------------------------------------------------------
;   EFR32BG13P532F512                  512.      64.
;   EFR32BG13P632F512                  512.      64.
;   EFR32BG13P732F512                  512.      64.
;   EFR32BG13P733F512                  512.      64.
;   EFR32MG1P132F256                   256       32
;   EFR32MG1B232F256                   256       32
;   EFR32MG1B232F256                   256       32
;   EFR32MG1V132F256                   256       32
;   EFR32MG12P431F1024                1024      256
;   EFR32MG12P432F1024                1024      256
;   EFR32MG12P433F1024                1024      256
;   EFR32MG12P332F1024                1024      256
;   EFR32MG12P232F1024                1024      128
;   EFR32MG12P232F512                  512       64
;   EFR32MG12P232F1024                1024      128
;   EFR32MG12P231F1024                1024      128
;   EFR32MG12P132F1024                1024      128
;   EFR32MG12P132F512                  512       64
;   EFR32MG12P132F1024                1024      128
;   EFR32MG13P733F512                  512       64
;   EFR32MG13P732F512                  512       64
;   EFR32MG13P632F512                  512       64
;   EFR32MG14P733F256                  256       32
;   EFR32MG14P732F256                  256       32
;   EFR32MG14P731F256                  256       32
;   EFR32MG14P632F256                  256       32


;
; @Author: MAM
; @Copyright: (C) 1989-2019 Lauterbach GmbH, licensed for use with TRACE32(R) only
; @Chip: EFR32BG*
; --------------------------------------------------------------------------------
; $Rev: 7577 $
; $Id: efr32xg.cmm 7577 2019-10-30 15:30:31Z bschroefel $

  LOCAL &parameters &param_prepareonly
  ENTRY %LINE &parameters
  &param_prepareonly=(STRing.SCAN(STRing.UPpeR("&parameters"),"PREPAREONLY",0)!=-1)

  LOCAL &param_cpu
  &param_cpu=STRing.SCANAndExtract("&parameters","CPU=","")

  LOCAL &FlashSize

  ; ------------------------------------------------------------------------------
  ; Start debugging

  IF SYStem.MODE()<5
  (
    SYStem.RESet

    IF "&param_cpu"!=""
      SYStem.CPU &param_cpu
    IF !CPUIS(EFR32?G*)
      SYStem.CPU EFR32?G*

    SYStem.Option.ResBreak OFF
    IF CABLE.TWOWIRE()
    (
      SYStem.CONFIG.DEBUGPORTTYPE SWD
    )
    ELSE
    (
      PRINT %ERROR "Serial Wire Debug (SWD) not supported by debug cable"
      ENDDO
    )
    SYStem.JtagClock 500Khz

    SYStem.Up

    ; After SYStem.Up the JTAG clock can be set to higher frequency.
    SYStem.JtagClock 10Mhz
  )

  ; ------------------------------------------------------------------------------
  ; Flash declaration

  IF CPUIS(*F256*)
    &FlashSize=0x40000
  ELSE IF CPUIS(*F512*)
    &FlashSize=0x80000
  ELSE IF CPUIS(*F1024*)
    &FlashSize=0x100000
  ELSE
  (
    PRINT %ERROR "FLASH size of CPU type is not supported by the script"
    ENDDO
  )

  FLASH.RESet
  FLASH.Create   1. 0x00000000++(&FlashSize-1) 0x800 TARGET Byte
  FLASH.TARGET 0x10000000 0x10001000 0x800 ~~/demo/arm/flash/long/efr32bg.bin

  ; Flash script ends here if called with parameter PREPAREONLY
  IF &param_prepareonly
    ENDDO PREPAREDONE

  ; ------------------------------------------------------------------------------
  ; Flash programming example

  DIALOG.YESNO "Program flash memory?"
  LOCAL &progflash
  ENTRY &progflash
  IF &progflash 
  (
    FLASH.ReProgram.ALL /Erase
    Data.LOAD.auto *
    FLASH.ReProgram.off

    ; Reset device
    SYStem.Down
    SYStem.Up
  )

  ENDDO
