; --------------------------------------------------------------------------------
; @Title: Setup of TMS570LS21xx internal flash
;
; @Description:
; Script arguments:
;
;  do tms570ls21xx [AUTOECC=0|1] [PREPAREONLY]
;
;   AUTOECC default value is 1
;
;   PREPAREONLY only declares flash but does not execute flash programming example
;
; List of TMS570LS21xx derivatives and their configuration:
;
;   CPU-Type           Flash    RAM
;   --------------------------------
;   TMS570LS2124-PGE    2MB    192kB
;   TMS570LS2124-ZWT    2MB    192kB
;   TMS570LS2125-PGE    2MB    192kB
;   TMS570LS2125-ZWT    2MB    192kB
;   TMS570LS2134-PGE    2MB    256kB
;   TMS570LS2134-ZWT    2MB    256kB
;   TMS570LS2135-PGE    2MB    256kB
;   TMS570LS2135-ZWT    2MB    256kB
;
; HINTS:
;
;   Flash programming algorithm is linked to address 0x08000000 and is not
;   position independent. Code address of FLASH.TARGET command has not be
;   changed.
;
; @Author: WRD
; @Copyright: (C) 1989-2019 Lauterbach GmbH, licensed for use with TRACE32(R) only
; @Chip: TMS570LS21*
; --------------------------------------------------------------------------------
; $Rev: 6945 $
; $Id: tms570ls21xx.cmm 6945 2019-05-07 13:57:32Z wdoering $

  ; --------------------------------------------------------------------------------
  ; Setup script configuration. If auto ECC generation is disabled then
  ; flash sectors are programmed without generating ECC. ECC sectors can be
  ; programmed separately or ECC sector programming can be omitted.

  LOCAL &parameters
  ENTRY %LINE &parameters

  LOCAL &param_prepareonly
  &param_prepareonly=(STRing.SCAN(STRing.UPpeR("&parameters"),"PREPAREONLY",0)!=-1)

  LOCAL &AutoECCGeneration
  &AutoECCGeneration=STRing.SCANAndExtract(STRing.UPpeR("&parameters"),"AUTOECC=","1")

  LOCAL &flashdriver

  ; --------------------------------------------------------------------------------
  ; Setup CPU

  IF SYStem.MODE()<5
  (
    SYStem.RESet
    MAP.RESet

    SYStem.CPU TMS570LS2135-ZWT
    ETM.OFF
    SYStem.Up
  )

  ; --------------------------------------------------------------------------------
  ; Flash declaration

  FLASH.RESet

  IF &AutoECCGeneration!=0
  (
    ; Program flash
    FLASH.Create  1. 0x00000000--0x0001FFFF  0x8000 TARGET Byte 0.      /INFO "TCM Flash Bank 0"
    FLASH.Create  1. 0x00020000--0x0017FFFF 0x20000 TARGET Byte 0.      /INFO "TCM Flash Bank 0"
    FLASH.Create  2. 0x00180000--0x001FFFFF 0x20000 TARGET Byte 1.      /INFO "TCM Flash Bank 1"
    ; Program flash ECC
    FLASH.Create  1. 0xF0400000--0xF0403FFF  0x1000 NOP    Byte 0.      /INFO "TCM Flash Bank 0 ECC"
    FLASH.Create  1. 0xF0404000--0xF042FFFF  0x4000 NOP    Byte 0.      /INFO "TCM Flash Bank 0 ECC"
    FLASH.Create  2. 0xF0430000--0xF043FFFF  0x4000 NOP    Byte 1.      /INFO "TCM Flash Bank 1 ECC"
    ; EEPROM emulation flash
    FLASH.Create  8. 0xF0200000--0xF020FFFF  0x4000 TARGET Byte 7.      /INFO "EEPROM emulation Flash Bank 7"
    ; EEPROM emulation flash ECC
    FLASH.Create  8. 0xF0100000--0xF0101FFF   0x800 NOP    Byte 7.      /INFO "EEPROM emulation Flash Bank 7 ECC"
    ; OTP flash
    FLASH.Create 11. 0xF0000000--0xF0000FFF  0x1000 TARGET Quad 0. /OTP /INFO "Customer OTP, TCM Flash Bank 0"
    FLASH.Create 12. 0xF0002000--0xF0002FFF  0x1000 TARGET Quad 1. /OTP /INFO "Customer OTP, TCM Flash Bank 1"
    FLASH.Create 18. 0xF000E000--0xF000E7FF   0x800 TARGET Quad 7. /OTP /INFO "Customer OTP, EEPROM bank 7"
    ; OTP flash ECC
    FLASH.Create 11. 0xF0040000--0xF00401FF   0x200 NOP    Byte 0. /OTP /INFO "Customer OTP, TCM Flash Bank 0 ECC"
    FLASH.Create 12. 0xF0040400--0xF00405FF   0x200 NOP    Byte 1. /OTP /INFO "Customer OTP, TCM Flash Bank 1 ECC"
    FLASH.Create 18. 0xF0041C00--0xF0041CFF   0x100 NOP    Byte 7. /OTP /INFO "Customer OTP, EEPROM bank 7 ECC"

    &flashdriver="f021r4.bin"
  )
  ELSE
  (
    ; Program flash
    FLASH.Create  1. 0x00000000--0x0001FFFF  0x8000 TARGET Byte 0. /EraseALIAS 0xF0400000--0xF0403FFF /INFO "TCM Flash Bank 0"
    FLASH.Create  1. 0x00020000--0x0017FFFF 0x20000 TARGET Byte 0. /EraseALIAS 0xF0404000--0xF042FFFF /INFO "TCM Flash Bank 0"
    FLASH.Create  2. 0x00180000--0x001FFFFF 0x20000 TARGET Byte 1. /EraseALIAS 0xF0430000--0xF043FFFF /INFO "TCM Flash Bank 1"
    ; Program flash ECC
    FLASH.Create  1. 0xF0400000--0xF0403FFF  0x1000 TARGET Byte 0. /EraseALIAS 0x00000000--0x0001FFFF /INFO "TCM Flash Bank 0 ECC"
    FLASH.Create  1. 0xF0404000--0xF042FFFF  0x4000 TARGET Byte 0. /EraseALIAS 0x00020000--0x0017FFFF /INFO "TCM Flash Bank 0 ECC"
    FLASH.Create  2. 0xF0430000--0xF043FFFF  0x4000 TARGET Byte 1. /EraseALIAS 0x00180000--0x001FFFFF /INFO "TCM Flash Bank 1 ECC"
    ; EEPROM emulation flash
    FLASH.Create  8. 0xF0200000--0xF020FFFF  0x4000 TARGET Byte 7. /EraseALIAS 0xF0100000--0xF0101FFF /INFO "EEPROM emulation Flash Bank 7"
    ; EEPROM emulation flash ECC
    FLASH.Create  8. 0xF0100000--0xF0101FFF   0x800 TARGET Byte 7. /EraseALIAS 0xF0200000--0xF020FFFF /INFO "EEPROM emulation Flash Bank 7 ECC"
    ; OTP flash
    FLASH.Create 11. 0xF0000000--0xF0000FFF  0x1000 TARGET Quad 0. /OTP                               /INFO "Customer OTP, TCM Flash Bank 0"
    FLASH.Create 12. 0xF0002000--0xF0002FFF  0x1000 TARGET Quad 1. /OTP                               /INFO "Customer OTP, TCM Flash Bank 1"
    FLASH.Create 18. 0xF000E000--0xF000E7FF   0x800 TARGET Quad 7. /OTP                               /INFO "Customer OTP, EEPROM bank 7"
    ; OTP flash ECC
    FLASH.Create 11. 0xF0040000--0xF00401FF   0x200 TARGET Byte 0. /OTP                               /INFO "Customer OTP, TCM Flash Bank 0 ECC"
    FLASH.Create 12. 0xF0040400--0xF00405FF   0x200 TARGET Byte 1. /OTP                               /INFO "Customer OTP, TCM Flash Bank 1 ECC"
    FLASH.Create 18. 0xF0041C00--0xF0041CFF   0x100 TARGET Byte 7. /OTP                               /INFO "Customer OTP, EEPROM bank 7 ECC"

    &flashdriver="f021r4noecc.bin"
  )

  FLASH.TARGET 0x08000000 0x08001000 0x4000 ~~/demo/arm/flash/byte_be/&flashdriver
  IF FLASH.TARGET.BUILD(~~/demo/arm/flash/byte_be/&flashdriver)<1764.
    PRINT %ERROR "Flash algorithm is to old for OTP programming, please request an update"

  FLASH.CLocK AUTO

  MAP.BUS16 0xF0400000--0xF043FFFF
  MAP.BUS16 0xF0100000--0xF0101FFF
  MAP.BUS16 0xF0040000--0xF0041FFF

  ; Flash script ends here if called with parameter PREPAREONLY
  IF &param_prepareonly
    ENDDO PREPAREDONE

  ; --------------------------------------------------------------------------------
  ; Flash programming example

  DIALOG.YESNO "Program flash memory?"
  LOCAL &progflash
  ENTRY &progflash

  IF &progflash 
  (
    FLASH.ReProgram ALL /Erase
    Data.LOAD.auto *
    FLASH.ReProgram.oFF 
  )

  ENDDO
