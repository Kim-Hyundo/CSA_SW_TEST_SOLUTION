; --------------------------------------------------------------------------------
; @Title: Generic script for RM57 internal flash
;
; @Description:
;
; Flash declaration of TI RM57 internal flash.
;
; Script arguments:
;
;   DO rm57 [CPU=<cpu>] [PREPAREONLY] [AUTOECC=0|1]
;
;     CPU=<cpu> selects CPU derivative <cpu>. <cpu> can be CPU name out of the
;             table listed below. For these derivatives the flash declaration
;             is done by the script.
;
;     AUTOECC default value is 1 to enable auto ECC generation
;             If auto ECC generation is disabled then flash sectors are
;             programmed without generating ECC. ECC sectors can be programmed
;             separately or ECC sector programming can be omitted.
;
;     PREPAREONLY only declares flash but does not execute flash programming
;             example
;
; For example:
;
;   DO ~~/demo/arm/flash/rm57 CPU=RM57L843-ZWT PREPAREONLY
;
; List of RM57 derivatives and their configuration:
;
;                                EEPROM
;                     Program   emulation
;   CPU-Type           Flash      Flash       RAM
; --------------------------------------------------------------------------------
;   RM57L843-ZWT       4MB        128kB      512kB
;
; HINTS:
;
;   Flash programming algorithm is linked to address 0x08000000 and is not
;   position independent. Code address of FLASH.TARGET command has not be
;   changed.
;
;   OTP sectors can be programmed using FLASH.Program with /OTP option.
;   For example with:
;
;     FLASH.Program 0xF0000000--0xF0000FFF /OTP
;     Data.Set ...
;     ...
;     FLASH.Program off
;
; @Chip: RM57*
; @Author: FLC
; @Copyright: (C) 1989-2019 Lauterbach GmbH, licensed for use with TRACE32(R) only
; --------------------------------------------------------------------------------
; $Rev: 6957 $
; $Id: rm57.cmm 6957 2019-05-09 14:57:39Z wdoering $
;

  LOCAL &parameters
  ENTRY %LINE &parameters

  LOCAL &param_prepareonly
  &param_prepareonly=(STRing.SCAN(STRing.UPpeR("&parameters"),"PREPAREONLY",0)!=-1)

  LOCAL &AutoECCGeneration
  &AutoECCGeneration=STRing.SCANAndExtract(STRing.UPpeR("&parameters"),"AUTOECC=","1")

  LOCAL &param_cpu
  &param_cpu=STRing.SCANAndExtract(STRing.UPpeR("&parameters"),"CPU=","")

  LOCAL &flashdriver

  ; --------------------------------------------------------------------------------
  ; check prerequisites
  IF VERSION.BUILD.BASE()<76594.
  (
    PRINT %ERROR "Please use more recent Software! Contact support@lauterbach.com."
    STOP
    ENDDO
  )

  ; ------------------------------------------------------------------------------
  ; Setup CPU

  IF SYStem.MODE()<5
  (
    SYStem.RESet

    MAP.RESet

    IF "&param_cpu"!=""
      SYStem.CPU &param_cpu
    IF !CPUIS(RM57*)
      SYStem.CPU RM57*

    ; these settings stop the CPU at the RESET Vector
    SYStem.Option EnReset OFF
    SYStem.Option ICEPICK SystemReset.ON
    SYStem.Option ICEPICK WaitInReset.ON

    SYStem.Up

  )

  ; Init ECC
  Data.Set 0x08000000++0x7FFF %Quad 0x0

  ; ------------------------------------------------------------------------------
  ; Flash declaration

  FLASH.RESet

  IF &AutoECCGeneration!=0
  (
    ; Program flash
    FLASH.Create  1. 0x00000000--0x00017FFF  0x4000 TARGET Byte 0. /INFO "Flash Bank 0"
    FLASH.Create  1. 0x00018000--0x0001FFFF  0x8000 TARGET Byte 0. /INFO "Flash Bank 0"
    FLASH.Create  1. 0x00020000--0x0007FFFF 0x20000 TARGET Byte 0. /INFO "Flash Bank 0"
    FLASH.Create  1. 0x00080000--0x001FFFFF 0x40000 TARGET Byte 0. /INFO "Flash Bank 0"
    FLASH.Create  2. 0x00200000--0x003FFFFF 0x20000 TARGET Byte 1. /INFO "Flash Bank 1"
    ; Program flash ECC
    FLASH.Create  1. 0xF0400000--0xF0402FFF   0x800 NOP    Byte 0. /INFO "Flash Bank 0 ECC"
    FLASH.Create  1. 0xF0403000--0xF0403FFF  0x1000 NOP    Byte 0. /INFO "Flash Bank 0 ECC"
    FLASH.Create  1. 0xF0404000--0xF040FFFF  0x4000 NOP    Byte 0. /INFO "Flash Bank 0 ECC"
    FLASH.Create  1. 0xF0410000--0xF043FFFF  0x8000 NOP    Byte 0. /INFO "Flash Bank 0 ECC"
    FLASH.Create  2. 0xF0440000--0xF047FFFF  0x4000 NOP    Byte 1. /INFO "Flash Bank 1 ECC"
    ; EEPROM emulation flash
    FLASH.Create  8. 0xF0200000--0xF021FFFF  0x1000 TARGET Byte 7. /INFO "EEPROM emulation Flash Bank 7"
    ; EEPROM emulation flash ECC
    FLASH.Create  8. 0xF0100000--0xF0103FFF   0x200 NOP    Byte 7. /INFO "EEPROM emulation Flash Bank 7 ECC"
    ; OTP flash
    FLASH.Create 11. 0xF0000000--0xF0000FFF  0x1000 TARGET Quad 0. /OTP /INFO "Customer OTP, Flash Bank 0"
    FLASH.Create 12. 0xF0002000--0xF0002FFF  0x1000 TARGET Quad 1. /OTP /INFO "Customer OTP, Flash Bank 1"
    FLASH.Create 18. 0xF000E000--0xF000E3FF   0x400 TARGET Quad 7. /OTP /INFO "Customer OTP, EEPROM bank 7"
    ; OTP flash ECC
    FLASH.Create 11. 0xF0040000--0xF00401FF   0x200 NOP    Byte 0. /OTP /INFO "Customer OTP, Flash Bank 0 ECC"
    FLASH.Create 12. 0xF0040400--0xF00405FF   0x200 NOP    Byte 1. /OTP /INFO "Customer OTP, Flash Bank 1 ECC"
    FLASH.Create 18. 0xF0041C00--0xF0041C7F    0x80 NOP    Byte 7. /OTP /INFO "Customer OTP, EEPROM bank 7 ECC"

    &flashdriver="f021r4l2fmc.bin"
  )
  ELSE
  (
    ; Program flash
    FLASH.Create  1. 0x00000000--0x00017FFF  0x4000 TARGET Byte 0. /EraseALIAS 0xF0400000--0xF0402FFF /INFO "Flash Bank 0"
    FLASH.Create  1. 0x00018000--0x0001FFFF  0x8000 TARGET Byte 0. /EraseALIAS 0xF0403000--0xF0403FFF /INFO "Flash Bank 0"
    FLASH.Create  1. 0x00020000--0x0007FFFF 0x20000 TARGET Byte 0. /EraseALIAS 0xF0404000--0xF040FFFF /INFO "Flash Bank 0"
    FLASH.Create  1. 0x00080000--0x001FFFFF 0x40000 TARGET Byte 0. /EraseALIAS 0xF0410000--0xF043FFFF /INFO "Flash Bank 0"
    FLASH.Create  2. 0x00200000--0x003FFFFF 0x20000 TARGET Byte 1. /EraseALIAS 0xF0440000--0xF047FFFF /INFO "Flash Bank 1"
    ; Program flash ECC
    FLASH.Create  1. 0xF0400000--0xF0402FFF   0x800 TARGET Byte 0. /EraseALIAS 0x00000000--0x00017FFF /INFO "Flash Bank 0 ECC"
    FLASH.Create  1. 0xF0403000--0xF0403FFF  0x1000 TARGET Byte 0. /EraseALIAS 0x00018000--0x0001FFFF /INFO "Flash Bank 0 ECC"
    FLASH.Create  1. 0xF0404000--0xF040FFFF  0x4000 TARGET Byte 0. /EraseALIAS 0x00020000--0x0007FFFF /INFO "Flash Bank 0 ECC"
    FLASH.Create  1. 0xF0410000--0xF043FFFF  0x8000 TARGET Byte 0. /EraseALIAS 0x00080000--0x001FFFFF /INFO "Flash Bank 0 ECC"
    FLASH.Create  2. 0xF0440000--0xF047FFFF  0x4000 TARGET Byte 1. /EraseALIAS 0x00200000--0x003FFFFF /INFO "Flash Bank 1 ECC"
    ; EEPROM emulation flash
    FLASH.Create  8. 0xF0200000--0xF021FFFF  0x1000 TARGET Byte 7. /EraseALIAS 0xF0100000--0xF0103FFF /INFO "EEPROM emulation Flash Bank 7"
    ; EEPROM emulation flash ECC
    FLASH.Create  8. 0xF0100000--0xF0103FFF   0x200 TARGET Byte 7. /EraseALIAS 0xF0200000--0xF021FFFF /INFO "EEPROM emulation Flash Bank 7 ECC"
    ; OTP flash
    FLASH.Create 11. 0xF0000000--0xF0000FFF  0x1000 TARGET Quad 0. /OTP                               /INFO "Customer OTP, Flash Bank 0"
    FLASH.Create 12. 0xF0002000--0xF0002FFF  0x1000 TARGET Quad 1. /OTP                               /INFO "Customer OTP, Flash Bank 1"
    FLASH.Create 18. 0xF000E000--0xF000E3FF   0x400 TARGET Quad 7. /OTP                               /INFO "Customer OTP, EEPROM bank 7"
    ; OTP flash ECC
    FLASH.Create 11. 0xF0040000--0xF00401FF   0x200 TARGET Byte 0. /OTP                               /INFO "Customer OTP, Flash Bank 0 ECC"
    FLASH.Create 12. 0xF0040400--0xF00405FF   0x200 TARGET Byte 1. /OTP                               /INFO "Customer OTP, Flash Bank 1 ECC"
    FLASH.Create 18. 0xF0041C00--0xF0041C7F    0x80 TARGET Byte 7. /OTP                               /INFO "Customer OTP, EEPROM bank 7 ECC"

    &flashdriver="f021r4l2fmcnoecc.bin"
  )

  FLASH.TARGET 0x08000000 0x08002000 0x4000 ~~/demo/arm/flash/byte/&flashdriver
  IF FLASH.TARGET.BUILD(~~/demo/arm/flash/byte/&flashdriver)<3486.
    PRINT %ERROR "Flash algorithm does not support ECC line configuration, please request an update"
  IF FLASH.TARGET.BUILD(~~/demo/arm/flash/byte/&flashdriver)<6949.
    PRINT %ERROR "Flash algorithm is to old for OTP programming, please request an update"

  FLASH.CLocK AUTO

  MAP.BUS16 0xF0400000--0xF045FFFF
  MAP.BUS16 0xF0100000--0xF0101FFF
  MAP.BUS16 0xF0040000--0xF0041FFF

  ; Flash script ends here if called with parameter PREPAREONLY
  IF &param_prepareonly
    ENDDO PREPAREDONE

  ; ------------------------------------------------------------------------------
  ; Flash programming example

  DIALOG.YESNO "Program flash memory?"
  LOCAL &progflash
  ENTRY &progflash

  IF &progflash
  (
    ; Preliminary reset device to avoid MPU initialization problems
    SYStem.Down
    SYStem.Up

    ; Fill erased flash with empty value 0xFF not to get ECC errors on unused
    ; flash cells. Check Trace32 software version if option is implemented.
    IF VERSION.BUILD.BASE()<67626.
      FLASH.ReProgram.ALL /Erase
    ELSE
      FLASH.ReProgram.ALL /Erase /FILL
    Data.LOAD.auto *
    FLASH.ReProgram.off
  )

  ENDDO
