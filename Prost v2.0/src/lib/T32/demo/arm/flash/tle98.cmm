; --------------------------------------------------------------------------------
; @Title: Example script for flash declaration of Infineon TLE98X internal flash.
;
; @Description: 
; Synopsis:
;
;   DO tle98 [PREPAREONLY] [CPU=<cpu>]
;
; Description:
;
;   Script arguments are not case sensitive.
;
;   PREPAREONLY only declares flash but does not execute flash programming
;
;   CPU=<cpu> selects CPU derivative <cpu>. <cpu> can be CPU name out of the
;             table listed below. For these derivatives the flash declaration
;             is done by the script.
;
; Example:
;
;   DO ~~/demo/arm/flash/tle98 CPU=TLE987X PREPAREONLY
;
; List of TLE98X derivatives and their configuration:
;
;   CPU-Type              Flash         SRAM        
; --------------------------------------------------------------------------------
;   TLE9842QX             36KB          2KB    
;   TLE9843QX             48KB          4KB
;   TLE9844QX             64KB          4KB
;   TLE9845QX             48KB          4KB
; --------------------------------------------------------------------------------
;   TLE9850QX             48KB          4KB
;   TLE9851QXW            64KB          4KB
;   TLE9852QX             48KB          4KB
;   TLE9853QX             48KB          4KB
;   TLE9854QX             64KB          4KB
;   TLE9854QXW            64KB          4KB
;   TLE9855QX             96KB          4KB
; --------------------------------------------------------------------------------
;   TLE9861QXA20          36KB          3KB
;   TLE9867QXA20          64KB          6KB
;   TLE9867QXA40          64KB          6KB
;   TLE9869QXA20         128KB          6KB
; --------------------------------------------------------------------------------
;   TLE9871QXA20          36KB          3KB
;   TLE9877QXA20          64KB          6KB
;   TLE9877QXA40          64KB          6KB
;   TLE9879QXA20         128KB          6KB
;   TLE9879QXA40         128KB          6KB
;
; Memories:
;
; @Author: FLC
; @Copyright: (C) 1989-2019 Lauterbach GmbH, licensed for use with TRACE32(R) only
; --------------------------------------------------------------------------------
; $Rev: 8234 $
; $Id: tle98.cmm 8234 2020-04-28 06:00:45Z sphilipp $
;

LOCAL &parameters
ENTRY %LINE &parameters

LOCAL &param_prepareonly
&param_prepareonly=(STRing.SCAN(STRing.UPpeR("&parameters"),"PREPAREONLY",0)!=-1)

LOCAL &param_cpu
&param_cpu=STRing.SCANAndExtract(STRing.UPpeR("&parameters"),"CPU=","")
; ------------------------------------------------------------------------------
; Start debugging

IF SYStem.MODE()<5
(
  SYStem.RESet

  IF "&param_cpu"!=""
    SYStem.CPU &param_cpu
  IF !CPUIS(TLE98*)
    SYStem.CPU TLE98*

  SYStem.Mode.Attach
  Break 

  Register.Set XPSR 0x01000000

)

; ------------------------------------------------------------------------------
; Flash declaration

FLASH.RESet
GOSUB FlashDeclaration

; Flash script ends here if called with parameter PREPAREONLY
IF &param_prepareonly
  ENDDO PREPAREDONE

; ------------------------------------------------------------------------------
; Flash programming example

DIALOG.YESNO "Program flash memory?"
LOCAL &progflash
ENTRY &progflash
IF &progflash 
(
  FLASH.ReProgram.ALL /Erase
  Data.LOAD.auto *
  FLASH.ReProgram.off

  ; Reset device
  SYStem.Down
  SYStem.Up
)

ENDDO


--------------------------------------------------------------------------------
Flash declaration depending on selected CPU 

FlashDeclaration:

LOCAL &FlashSize &FlashDriver &BufferSize &PageSize
&FlashSize=0x0
&PageSize=0x1000

IF CPUIS(TLE9842QX)
(
  &FlashSize=0x9000
  &BufferSize=0x400
  &FlashDriver="tle984.bin"
)
ELSE IF CPUIS(TLE9843QX)||CPUIS(TLE9845QX)
(
  &FlashSize=0xC000
  &BufferSize=0x800
  &FlashDriver="tle984.bin"
)
ELSE IF CPUIS(TLE9850QX)||CPUIS(TLE9852QX)||CPUIS(TLE9853QX)
(
  &FlashSize=0xC000
  &BufferSize=0x800
  &PageSize=0x80
  &FlashDriver="tle985.bin"
)
ELSE IF CPUIS(TLE9844QX)
(
  &FlashSize=0x10000
  &BufferSize=0x800
  &FlashDriver="tle984.bin"
)
ELSE IF CPUIS(TLE9851QXW)||CPUIS(TLE9854QX)||CPUIS(TLE9854QXW)
(
  &FlashSize=0x10000
  &BufferSize=0x800
  &PageSize=0x80
  &FlashDriver="tle985.bin"
)
ELSE IF CPUIS(TLE9861*)||CPUIS(TLE9871*)
(
  &FlashSize=0x9000
  &BufferSize=0x400
  &FlashDriver="tle987.bin"
)
ELSE IF CPUIS(TLE9867*)||CPUIS(TLE9877*)
(
  &FlashSize=0x10000
  &BufferSize=0x1000
  &FlashDriver="tle987.bin"
)
ELSE IF CPUIS(TLE9855QX)
(
  &FlashSize=0x18000
  &BufferSize=0x800
  &PageSize=0x80
  &FlashDriver="tle985.bin"
)
ELSE IF CPUIS(TLE9869*)||CPUIS(TLE9879*)
(
  &FlashSize=0x20000
  &BufferSize=0x1000
  &FlashDriver="tle987.bin"
)
ELSE
(
  PRINT %ERROR "FLASH size of CPU type is not supported by the script"
  ENDDO
)

FLASH.Create 1. 0x11000000++(&FlashSize-1) 0x1000 TARGET Long
IF CPUIS(TLE9855QX)
  FLASH.CHANGEtype (0x11000000+&FlashSize-0x1000)++(0x1000-1) 0x1 /INFO "EEPROM"

FLASH.TARGET 0x18000000 0x18000400 &BufferSize ~~/demo/arm/flash/long/&FlashDriver

RETURN
