; --------------------------------------------------------------------------------
; @Title: TMS470 internal flash of TMS470PVF345B
;
; @Description: 
; Script arguments:
;
;   DO tms470pvf345b [PREPAREONLY] 
;
;     PREPAREONLY only declares flash but does not execute flash programming
;
; Example:
;
;   DO ~~/demo/arm/flash/tms470pvf345b PREPAREONLY
;
; internal flash is mapped to: 0x00000000
; internal RAM is mapped to:   0x08000000
;
; @Author: WRD
; @Copyright: (C) 1989-2019 Lauterbach GmbH, licensed for use with TRACE32(R) only
; --------------------------------------------------------------------------------
; $Rev: 7602 $
; $Id: tms470pvf345b.cmm 7602 2019-11-05 15:02:25Z bschroefel $

LOCAL &parameters
ENTRY %LINE &parameters

DO ~~~~/tms470pvf341b TMS470PVF345 &parameters

ENDDO
