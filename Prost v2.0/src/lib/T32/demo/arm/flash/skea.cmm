;
; @Title: Generic script for Freescale SKEAZ internal flash.
;
; @Description:
;
; Example for flash declaration of Freescale SKEAZ internal flash.
;
; Script arguments:
;
;   DO skea [PREPAREONLY] [CPU=<cpu>] [MASSERASE]
;
;     PREPAREONLY only declares flash but does not execute flash programming
;
;     CPU=<cpu> selects CPU derivative <cpu>. <cpu> can be CPU name out of the
;             table listed below. For these derivatives the flash declaration
;             is done by the script.
;
;     MASSERASE forces mass erase of device before establishing debug connection
;
; For example:
;
;   DO ~~/demo/arm/flash/skea CPU=S9KEAZ128AMLK PREPAREONLY
; List of SKEA derivatives and their configuration:
;
;   CPU-Type       Flash   ProgFlash   RamSize    EEPromSize
;                   Type     [Byte]     [Byte]    [Byte]
; --------------------------------------------------------------------------------
;   S9KEAZ64ACLH    FTMRE      64kB        8kB
;   S9KEAZ64ACLK    FTMRE      64kB        8kB
;   S9KEAZ64MLD4    FTMRE      64kB        8kB
;   S9KEAZ64AMLH    FTMRE      64kB        8kB
;   S9KEAZ64AMLK    FTMRE      64kB        8kB
;   S9KEAZ64AVLH    FTMRE      64kB        8kB
;   S9KEAZ64AVLK    FTMRE      64kB        8kB
;   S9KEAZ128MLD4   FTMRE     128kB       16kB
;   S9KEAZ128ACLH   FTMRE     128kB       16kB
;   S9KEAZ128ACLK   FTMRE     128kB       16kB
;   S9KEAZ128AMLH   FTMRE     128kB       16kB
;   S9KEAZ128AMLK   FTMRE     128kB       16kB
;   S9KEAZ128AVLH   FTMRE     128kB       16kB
;   S9KEAZ128AVLK   FTMRE     128kB       16kB
; --------------------------------------------------------------------------------
;   S9KEAZN8AMTG(R) FTMRE       8kB        1kB
;   S9KEAZN8ACTG(R) FTMRE       8kB        1kB
;   S9KEAZN8AMFK(R) FTMRE       8kB        1kB
;   S9KEAZN8ACFK(R) FTMRE       8kB        1kB
;   S9KEAZN8AVTG    FTMRE       8kB        1kB
; --------------------------------------------------------------------------------
;   S9KEAZN16ACLC   FTMRH      16kB        2kB     256
;   S9KEAZN16ACLH   FTMRH      16kB        2kB     256
;   S9KEAZN16AMLC   FTMRH      16kB        2kB     256
;   S9KEAZN16AMLH   FTMRH      16kB        2kB     256
;   S9KEAZN16MLD2   FTMRH      16kB        2kB     256
;   S9KEAZN32ACLC   FTMRH      32kB        4kB     256
;   S9KEAZN32ACLH   FTMRH      32kB        4kB     256
;   S9KEAZN32AMLC   FTMRH      32kB        4kB     256
;   S9KEAZN32AMLH   FTMRH      32kB        4kB     256
;   S9KEAZN32AVLC   FTMRH      32kB        4kB     256
;   S9KEAZN32MLD2   FTMRH      32kB        4kB     256
;   S9KEAZN64ACLC   FTMRH      64kB        4kB     256
;   S9KEAZN64ACLH   FTMRH      64kB        4kB     256
;   S9KEAZN64AMLC   FTMRH      64kB        4kB     256
;   S9KEAZN64AMLH   FTMRH      64kB        4kB     256
;   S9KEAZN64MLD2   FTMRH      64kB        4kB     256
;
; Flash Configuration Field:
;
;   Byte address    Width   Description
; --------------------------------------------------------------------------------
;   0x0400--0x0407    8    Backdoor Comparison Key
;   0x0408--0x040B    4    reserved
;   0x040C            1    EEPROM protection byte (FEPROT)
;   0x040D            1    Program flash protection bytes (FPROT)
;   0x040E            1    Flash security byte (FSEC)
;   0x040F            1    Flash nonvolatile option byte (FOPT)
;
;   Flash Configuration Field can be programmed using FLASH.AUTO command 
;   with /CENSORSHIP option.
;
; @Author: FLC
; @Chip: S9KEAZ*
; @Copyright: (c) 1989-2019 Lauterbach GmbH, licensed for use with TRACE32(R) only
; $Id: skea.cmm 7605 2019-11-05 16:45:28Z bschroefel $
; $Rev: 7605 $
;

  LOCAL &parameters
  ENTRY %LINE &parameters

  LOCAL &param_prepareonly &param_masserase &param_cpu
  &param_prepareonly=(STRing.SCAN(STRing.UPpeR("&parameters"),"PREPAREONLY",0)!=-1)
  &param_masserase=(STRing.SCAN(STRing.UPpeR("&parameters"),"MASSERASE",0)!=-1)
  &param_cpu=STRing.SCANAndExtract(STRing.UPpeR("&parameters"),"CPU=","")

  ; ------------------------------------------------------------------------------
  ; Setup CPU

  IF (SYStem.MODE()<5)||&param_masserase
  (
    SYStem.RESet

    IF "&param_cpu"!=""
      SYStem.CPU &param_cpu
    IF !CPUIS(*KEAZ*)
      SYStem.CPU *KEAZ*

    SYStem.CONFIG.DEBUGPORTTYPE SWD
    
    SYStem.Option ResBreak OFF
    SYStem.Option WaitReset 500us 
    
    IF &param_masserase
      GOSUB MassErase

    ON.ERROR GOSUB Unsecure
    SYStem.Up
    ON.ERROR
  )

  ; Unsecure device
  IF (Data.Long(EDBG:0x40000100)&0x04)==0x04
    GOSUB Unsecure

  ; Disable watchdog
  GOSUB DisableWatchdog

  ; ------------------------------------------------------------------------------
  ; Flash declaration

  FLASH.RESet
  GOSUB FlashDeclaration

  ; Flash script ends here if called with parameter PREPAREONLY
  IF &param_prepareonly
    ENDDO PREPAREDONE

  ; ------------------------------------------------------------------------------
  ; Flash programming example

  DIALOG.YESNO "Program flash memory?"
  LOCAL &progflash
  ENTRY &progflash
  IF &progflash 
  (
    FLASH.ReProgram.ALL /Erase
    Data.LOAD.auto *
    FLASH.ReProgram.off

    ; Reset device
    SYStem.Down
    SYStem.Up

    ; Disable watchdog
    GOSUB DisableWatchdog
  )

  ENDDO


; --------------------------------------------------------------------------------
; Disable watchdog

DisableWatchdog:  
  Data.Set VM:0x20000000++0x2F %Long 0
  Data.Assemble VMT:0x20000000 adr     r0,0x20000014
  Data.Assemble ,              ldm     r0,{r0-r4}
  Data.Assemble ,              movs    r5,0
  Data.Assemble ,              strb r5, [r0, #1]
  Data.Assemble ,              strh r1, [r0, #2]
  Data.Assemble ,              strh r2, [r0, #2]
  Data.Assemble ,              strh r3, [r0, #4]
  Data.Assemble ,              strh r4, [r0, #0]
  Data.Assemble ,              bkpt    #0x0
  Data.Set VM:0x20000014 %Long 0x40052000
  Data.Set VM:0x20000018 %Long 0x20c5
  Data.Set VM:0x2000001C %Long 0x28D9
  Data.Set VM:0x20000020 %Long 0xFFFF
  Data.Set VM:0x20000024 %Long 0x20
  Data.COPY SD:0x20000000++0x2F VM:0x20000030
  Data.COPY VM:0x20000000++0x2F SD:0x20000000
  Register.Set PC 0x20000000
  Go.direct
  WAIT !STATE.RUN()
  Data.COPY VM:0x20000030++0x2F SD:0x20000000
  RETURN


; --------------------------------------------------------------------------------
; Try to unsecure a secured device

Unsecure:
  ; Print security state information
  SYStem.Mode.Prepare
  PRINT "MDM-AP Status Register is 0x" Data.Long(EDBG:0x40000100)

  DIALOG.YESNO "Execute mass erase to unsecure chip?"
  LOCAL &masserase
  ENTRY &masserase
  IF &masserase
  (
    ON.ERROR DEFault

    ; Unsecure device
    IF (Data.Long(EDBG:0x40000104)&0x08)==0x08
    (
      Data.Set EDBG:0x40000104 %Long (Data.Long(EDBG:0x40000104)&0xFFFFFFF7)
    )
    SYStem.Down
    FLASH.UNSECUREerase
    SYStem.Mode.Prepare
    IF (Data.Long(EDBG:0x40000100)&0x04)==0x04
    (
      PRINT %ERROR "Unsecure failed, MDM-AP Status Register is 0x" Data.Long(EDBG:0x40000100)
      SYStem.Down
      ENDDO
    )
  )
  ELSE
    ENDDO

  SYStem.Up

  ; Disable watchdog
  GOSUB DisableWatchdog

  RETURN


; --------------------------------------------------------------------------------
; Try to mass erase the device

MassErase:
  ; Mass erase device by unsecure command
  SYStem.Down
  FLASH.UNSECUREerase
  SYStem.Mode.Prepare
  IF (Data.Long(EDBG:0x40000100)&0x04)==0x04
  (
    PRINT %ERROR "Mass erase failed, MDM-AP Status Register is 0x" Data.Long(EDBG:0x40000100)
    SYStem.Down
    ENDDO
  )

  RETURN


; --------------------------------------------------------------------------------
; Flash declaration depending on selected CPU 

FlashDeclaration:
  LOCAL &PFlashSize &FlashType &RAMSize

  ; Setup configuration values
  IF CPUIS("S9KEAZN8*")||CPUIS("SKEAZN8*")
  (
    &PFlashSize=0x2000
    &FlashType="FTMRE"
    &RAMSize=0x400
  )
  ELSE IF CPUIS("S9KEAZN16*")||CPUIS("SKEAZN16*")
  (
    &PFlashSize=0x4000
    &FlashType="FTMRH"
    &RAMSize=0x800
  )
  ELSE IF CPUIS("S9KEAZN32*")||CPUIS("SKEAZN32*")
  (
    &PFlashSize=0x8000
    &FlashType="FTMRH"
    &RAMSize=0x1000
  )
  ELSE IF CPUIS("S9KEAZN64*")||CPUIS("SKEAZN64*")
  (
    &PFlashSize=0x10000
    &FlashType="FTMRH"
    &RAMSize=0x1000
  )
  ELSE IF CPUIS("S9KEAZ64*")||CPUIS("SKEAZ64*")
  (
    &PFlashSize=0x10000
    &FlashType="FTMRE"
    &RAMSize=0x2000
  )
  ELSE IF CPUIS("S9KEAZ128*")||CPUIS("SKEAZ128*")
  (
    &PFlashSize=0x20000
    &FlashType="FTMRE"
    &RAMSize=0x4000
  )
  ELSE
  (
    PRINT %ERROR "FLASH size of CPU type is not supported by the script"
    ENDDO
  )

  ; Program Flash
  IF &PFlashSize>=0x2000
    FLASH.Create 1. 0x00000000--0x00001FFF 0x200 TARGET Long /KEEP 0x3FC--0x3FF /CENSORSHIP 0x400--0x40F
  IF &PFlashSize>=0x4000
    FLASH.Create 1. 0x00002000--0x00003FFF 0x200 TARGET Long
  IF &PFlashSize>=0x8000
    FLASH.Create 1. 0x00004000--0x00007FFF 0x200 TARGET Long
  IF &PFlashSize>=0x10000
    FLASH.Create 1. 0x00008000--0x0000FFFF 0x200 TARGET Long
  IF &PFlashSize>=0x20000
    FLASH.Create 1. 0x00010000--0x0001FFFF 0x200 TARGET Long

  IF "&FlashType"=="FTMRH"
  (
    FLASH.Create 2. 0x10000000--0x100000FF 0x100 TARGET Word /Info "EEPROM"
    Map.BUS8 0x10000000++0FF //Force Host to read EEProm sector bytewise

    IF &RAMSize>=0x1000
      FLASH.TARGET 0x1FFFFC00 0x20000400 0x200 ~~/demo/arm/flash/long/ftmrh.bin
    ELSE IF &RAMSize>=0x800
      FLASH.TARGET 0x1FFFFE00 0x20000380 0x100 ~~/demo/arm/flash/long/ftmrh.bin
    ELSE
    (
      PRINT %ERROR "Memory configuration preliminary not supported, please request an update"
      ENDDO
    )
  )
  ELSE IF "&FlashType"=="FTMRE"
  (
    IF &RAMSize>=0x1000
      FLASH.TARGET 0x1FFFFC00 0x20000400 0x200 ~~/demo/arm/flash/long/ftmre.bin
    ELSE IF &RAMSize>=0x400
      FLASH.TARGET 0x1FFFFF00 0x20000200  0x80 ~~/demo/arm/flash/long/ftmre.bin /STACKSIZE 0x40
    ELSE
    (
      PRINT %ERROR "Memory configuration preliminary not supported, please request an update"
      ENDDO
    )
  )
  ELSE
  (
    PRINT %ERROR "Flash type preliminary not supported, please request an update"
    ENDDO
  )

  FLASH.CLocK.AUTO

  RETURN
