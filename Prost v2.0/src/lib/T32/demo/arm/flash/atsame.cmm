; --------------------------------------------------------------------------------
; @Title: Example for flash declaration of Atmel / Microchip ATSAME* internal flash
; @Description:
;   Script arguments:
;
;    DO atsame [PREPAREONLY] [CPU=<cpu>]
;
;      PREPAREONLY only declares flash but does not execute flash programming
;
;      CPU=<cpu> selects CPU derivative <cpu>
;
;   Example:
;
;   DO ~~/demo/arm/flash/atsame CPU=ATSAME70Q21 PREPAREONLY
;   Note:
;     This file must NOT be modified.
;     This file is intended to stay within TRACE32 installation.
;     Usage examples are available in the ~~/demo/arm/hardware/... subdirectories.
;
;   List of ATSAME* derivatives and their configuration:
;
;     CPU-Type        Flash size   Sector size   SRAM size
;                        [KB]            [KB]     [KB]
;     ATSAME5xx18         256               8      256
;     ATSAME5xx19         512               8      256
;     ATSAME5xx20        1024               8      256
;     ATSAME70Q21        2048         8/8/128      384	
;     ATSAME70Q20        1024                      384
;     ATSAME70Q19         512                      256
;     ATSAME70N21        2048                      384
;     ATSAME70N20        1024                      384
;     ATSAME70N19         512                      256
;     ATSAME70J21        2048                      384
;     ATSAME70J20        1024                      384
;     ATSAME70J19         512                      256
;
; @Author: FLC
; @Chip: ATSAME7*
; @Copyright: (C) 1989-2019 Lauterbach GmbH, licensed for use with TRACE32(R) only
; --------------------------------------------------------------------------------
; $Rev: 7577 $
; $Id: atsame.cmm 7577 2019-10-30 15:30:31Z bschroefel $


LOCAL &parameters
ENTRY %LINE &parameters

PRIVATE &param_prepareonly &param_cpu
&parameters=STRing.UPpeR("&parameters")
&param_prepareonly=(STRing.SCAN("&parameters","PREPAREONLY",0)!=-1)
&param_cpu=STRing.SCANAndExtract("&parameters","CPU=","")

IF VERSION.BUILD.BASE()<55857.
(
  PRINT %ERROR "TRACE32 software version is too old, please request an update."
  ENDDO
)

; --------------------------------------------------------------------------------
; Initialize and start the debugger

IF !SYStem.Up()
(
  SYStem.RESet

  IF "&param_cpu"!=""
    SYStem.CPU &param_cpu
  IF !CPUIS(ATSAME*)
    SYStem.CPU ATSAME*
  SYStem.MemAccess DAP
  IF CABLE.TWOWIRE()
    SYStem.CONFIG DEBUGPORTTYPE SWD
  ELSE
    SYStem.CONFIG DEBUGPORTTYPE JTAG
  SYStem.Up

  GOSUB DisableWatchdog
)

; ------------------------------------------------------------------------------
; Flash declaration

FLASH.RESet
GOSUB FlashDeclaration

; Flash script ends here if called with parameter PREPAREONLY
IF &param_prepareonly
  ENDDO PREPAREDONE

; -------------------------------------------------------------------------------
; Flash programming example

DIALOG.YESNO "Program flash memory?"
PRIVATE &progflash
ENTRY &progflash
IF &progflash
(
  FLASH.ReProgram ALL /Erase
  Data.LOAD.auto *
  FLASH.ReProgram.off

  IF CPUIS("ATSAME7*")
  (
    ; after factory programming the NVM should be set to FLASH
    IF ((Data.Long(AD:0xE000EF90)&0x1)==0x0)&&(Data.Quad(AD:0x0)!=Data.Quad(A:0x00400000))
      DO ~~/demo/arm/flash/atsame-nvm BOOT=FLASH
  )

  ; Reset device
  SYStem.Down
  SYStem.Up
)

ENDDO

; --------------------------------------------------------------------------------
; SUBROUTINES

; --------------------------------------------------------------------------------
; Flash declaration depending on selected CPU
;
;   Please do NOT modify the TRACE32 flash declaration.
;
;   Modifications can result in unpredictable behavior.
;   Please contact support@lauterbach.com for any changes.
FlashDeclaration: 
(
  PRIVATE &FlashSize &FlashDriver

  
  IF CPUIS("ATSAME5??18*")
  (
    &FlashSize=0x40000
    &FlashDriver="atsame.bin"
  )
  ELSE IF CPUIS("ATSAME5??19*")
  (
    &FlashSize=0x80000
    &FlashDriver="atsame.bin"
  )
  ELSE IF CPUIS("ATSAME5??20*")
  (
    &FlashSize=0x100000
    &FlashDriver="atsame.bin"
  )
  ELSE IF CPUIS("ATSAME70?19*")
  (
    &FlashSize=0x80000
    &FlashDriver="atsamv.bin"
  )
  ELSE IF CPUIS("ATSAME70?20*")
  (
    &FlashSize=0x100000
    &FlashDriver="atsamv.bin"
  )
  ELSE IF CPUIS("ATSAME70?21*")
  (
    &FlashSize=0x200000
    &FlashDriver="atsamv.bin"
  )
 ELSE
  (
    PRINT %ERROR "FLASH size of CPU type is unknown"
    ENDDO
  )

  IF CPUIS("ATSAME7*")
  (
    IF &FlashSize>=0x80000
    (
      FLASH.Create  1. 0x00400000--0x00401FFF 0x2000 TARGET Long
      FLASH.Create  2. 0x00402000--0x00403FFF 0x2000 TARGET Long
      FLASH.Create  3. 0x00404000--0x0041FFFF 0x2000 TARGET Long
      FLASH.Create  4. 0x00420000--0x0043FFFF 0x2000 TARGET Long
      FLASH.Create  5. 0x00440000--0x0045FFFF 0x2000 TARGET Long
      FLASH.Create  6. 0x00460000--0x0047FFFF 0x2000 TARGET Long
    )
    IF &FlashSize>=0x100000
    (
      FLASH.Create  7. 0x00480000--0x0049FFFF 0x2000 TARGET Long
      FLASH.Create  8. 0x004A0000--0x004BFFFF 0x2000 TARGET Long
      FLASH.Create  9. 0x004C0000--0x004DFFFF 0x2000 TARGET Long
      FLASH.Create 10. 0x004E0000--0x004FFFFF 0x2000 TARGET Long
    )
    IF &FlashSize>=0x200000
    (
      FLASH.Create 11. 0x00500000--0x0051FFFF 0x2000 TARGET Long
      FLASH.Create 12. 0x00520000--0x0053FFFF 0x2000 TARGET Long
      FLASH.Create 13. 0x00540000--0x0055FFFF 0x2000 TARGET Long
      FLASH.Create 14. 0x00560000--0x0057FFFF 0x2000 TARGET Long
      FLASH.Create 15. 0x00580000--0x0059FFFF 0x2000 TARGET Long
      FLASH.Create 16. 0x005A0000--0x005BFFFF 0x2000 TARGET Long
      FLASH.Create 17. 0x005C0000--0x005DFFFF 0x2000 TARGET Long
      FLASH.Create 18. 0x005E0000--0x005FFFFF 0x2000 TARGET Long
    )
  )
  ELSE
  (
    FLASH.Create  1. 0x00000000--(&FlashSize-1.) 0x2000 TARGET Long
  )	

  IF CPUIS("ATSAME7*")
  (
    FLASH.TARGET  0x20400000 0x20402000 0x2000 ~~/demo/arm/flash/long/&FlashDriver
  )
  ELSE
  (
    FLASH.TARGET  0x20000000 0x20002000 0x2000 ~~/demo/arm/flash/long/&FlashDriver
  )
  RETURN
)


; --------------------------------------------------------------------------------
; Disable onchip Watchdog
DisableWatchdog:
(
  IF CPUIS("ATSAME7*")
  (
    Data.Set C:0x400E1854 Data.Long(C:0x400E1854)|0x8000
  )
  RETURN
)
  