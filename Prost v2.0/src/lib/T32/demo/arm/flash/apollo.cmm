; --------------------------------------------------------------------------------
; @Title: Example for flash declaration of Ambiq Apollo internal flash
; @Description:
;   Script arguments:
;
;    DO apollo [PREPAREONLY] [CPU=<cpu>]
;
;      PREPAREONLY only declares flash but does not execute flash programming
;
;      CPU=<cpu> selects CPU derivative <cpu>
;
;   Example:
;
;   DO ~~/demo/arm/flash/apollo CPU=APOLLO512 PREPAREONLY
;
;   List of APOLLO* derivatives and their configuration:
;
;     CPU-Type        Flash size      SRAM size
;                       [Byte]         [Byte]
;     APOLLO256        0x40000         0x08000
;     APOLLO256        0x80000         0x10000
;
; @Author: AME
; @Chip: APOLLO*
; @Copyright: (C) 1989-2019 Lauterbach GmbH, licensed for use with TRACE32(R) only
; --------------------------------------------------------------------------------
; $Rev: 7577 $
; $Id: apollo.cmm 7577 2019-10-30 15:30:31Z bschroefel $


LOCAL &parameters
ENTRY %LINE &parameters

LOCAL &param_prepareonly &param_cpu
&param_prepareonly=(STRing.SCAN(STRing.UPpeR("&parameters"),"PREPAREONLY",0)!=-1)
&param_cpu=STRing.SCANAndExtract(STRing.UPpeR("&parameters"),"CPU=","")

; ------------------------------------------------------------------------------
; Setup CPU

IF !SYStem.Up()
(
  SYStem.RESet

  IF "&param_cpu"!=""
    SYStem.CPU &param_cpu
  IF !CPUIS(APOLLO*)
    SYStem.CPU APOLLO*
  SYStem.CONFIG.DEBUGPORTTYPE SWD
  SYStem.JtagClock 5MHz
  SYStem.Up
)

; ------------------------------------------------------------------------------
; Flash declaration

FLASH.RESet
GOSUB FlashDeclaration

; Flash script ends here if called with parameter PREPAREONLY
IF &param_prepareonly
  ENDDO PREPAREDONE

; -------------------------------------------------------------------------------
; Flash programming example

DIALOG.YESNO "Program flash memory?"
LOCAL &progflash
ENTRY &progflash
IF &progflash
(
  FLASH.ReProgram.ALL
  Data.LOAD.auto *
  FLASH.ReProgram.off

  ; Reset device
  SYStem.Down
  SYStem.Up
)

ENDDO


; --------------------------------------------------------------------------------
; Flash declaration depending on selected CPU

FlashDeclaration:
(
  PRIVATE &FlashSize &FlashDriver

  IF CPUIS("APOLLO256")
  (
    &FlashSize=0x40000
    &FlashDriver="apollo1.bin"
  )
  ELSE IF CPUIS("APOLLO512")
  (
    &FlashSize=0x80000
    &FlashDriver="apollo1.bin"
  )
  ELSE
  (
    PRINT %ERROR "FLASH size of CPU type is unknown"
    ENDDO
  )

  FLASH.Create  1. 0x00000000--(&FlashSize-1.) 0x800 TARGET Long

  FLASH.TARGET 0x10000000 0x10000800 0x1000 ~~/demo/arm/flash/long/&FlashDriver

  RETURN
)