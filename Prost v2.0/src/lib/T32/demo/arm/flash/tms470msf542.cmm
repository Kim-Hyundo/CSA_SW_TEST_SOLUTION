; --------------------------------------------------------------------------------
; @Title: TMS470MSF542 internal flash setup
;
; @Description: 
; Script arguments:
;
;   DO tms470msf542 [PREPAREONLY] 
;
;     PREPAREONLY only declares flash but does not execute flash programming
;
; Example:
;
;   DO ~~/demo/arm/flash/tms470msf542 PREPAREONLY
;
; @Author: WRD
; @Copyright: (C) 1989-2019 Lauterbach GmbH, licensed for use with TRACE32(R) only
; @Chip: TMS470MSF542
; --------------------------------------------------------------------------------
; $Rev: 7602 $
; $Id: tms470msf542.cmm 7602 2019-11-05 15:02:25Z bschroefel $

LOCAL &parameters
ENTRY %LINE &parameters

DO ~~~~/tms470msf541 TMS470MSF542 &parameters

ENDDO