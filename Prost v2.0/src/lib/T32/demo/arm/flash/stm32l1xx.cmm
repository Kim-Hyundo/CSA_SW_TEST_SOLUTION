; --------------------------------------------------------------------------------
; @Title: Script for programming of ST STM32L1xx internal flash
;
; @Description: 
; Script arguments:
;
;  do stm32l1xx [PREPAREONLY] [CPU=<cpu>]
;
;   PREPAREONLY only declares flash but does not execute flash programming example
;
;   CPU=<cpu> selects CPU derivative <cpu>
;
; List of STM32L1xx derivatives and their configuration:
;
;   CPU-Type      Flash size   EEPROM size   SRAM size   Cat.x
;                   (kByte)      (kByte)      (kByte)
; --------------------------------------------------------------------------------
;   STM32L15xx6       32.           4.          10.        1
;     STM32L151C6
;     STM32L152C6
;     STM32L152R6
;     STM32L151R6
;   STM32L15xx6-A     32.           4.          16.        2
;     STM32L151C6-A
;     STM32L152C6-A
;     STM32L151R6-A
;     STM32L152R6-A
;   STM32L15xx8       64.           4.          10.        1
;     STM32L152C8
;     STM32L151C8
;     STM32L151R8
;     STM32L152R8
;     STM32L151V8
;     STM32L152V8
;   STM32L15xx8-A     64.           4.          32.        2
;     STM32L152C8-A
;     STM32L151C8-A
;     STM32L151R8-A
;     STM32L152R8-A
;     STM32L151V8-A
;     STM32L152V8-A
;   STM32L15xxB      128.           4.          16.        1
;     STM32L151CB
;     STM32L152CB
;     STM32L151RB
;     STM32L152RB
;     STM32L151VB
;     STM32L152VB
;   STM32L15xxB-A      128.           4.          32.      2
;     STM32L151CB-A
;     STM32L152CB-A
;     STM32L151RB-A
;     STM32L152RB-A
;     STM32L151VB-A
;     STM32L152VB-A
;   STM32L15xUC      256.           8.          32.        3
;     STM32L151UC
;     STM32L152UC
;   STM32L15xCC      256.           8.          32.        3
;     STM32L151CC
;     STM32L152CC
;   STM32L1xxRC      256.           8.          32.        3
;     STM32L151RC
;     STM32L152RC
;     STM32L162RC
;   STM32L15xVC      256.           8.          32.        3
;     STM32L151VC
;     STM32L152VC
;     STM32L162VC
;   STM32L1xxQC      256.           8.          32.        3
;     STM32L151QC
;     STM32L152QC
;     STM32L162QC
;   STM32L15xZC      256.           8.          32.        3
;     STM32L151ZC
;     STM32L152ZC
;     STM32L162ZC
;   STM32L1xxRCxA    256.           8.          32.        3
;     STM32L151RC-A
;     STM32L152RC-A
;     STM32L162RC-A
;   STM32L1xxVCxA    256.           8.          32.        3
;     STM32L151VC-A
;     STM32L152VC-A
;     STM32L162VC-A
;   STM32L1xxRD        384.          12.          48.      4
;     STM32L151RD
;     STM32L152RD
;     STM32L162RD
;   STM32L1xxVD        384.          12.          48.      4
;     STM32L151VD
;     STM32L152VD
;     STM32L162VD
;   STM32L1xxQD        384.          12.          48.      4
;     STM32L151QD
;     STM32L152QD
;     STM32L162QD
;   STM32L1xxZD        384.          12.          48.      4
;     STM32L151ZD
;     STM32L152ZD
;     STM32L162ZD
;   STM32L1xxVD-X      384.          12.          80.      6
;     STM32L151VD-X
;     STM32L152VD-X
;     STM32L162VD-X
;   STM32L15xxE        512.          16.          80.      5
;     STM32L151RE
;     STM32L152RE
;     STM32L151VE
;     STM32L152VE
;     STM32L151QE
;     STM32L152QE
;     STM32L151ZE
;     STM32L152ZE
; ------------------------------------------------------- -------------------------
;
; Flash base address is 0x08000000
; SRAM base address is  0x20000000
;
; @Author: WRD
; @Copyright: (C) 1989-2019 Lauterbach GmbH, licensed for use with TRACE32(R) only
; @Chip: STM32L1*
; --------------------------------------------------------------------------------
; $Rev: 7602 $
; $Id: stm32l1xx.cmm 7602 2019-11-05 15:02:25Z bschroefel $

PRIVATE  &parameters
ENTRY %LINE &parameters

PRIVATE  &param_prepareonly
&param_prepareonly=(STRing.SCAN(STRing.UPpeR("&parameters"),"PREPAREONLY",0)!=-1)

PRIVATE  &param_cpu
&param_cpu=STRing.SCANAndExtract(STRing.UPpeR("&parameters"),"CPU=","")

PRIVATE &param_dualport
&param_dualport=STRing.SCANAndExtract(STRing.UPpeR("&parameters"),"DUALPORT=","1")

; ------------------------------------------------------------------------------
; CPU setup

IF SYStem.MODE()<5
(
  SYStem.RESet
  IF "&param_cpu"!=""
    SYStem.CPU &param_cpu
  IF !CPUIS(STM32L1*)
    SYStem.CPU STM32L1*
  SYStem.Up
)

; ------------------------------------------------------------------------------
; Flash declaration

FLASH.RESet

PRIVATE  &FlashSize &EEPROMSize
GOSUB FlashDeclaration &param_dualport

ENTRY &FlashSize &EEPROMSize

; Flash script ends here if called with parameter PREPAREONLY
IF &param_prepareonly
  ENDDO PREPAREDONE

; ------------------------------------------------------------------------------
; Flash programming example

DIALOG.YESNO "Program flash memory?"
PRIVATE  &progflash
ENTRY &progflash

IF &progflash 
(
  FLASH.ReProgram 0x08000000++(&FlashSize-1) /Erase
  Data.LOAD.auto *
  FLASH.ReProgram off

  ; Reset device
  SYStem.Down
  SYStem.Up
)

DIALOG.YESNO "Program data EEPROM memory?"
ENTRY &progflash

IF &progflash 
(
  ; EEPROM memory can be reprogrammed without erase command 
  FLASH.Program 0x08080000++(&EEPROMSize-1)
  Data.dump 0x08080000++(&EEPROMSize-1)
  Data.Set
)

ENDDO


; --------------------------------------------------------------------------------
; Flash declaration depending on selected CPU 

FlashDeclaration:
(
  PRIVATE  &FlashSize &EEPROMSize &DualPort
  ENTRY &DualPort
  
IF CPUIS("STM32L1???6*")
  (
    &FlashSize=0x8000
    &EEPROMSize=0x1000
  )
  ELSE IF CPUIS("STM32L1???8*")
  (
    &FlashSize=0x10000
    &EEPROMSize=0x1000
  )
  ELSE IF CPUIS("STM32L1???B*")
  (
    &FlashSize=0x20000
    &EEPROMSize=0x1000
  )
  ELSE IF CPUIS("STM32L1???C*")
  (
    &FlashSize=0x40000
    &EEPROMSize=0x2000
  )
  ELSE IF CPUIS("STM32L1???D*")
  (
    &FlashSize=0x60000
    &EEPROMSize=0x3000
  )
  ELSE IF CPUIS("STM32L1???E*")
  (
    &FlashSize=0x80000
    &EEPROMSize=0x4000
  )
  ELSE IF CPUIS("STM32L1??VD-X")
  (
    &FlashSize=0x60000
    &EEPROMSize=0x3000
  )
  ELSE
  (
    PRINT %ERROR "FLASH size of CPU type is unknown"
    ENDDO
  )
  
  ; Program memory flash
  IF &FlashSize>=0x8000
    FLASH.Create 1. 0x08000000--0x08007FFF  0x100 TARGET Long
  IF &FlashSize>=0x10000
    FLASH.Create 1. 0x08008000--0x0800FFFF  0x100 TARGET Long
  IF &FlashSize>=0x20000
    FLASH.Create 1. 0x08010000--0x0801FFFF  0x100 TARGET Long
  IF &FlashSize>=0x40000
    FLASH.Create 1. 0x08020000--0x0803FFFF  0x100 TARGET Long
  IF &FlashSize>=0x60000
    FLASH.Create 2. 0x08040000--0x0805FFFF  0x100 TARGET Long
  IF &FlashSize>=0x80000
    FLASH.Create 2. 0x08060000--0x0807FFFF  0x100 TARGET Long
  
  
  ; Data/EEPROM memory
  IF &EEPROMSize>=0x1000
    FLASH.Create 3. 0x08080000--0x08080FFF TARGET Byte
  IF &EEPROMSize>=0x2000
    FLASH.Create 3. 0x08081000--0x08081FFF TARGET Byte
  IF &EEPROMSize>=0x3000
    FLASH.Create 4. 0x08082000--0x08082FFF TARGET Byte
  IF &EEPROMSize>=0x4000
    FLASH.Create 4. 0x08083000--0x08083FFF TARGET Byte
  
  
  ; For Main Flash memory boot mode flash memory is aliased to address 0x0
  ; Because SYSCFG_MEMRMP:MEM_MODE[1:0] is not indicating active memory remap
  ; we are comparing flash reset vector against reset vector at alias address
  ; Changed on 5.7.2018 : MEN_MODE should represent real boot memory (target:STM32L152VB)
;  Data.ComPare 0x0--0x7 0x08000000
;  IF !FOUND()
  IF ((Data.Long(D:0x40010000)&0x3)==0x0)
    FLASH.CreateALIAS 0x00000000++(&FlashSize-1) 0x08000000
  
  IF "&DualPort"=="0"
  (
    IF &FlashSize>=0x60000
      FLASH.TARGET 0x20000000 0x20001000 0x400 ~~/demo/arm/flash/byte/stm32l100hd.bin
    ELSE IF &FlashSize>=0x40000
      FLASH.TARGET 0x20000000 0x20001000 0x400 ~~/demo/arm/flash/byte/stm32l100mdp.bin
    ELSE
      FLASH.TARGET 0x20000000 0x20001000 0x400 ~~/demo/arm/flash/byte/stm32l100md.bin
  )
  ELSE
  (
    IF &FlashSize>=0x60000
      FLASH.TARGET 0x20000000 EAHB:0x20001000 0x400 ~~/demo/arm/flash/byte/stm32l100hd.bin /DualPort
    ELSE IF &FlashSize>=0x40000
      FLASH.TARGET 0x20000000 EAHB:0x20001000 0x400 ~~/demo/arm/flash/byte/stm32l100mdp.bin /DualPort
    ELSE
      FLASH.TARGET 0x20000000 EAHB:0x20001000 0x400 ~~/demo/arm/flash/byte/stm32l100md.bin /DualPort
  )
  
  RETURN &FlashSize &EEPROMSize
)