; --------------------------------------------------------------------------------
; @Title: Example for flash declaration of Texas Instruments CC13xx internal flash
; @Description:
;   Script arguments:
;
;    DO cc1300 [PREPAREONLY] [CPU=<cpu>]
;
;      PREPAREONLY only declares flash but does not execute flash programming
;
;      CPU=<cpu> selects CPU derivative <cpu>
;
;   Example:
;
;   DO ~~/demo/arm/flash/cc1300 CPU=CC1310F128 PREPAREONLY
;
;   List of CC13xx derivatives and their configuration:
;
;     CPU-Type        Flash size   Page size
;                       [Byte]      [Byte]
;     CC1310F32        0x20000      0x1000
;     CC1310F64        0x20000      0x1000
;     CC1310F128       0x20000      0x1000
;
; @Author: FLC
; @Chip: CC1310F*
; @Copyright: (C) 1989-2019 Lauterbach GmbH, licensed for use with TRACE32(R) only
; --------------------------------------------------------------------------------
; $Rev: 7577 $
; $Id: cc1300.cmm 7577 2019-10-30 15:30:31Z bschroefel $


  LOCAL &parameters
  ENTRY %LINE &parameters

  LOCAL &param_prepareonly &param_cpu
  &param_prepareonly=(STRing.SCAN(STRing.UPpeR("&parameters"),"PREPAREONLY",0)!=-1)
  &param_cpu=STRing.SCANAndExtract(STRing.UPpeR("&parameters"),"CPU=","")

  ; ------------------------------------------------------------------------------
  ; Setup CPU

  IF SYStem.MODE()<5
  (
    SYStem.RESet

    IF "&param_cpu"!=""
      SYStem.CPU &param_cpu
    IF !CPUIS(CC13*)
      SYStem.CPU CC13*

    SYStem.CONFIG DEBUGPORTTYPE CJTAG
    SYStem.Option ResBreak OFF
    SYStem.JtagClock CTCK 1MHz
    SYStem.Mode.Attach
  )

  ; ------------------------------------------------------------------------------
  ; Flash declaration

  FLASH.RESet
  GOSUB FlashDeclaration

  ; Flash script ends here if called with parameter PREPAREONLY
  IF &param_prepareonly
    ENDDO PREPAREDONE

 ; -------------------------------------------------------------------------------
  ; Flash programming example

  DIALOG.YESNO "Program flash memory?"
  LOCAL &progflash
  ENTRY &progflash
  IF &progflash
  (
    FLASH.ReProgram.ALL
    Data.LOAD.auto *
    FLASH.ReProgram.off

    ; Reset device
    SYStem.Down
    SYStem.Up
  )

  ENDDO


; --------------------------------------------------------------------------------
; Flash declaration depending on selected CPU

FlashDeclaration:
  LOCAL &FlashSize &FlashDriver

  IF CPUIS("CC1310F32")
  (
    &FlashSize=0x20000
    &FlashDriver="cc2600.bin"
  )
  ELSE IF CPUIS("CC1310F64")
  (
    &FlashSize=0x20000
    &FlashDriver="cc2600.bin"
  )
  ELSE IF CPUIS("CC1310F128")
  (
    &FlashSize=0x20000
    &FlashDriver="cc2600.bin"
  )
  ELSE
  (
    PRINT %ERROR "FLASH size of CPU type is unknown"
    ENDDO
  )

  IF &FlashSize>=0x20000
    FLASH.Create  1. 0x00000000--0x0001FFFF 0x1000 TARGET Long


  FLASH.TARGET 0x20000000 0x20000800 0x800 ~~/demo/arm/flash/long/&FlashDriver

  RETURN
