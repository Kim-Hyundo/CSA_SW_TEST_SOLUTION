; --------------------------------------------------------------------------------
; @Title: TMS470 internal flash of TMS470AVF689A
;
; @Description:
; Script arguments:
;
;   DO tms470avf689a [PREPAREONLY]
;
;     PREPAREONLY only declares flash but does not execute flash programming
;
; Example:
;
;   DO ~~/demo/arm/flash/tms470avf689a PREPAREONLY
;
; @Author: WRD
; @Copyright: (C) 1989-2019 Lauterbach GmbH, licensed for use with TRACE32(R) only
; --------------------------------------------------------------------------------
; $Rev: 7602 $
; $Id: tms470avf689a.cmm 7602 2019-11-05 15:02:25Z bschroefel $

LOCAL &parameters
ENTRY %LINE &parameters

DO ~~~~/tms470r1vf689 TMS470AVF689A &parameters

ENDDO
