; --------------------------------------------------------------------------------
; @Title: STM Demo Script for the STM32F103
; @Description: -
; @Keywords: sieve, STM
; @Chip: STM32F103ZE
; @Board: STM32F103 EVB
; @Author: ING
; @Copyright: (C) 1989-2019 Lauterbach GmbH, licensed for use with TRACE32(R) only
; --------------------------------------------------------------------------------
; $Id: setup.cmm 15223 2019-11-05 16:29:45Z bschroefel $


; bring up board, load application etc.
  Break.Delete
  SYStem.CPU STM32F103ZE
  ITM.RESet

  ChDir ../pipeproto
  DO common
  ChDir ../sieve

  CAnalyzer.Mode FIFO
  CAnalyzer.Init

  Data.LOAD.Elf sieve.elf

; Now start application
  Go.direct main
  WAIT !STATE.RUN()
  WinCLEAR
  WinPOS 0% 0%
  List.auto
  WinPOS 61% 0% 
  CAnalyzer.List

; Sample PC via ITM
  ITM.PCSampler 1/512
; Trace "gCount" Variable via ITM
  Break.Set gCount /Onchip /Write /TraceData
