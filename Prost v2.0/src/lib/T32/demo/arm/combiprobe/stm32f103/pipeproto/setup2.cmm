; --------------------------------------------------------------------------------
; @Title: PIPE Demo setup script for STM32F103
; @Description: PIPE Demo setup script.
; @Keywords: PIPE, PROTO
; @Chip: STM32F103ZE
; @Board: STM32F103 EVB
; @Author: ING
; @Copyright: (C) 1989-2019 Lauterbach GmbH, licensed for use with TRACE32(R) only
; --------------------------------------------------------------------------------
; $Id: setup2.cmm 15209 2019-11-04 10:07:55Z bschroefel $


; bring up board, load application etc.
  DO common

; set timer rate
; for SWV with 32Mbps, ca 1MB/s
  Var.set timerReload = 1399.

; Start two applications which will
; receive data via named pipes
; from two DLL instances

  &pproto="pproto"

  IF (OS.VERSION(0)>=0x10)||(OS.VERSION(0)==0x0)
  (
    PRINT "Demo unsupported for this OS"
    ENDDO
  )
  ELSE
  (
    IF SOFTWARE.64BIT()
      &pproto="pproto64.dll"
    ELSE
      &pproto="pproto32.dll"
  )

  OS.screen ./pread2.exe 0
  OS.screen ./pread2.exe 1
  WAIT 2.s

; Configure DLLs as trace sinks
; pass command arguments to specify selected
; channels

  SystemTrace.PipePROTO dll/"&pproto" pproto00 0 15
  SystemTrace.PipePROTO dll/"&pproto" pproto01 16 31

; Start to receive data
  SystemTrace.Arm

; Now start application
