; --------------------------------------------------------------------------------
; @Title: TRACE32 Compatible Semihosting via Memory Interface 'BUFFERE' for Cortex-M
; @Description: 
;   There is no DCC channel available on Cortex-M, but memory can be accessed
;   during runtime by the debugger. The example assumes RAM at address 0.
; @Author: PEG
; @Chip: Cortex-M?
; @Copyright: (C) 1989-2019 Lauterbach GmbH, licensed for use with TRACE32(R) only
; --------------------------------------------------------------------------------
; $Id: t32term_cortexm.cmm 15223 2019-11-05 16:29:45Z bschroefel $


; After executing this script you need to run the loaded example program (-> 'Go').
; It outputs 'Hello World!' in the TERM.GATE window and offers you a menu to 
; 'r' read and type an ascii file named test1 which needs to be in the current 
; directory.
; 'w' write the text 'Hello World!' in an ascii file named test2 in the current 
; directory.
; 'p' print 32 times the line 'Performance Test Text'.

; For further functions of the TRACE32 compatible semihosting see t32term.c.
; See the target manual of the arm debugger (debugger_arm.pdf) for more details 
; about 'semihosting'.

; The debugger is expected to be in 'UP' state, therefore a target specific 
; start-up script .probably similar to the following one for the simulator 
; will be needed to run first.


; start-up in case of simulator
  if INTERFACE.SIM()
  (
    RESet
    SYStem.CPU CORTEXM3
    SYStem.Up
  )

; load demo application
  Data.LOAD.Elf ~~~~/t32term_cortexm.axf /Verify

; configure and open semihosting channel
  TERM.METHOD BUFFERE e:OutBuffer e:InBuffer
  TERM.Mode ascii

; open some windows
  WinCLEAR
  WinPOS 0% 0% 100% 48%
  List.auto
  WinPOS 0% 50% 50% 48%
  Frame /Locals /Caller
  WinPOS 50% 50% 50% 48%
  TERM.GATE

  ENDDO




