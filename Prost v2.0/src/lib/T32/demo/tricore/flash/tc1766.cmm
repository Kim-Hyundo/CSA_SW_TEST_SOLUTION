; --------------------------------------------------------------------------------
; @Title: Generic Flash script file for TC1766 devices
; @Description:
;   Example script for flash declaration and programming of Infineon
;   TriCore TC1766 internal flash.
; @Keywords: Flash, Infineon, TriCore
; @Author: WRD
; @Chip: TC1766*
; @Copyright: (C) 1989-2014 Lauterbach GmbH, licensed for use with TRACE32(R) only
; --------------------------------------------------------------------------------
; $Rev: 3256 $
; $Id: tc1766.cmm 3256 2015-04-16 07:19:01Z mobermeir $


; Script arguments:
;
;   DO tc1766 [PREPAREONLY]
;
;     PREPAREONLY only declares flash but does not execute flash programming
;
; Example:
;
;   DO ~~/demo/tricore/flash/tc1766 PREPAREONLY
;
; Flash:
;   1504 kByte onchip program flash at 0x80000000--0x80177fff (cached)
;                                   or 0xa0000000--0xa0177fff (non cached)
;     Sectors (logical):  8 x 16kB, 1 x 128kB, 1 x 256kB, 1 x 512kB, 1 x 480kB
;     Sectors (physical): 2 x 128kB, 1 x 256kB, 1 x 512kB, 1 x 480kB
;
;   32 kByte onchip data flash at 0x8fe00000--0x8fe03fff (cached)
;                             and 0x8fe10000--0x8fe13fff (cached)
;                              or 0xafe00000--0xafe03fff (non cached)
;                             and 0xafe10000--0xafe13fff (non cached)
;     Sectors: 2 x 16kB
;
; RAM:
;   56 kByte DMI Scratch-Pad RAM at 0xd0000000--0xd000dfff for data
;   16 kByte PMI Scratch-Pad RAM at 0xd4000000--0xd4003fff for flash algorithm
;
; NOTES:
;   This script version is considering TC1766 EES-AC and EES-BA Errata
;   regarding address restriction of program flash, last 32kByte of
;   program flash are not programmable.
;

  LOCAL &parameters &param_prepareonly
  ENTRY %LINE &parameters
  &param_prepareonly=(STRing.SCAN(STRing.UPpeR("&parameters"),"PREPAREONLY",0)!=-1)

  ; ------------------------------------------------------------------------------
  ; Initialize

  IF SYStem.MODE()<5.
  (
    SYStem.RESet
    SYStem.CPU TC1766
    SYStem.Up
  )

  Data.Set 0xF0000024 %Long 0x00000008    ; disable watchdog for programming

  ; ------------------------------------------------------------------------------
  ; Check chip ID and RT ID for size of last sector
  ;
  PRIVATE &chipid &rtid &sectorsize
  &chipid=Data.Long(D:0xf0000074)
  &rtid=Data.Long(D:0xf0000078)
  &sectorsize=0x78000
  IF &chipid<0x00008b02||(&chipid==0x00008b02&&(&rtid==0x00000000))
  (
    ; TC1766 revision Ax and BA chips do not support last 32kByte of last sector
    &sectorsize=0x70000
  )

  ; ------------------------------------------------------------------------------
  ; Flash Declaration
  FLASH.RESet
  ; Program flash
  FLASH.Create 1. 0xa0000000--0xa001ffff 0x04000 TARGET Long
  FLASH.Create 2. 0xa0020000--0xa003ffff 0x20000 TARGET Long
  FLASH.Create 2. 0xa0040000--0xa007ffff 0x40000 TARGET Long
  FLASH.Create 2. 0xa0080000--0xa00fffff 0x80000 TARGET Long
  IF &sectorsize==0x78000
  (
    FLASH.Create 2. 0xa0100000--0xa0177fff 0x78000 TARGET Long
  )
  ELSE
  (
    FLASH.Create 2. 0xa0100000--0xa016ffff 0x70000 TARGET Long
    FLASH.Create 2. 0xa0170000--0xa0177fff 0x08000 NOP    Long
  )
  ; Data flash
  FLASH.Create 3. 0xafe00000--0xafe03fff 0x04000 TARGET Long
  FLASH.Create 4. 0xafe10000--0xafe13fff 0x04000 TARGET Long
  FLASH.TARGET 0xd4000000 0xd0000000 0x1000 ~~/demo/tricore/flash/long/tc1796.bin
  FLASH.CreateALIAS 0x80000000--0x8fffffff 0xa0000000

  ; Flash script ends here if called with parameter PREPAREONLY
  IF &param_prepareonly
    ENDDO PREPAREDONE

  ; ------------------------------------------------------------------------------
  ; Example for download
  ;
  ; FLASH.ReProgram or FLASH.AUTO is required for flash programming of unsorted
  ; files. Each write page can only be written once after it was erased.

  DIALOG.YESNO "Program flash memory?"
  LOCAL &progflash
  ENTRY &progflash
  IF &progflash
  (
    FLASH.ReProgram ALL /Erase
    Data.LOAD.auto *
    FLASH.ReProgram.off
  )

  ENDDO
