; --------------------------------------------------------------------------------
; @Title: Erika3 demo for TC39x emulation devices
; @Description:
;  Setup and run Erika3 on 3 cores of a TC39x device.
;  The demo uses MCDS trace to show TASK switches trace and CPU load, thus
;  an emulation device is required
; @Keywords: AURIX2G, AUTOSAR, flash, Infineon, TriCore
; @Author: HDA
; @Chip: TC39*
; @Copyright: (C) 1989-2020 Lauterbach GmbH, licensed for use with TRACE32(R) only
; --------------------------------------------------------------------------------
; $Id: start_erika3_tc39x.cmm 16280 2020-07-07 13:12:52Z hdammak $

LOCAL &cpu &elfFile

; --------------------------------------------------------------------------------
; system startup
RESet
AREA.CLEAR
SYStem.Down
; detect the target CPU
SYStem.DETECT CPU

&cpu=CPU()
; check if the CPU is valid for this demo
IF !CPUIS(TC39*)
(
  PRINT %ERROR "This demo is not suitable for &cpu"
  ENDDO
)

; this demo is only using 3 cores
CORE.ASSIGN 1. 2. 3.
SYStem.Up

; --------------------------------------------------------------------------------
; flash programming
&elfFile="~~~~/tc39x/out/erika3app.elf"
GOSUB ProgramFlash

; --------------------------------------------------------------------------------
; reset the target
SYStem.RESetOut

GOSUB OptionalSettings

; --------------------------------------------------------------------------------
; load the debug symbols
Data.LOAD.Elf &elfFile /NoCODE /SingleLineAdjacent /StripPART "erika3" /SOURCEPATH "~~~~/"

; --------------------------------------------------------------------------------
; load the ORTI file
TASK.ORTI ~~~~/tc39x/out/system.orti

; execute the target startup code
Go.direct StartOS /Onchip
WAIT !STATE.RUN() 1.s


; --------------------------------------------------------------------------------
; configure tracing of the task switches

IF !Analyzer()
  Trace.METHOD Onchip
  
MCDS.RESet
MCDS.SOURCE.Set CpuMux0.Program OFF

MCDS.SOURCE.Set CpuMux2.Core TriCore0
MCDS.SOURCE.Set CpuMux1.Core TriCore1
MCDS.SOURCE.Set CpuMux0.Core TriCore2

; enable tracing task switches
Break.Set TASK.CONFIG(magic[0]) /Write /TraceData
Break.Set TASK.CONFIG(magic[1]) /Write /TraceData
Break.Set TASK.CONFIG(magic[2]) /Write /TraceData

; enable onchip time stamps
MCDS.TimeStamp ON
; enables the computation of clock frequencies
CLOCK.ON

; --------------------------------------------------------------------------------
; create Groups for CPU load measurements
GOSUB CreateGroups

; --------------------------------------------------------------------------------
; run for a while
Go.direct
SCREEN.WAIT 1.s
Break.direct

; --------------------------------------------------------------------------------
; setup demo display
Do ~~~~/display.cmm

ENDDO

; --------------------------------------------------------------------------------
; SUBROUTINES
; --------------------------------------------------------------------------------

; --------------------------------------------------------------------------------
; flash programming
ProgramFlash:

  ; flash declaration
  DO ~~/demo/tricore/flash/tc39x.cmm  CPU="&cpu" PREPAREONLY DUALPORT=1

  Data.LOAD.Elf "&elfFile" /DIFF /SingleLineAdjacent /NosYmbol

  IF FOUND()
  (
    DIALOG.YESNO "Program Lauterbach ERIKA3 demo into flash memory?"

    ; ==== Step 1: Program TriCore code ====

    ENTRY &progFlash
  
    IF (&progFlash)
    (
      ; enable flash programming
      FLASH.ReProgram ALL

      ; load demo application
      Data.LOAD.Elf "&elfFile"

      FLASH.ReProgram OFF
    )

    ; ==== Step 2: Write boot mode header ====

    PRIVATE &progUcb &ucbOrigDiff &ucbCopyDiff &supported &DMU_HF_CONFIRM0 &result
    &progUcb=FALSE()
    ; check if both UCBs are in state UNLOCKED or UNREAD. Other states are not supported by this script
    &DMU_HF_CONFIRM0=Data.Long(ED:0xF8040020)
    &supported=(((&DMU_HF_CONFIRM0)&(0x00020002))==0x00000000)
    IF !&supported
    (
      DIALOG.MESSAGE "UCB_BMHD0_ORIG or UCB_BMHD0_COPY are not in state unlocked or unread"
    )
    ; check if we need to program the BMHD
    &ucbOrigDiff=FALSE()
    &ucbCopyDiff=FALSE()
    IF &supported
    (
      Data.LOAD.Elf "&elfFile" 0xAF400000++0x1FF /DIFF /NosYmbol
      &ucbOrigDiff=FOUND()
      Data.LOAD.Elf "&elfFile" 0xAF401000++0x1FF /DIFF /NosYmbol
      &ucbCopyDiff=FOUND()
    )
    IF (&ucbOrigDiff)||(&ucbCopyDiff)
    (
      DIALOG.YESNO "Configure UCB_BMHD0_ORIG and UCB_BMHD0_COPY to start demo application?"
      ENTRY &progUcb
    )

    IF (&ucbOrigDiff)||(&ucbCopyDiff)
    (
      DIALOG.YESNO "Configure UCB_BMHD0_ORIG and UCB_BMHD0_COPY to start demo application?"
      ENTRY &progUcb
    )

    IF (&progUcb)&&(&ucbCopyDiff)
    (
      DO ~~/demo/tricore/flash/tc3xx-ucb.cmm UCB=BMHD0_COPY ACTIVATE
      
      ; load data of UCB_BMHD0_COPY
      Data.LOAD.Elf "&elfFile" 0xAF401000++0x1FF /NosYmbol

      DO ~~/demo/tricore/flash/tc3xx-ucb.cmm UCB=BMHD0_COPY PROGRAM
    )

    IF (&progUcb)&&(&ucbOrigDiff)
    (
      DO ~~/demo/tricore/flash/tc3xx-ucb.cmm UCB=BMHD0_ORIG ACTIVATE
      
      ; load data of UCB_BMHD0_ORIG
      Data.LOAD.Elf "&elfFile" 0xAF400000++0x1FF /NosYmbol

      DO ~~/demo/tricore/flash/tc3xx-ucb.cmm UCB=BMHD0_ORIG PROGRAM
    )

    ; ==== Step 3: Verify programming ====

    Data.LOAD.Elf "&elfFile" /DIFF /NosYmbol
    IF FOUND()
    (
      ; maybe some sections are still declared as NOP?
      PRIVATE &diffAddress
      &diffAddress=TRACK.ADDRESS()
      DIALOG.MESSAGE "File &elfFile has not been fully flashed, difference found at address &diffAddress (check flash declaration)"
    )

  )
  RETURN
  
; --------------------------------------------------------------------------------
; optional debugger settings
OptionalSettings:
(
  SYStem.Option DUALPORT ON
  SETUP.Var %SpotLight.on
  ; force onchip-breakpoints
  MAP.BOnchip 0x0--0xffffffff

  RETURN
)

; --------------------------------------------------------------------------------
; create groups for cpu load measurements
CreateGroups:
(
  GROUP.CreateTASK "idle" "Idle_Core0"
  GROUP.CreateTASK "idle" "Idle_Core1"
  GROUP.CreateTASK "idle" "Idle_Core2"
  GROUP.COLOR "other" RED
  GROUP.COLOR "idle" LIME
  GROUP.Merge "other"
  GROUP.Merge "idle"
  RETURN
)