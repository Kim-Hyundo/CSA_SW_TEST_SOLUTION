; --------------------------------------------------------------------------------
; @Title: FreeRTOS Demo for TRACE32 OS Awareness
; @Description: 
;   
;   This batchfile loads all necessary files to demonstrate
;   the OS Awareness for FreeRTOS.
;   
; @Keywords: awareness, RTOS, FreeRTOS
; @Author: DIE
; @Copyright: (C) 1989-2014 Lauterbach GmbH, licensed for use with TRACE32(R) only
; --------------------------------------------------------------------------------
; $Id: freertos.cmm 13125 2018-09-11 14:03:01Z rdienstbeck $

 SCREEN.ON
 WinPAGE.RESet
 WinPOS 0. 25. 70. 7. 0. 0. W000
 AREA.view

; Reset debugger
 PRINT "resetting..."
 RESet

; Initialize debugger
 PRINT "initializing..."
 SYStem.CPU TC1782
 SYStem.Up

; Load sample application
 PRINT "loading sample application..."
 Data.LOAD.Elf freertos_demo.elf

; Patch for Simulator
 IF simulator()
 (
    Data.Assemble set_cpu_frequency+0x11a nop16
    Data.Assemble set_cpu_frequency+0x138 nop16
 )
 
; Initialize RTOS support
 PRINT "initializing FreeRTOS support..."
 TASK.CONFIG ~~/demo/tricore/kernel/freertos/freertos.t32 0 0x200   ; load FreeRTOS awareness
 MENU.ReProgram ~~/demo/tricore/kernel/freertos/freertos.men        ; load FreeRTOS menu
 HELP.FILTER.Add rtosfreertos   ; add FreeRTOS awareness manual to filtered help

 PRINT "load complete."
 
; Open some windows
 WinPOS 0. 0. 70. 20.
 List.auto
 WinPOS 48. 5. 65. 20. 0. 1. W001
 TASK.TaskList

; start application
 Go prvHighFrequencyTimerTask

 ENDDO
