; --------------------------------------------------------------------------------
; @Title: TriCore 27x STM model demo
; @Description:
;   Simulation engine for the Tricore STM 27x timer
;
; @Keywords: STM, Infineon, simulator, TriCore
; @Author: DIE
; @Chip: TC275TE
; @Copyright: (C) 1989-2014 Lauterbach GmbH, licensed for use with TRACE32(R) only
; --------------------------------------------------------------------------------
; $Id: demo.cmm 16333 2020-07-23 17:18:31Z hdammak $


LOCAL &STM0_BASE &IR_SRC_STM0SR0
LOCAL &OS_Name

&STM0_BASE=D:0xF0000000
&IR_SRC_STM0SR0=D:0xF0038490
SYStem.Down

SIM.UNLOAD ; unload all modules

SYStem.CPU TC275TE-Astep

; load the simulation model
&OS_Name=OS.NAME()
IF "&OS_Name"=="Windows"
(
  IF SOFTWARE.64BIT()
  (
    SIM.LOAD ~~~~/timer_tc275_64bit.dll &STM0_BASE &IR_SRC_STM0SR0
  )
  ELSE
  (
    SIM.LOAD ~~~~/timer_tc275.dll &STM0_BASE &IR_SRC_STM0SR0
  )
)
ELSE
(
  PRINT "This demo is not supported for &OS_Name.
  ENDDO
)

SYStem.Up

; --- core registers -----
Register.Set	pc	0xA0000000
Register.Set	BIV	0xA0000100	; Interrupt Vector Table Pointer
Register.Set	FCX	0x000D0048	; Free Context List Pointer
Register.Set	LCX	0x000D000D	; Context List Limit Pointer

Register.Set	ICR	0x00008000	; global int enable

; ------ interrupt vector ------
Data.Assemble 0xA0000120 enable ;nop
Data.Assemble 0xA0000124 add d1, d1, 1		;for testing purpose
Data.Assemble 0xA0000130 rfe					;return from exception


; ------ main loop -------
Data.Assemble	0xA0000000 nop16
Data.Assemble	0xA000001e JA 0xA0000000	;abs jump


; ------ STM0 SR0 interrupt enable ------

Data.Set 0xF0038490 %Long 0x00000401 ;[SRC_STM0SR0] 
Data.Set 0xF000003C %Long 0x00000001 ;[STM0_ICR]

; ------ STM0 compare registers ------

Data.Set 0xF0000030 %Long 0x000000FF ;[STM0_CMP0]
Data.Set 0xF0000038 %Long 0x00000007 ;[STM0_CMCON]

Break.Set 0xA0000120
Go

WinPAGE.RESet

WinCLEAR

WinPOS 0. 0. 95. 24. 13. 1. W001
WinTABS 10. 10. 25. 62.
Data.List

WinPOS 0. 30. 44. 24. 0. 0. W002
Register.view /SpotLight

WinPOS 40. 30. 54. 23. 13. 1. W003
WinTABS 10. 10. 25. 62.
Data.List 0xA0000000

WinPAGE.select P000

ENDDO
