; --------------------------------------------------------------------------------
; @Title: Demo script for TC1197 on TriBoard-TC179x
; @Description:
;   Initializes the TriCore, SRAM and Flash,
;   and loads the Sieve-Demo into processor internal memory.
; @Keywords: Infineon, internal, intmem, memory, sieve, TriCore
; @Author: MEI
; @Board: TriBoard-TC179x
; @Chip: TC1197
; @Copyright: (C) 1989-2014 Lauterbach GmbH, licensed for use with TRACE32(R) only
; --------------------------------------------------------------------------------
; $Id: tc1197_demo.cmm 7578 2014-08-27 14:53:19Z mobermeir $


; --------------------------------------------------------------------------------
; Performed tests:
; Dip Switch S301: SW1=OFF, SW2=OFF, SW3=OFF, SW4=OFF,
;                   SW5=OFF, SW6=OFF, SW7=OFF, SW8=OFF
; TriBoard TC179x.400 TC1797ED AC-ES 2013-03-05 MEI

; --------------------------------------------------------------------------------
; initialize and start the debugger
RESet
SYStem.CPU TC1197

IF DAP.Available()
(
  ; Bi-Directional Debug Cable detected
  SYStem.CONFIG.DEBUGPORTTYPE DAP2    ; instead of JTAG
)
ELSE
(
  ; Uni-Directional Debug Cable
  SYStem.CONFIG.DEBUGPORTTYPE JTAG
)

SYStem.Up

; --------------------------------------------------------------------------------
; bugfixes and workarounds

; DMA_TC.013
; DMA-LMB-Master Access to Reserved Address Location
; prevent the debugger from accessing certain target memory
MAP.DenyAccess 0xC8000000++0x07FFFFFF

; --------------------------------------------------------------------------------
; load demo program
Data.LOAD.Elf "~~~~/triboard-tc1797_sieve_intmem.elf"
Go.direct main

; open some windows
WinCLEAR
WinPOS 0% 0% 100% 50%
List.auto
WinPOS 0% 50% 50% 50%
Frame.view /Locals /Caller
WinPOS 50% 50% 50% 50%
Var.Watch
Var.AddWatch ast flags

ENDDO
