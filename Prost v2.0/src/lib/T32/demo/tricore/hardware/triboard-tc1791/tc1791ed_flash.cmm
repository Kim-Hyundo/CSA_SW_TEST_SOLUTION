; --------------------------------------------------------------------------------
; @Title: Demo script for TC1791ED on TriBoard-TC1791 (Flash)
; @Description:
;   Initializes the TriCore and loads the Sieve-Demo into memory.
; @Keywords: Flash, Infineon, TriCore
; @Author: MAX
; @Board: TriBoard-TC1791
; @Chip: TC1791ED
; @Copyright: (C) 1989-2014 Lauterbach GmbH, licensed for use with TRACE32(R) only
; --------------------------------------------------------------------------------
; $Id: tc1791ed_flash.cmm 16676 2020-10-20 08:21:08Z sltaief $


; --------------------------------------------------------------------------------
; Memory mappings:
; internal program memory PSPR     mapped to 0xC0000000--0xC0007FFF   32 KB
;                                            0xC0200000--0xC0203FFF   16 KB
; internal data memory    DSPR     mapped to 0xD0000000--0xD001FFFF  128 KB
;                                            0xD0200000--0xD0203FFF   16 KB
;                         LMU SRAM mapped to 0xB0000000--0xB001FFFF  128 KB
; internal program flash  PFLASH0  mapped to 0xA0000000--0xA01FFFFF    2 MB
;                         PFLASH1  mapped to 0xA0800000--0xA09FFFFF    2 MB
; internal data flash     DFLASH   mapped to 0xAF000000--0xAF017FFF   96 KB
;                                            0xAF080000--0xAF097FFF   96 KB
; Notes:
; - memories mirrored in segment 8 (cached access):
;   - internal PFLASH0, PFLASH1
; - memories mirrored in segment 9 (cached access):
;   - internal LMU SRAM
; - memories mirrored within their segment
;   - internal PSPR, DSPR with offset 0x08000000
; - memories not mirrored
;   - internal DFLASH0, DFLASH1

; --------------------------------------------------------------------------------
; initialize and start the debugger

RESet
SYStem.CPU TC1791ED

IF DAP.Available()
(
  ; Bi-Directional Debug Cable detected
  ; switch to DAP2 mode instead of using JTAG
  SYStem.CONFIG.DEBUGPORTTYPE DAP2
)
ELSE
(
  ; Uni-Directional Debug Cable
  ; use JTAG as default mode
  SYStem.CONFIG.DEBUGPORTTYPE JTAG
)

;In this demo, the cores runs with a very slow clock. So, the best case is to set f(MCDS)=f(CPU)
;When the application runs with a higher frequency (e.g >150MHZ), the best case is to set f(MCDS)=f(CPU)/2
Data.STARTUP.SELect 1
Data.STARTUP.SEQuence SET 0xF0000534 %Long 0yXXXXxxxxXXXX0001XXXXxxxxXXXX0000  ;set MCDSDIV=f(PLL) &  EDBBBDIV=f(PLL)/2
Data.STARTUP.ON
;Enable clock frequency computation
CLOCK.ON

SYStem.Up

Data.Set 0xF00005F4 %Long 0x00000008    ; disable watchdog

; --------------------------------------------------------------------------------
; flash declaration
; Declaring TC1791ED internal flash requires an additional parameter providing
; the base address for the flash device to use (FLASH_0 or FLASH_1).
; In case the parameter is omitted, the default is FLASH_0.
;
; Note: Only one FLASH.TARGET command at the same time is supported. If two
;       or more target algorithms are required on the same target, the
;       appropriate FLASH.TARGET command has to be issued when switching to
;       another flash type.
FLASH.RESet

; flash declaration for processor internal flash
; processor internal program flash
FLASH.Create 1. 0xA0000000--0xA000FFFF 0x4000  TARGET Long 0xF8002000
FLASH.Create 2. 0xA0010000--0xA001FFFF 0x4000  TARGET Long 0xF8002000
FLASH.Create 3. 0xA0020000--0xA003FFFF 0x20000 TARGET Long 0xF8002000
FLASH.Create 3. 0xA0040000--0xA01FFFFF 0x40000 TARGET Long 0xF8002000
FLASH.Create 4. 0xA0800000--0xA080FFFF 0x4000  TARGET Long 0xF8004000
FLASH.Create 5. 0xA0810000--0xA081FFFF 0x4000  TARGET Long 0xF8004000
FLASH.Create 6. 0xA0820000--0xA083FFFF 0x20000 TARGET Long 0xF8004000
FLASH.Create 6. 0xA0840000--0xA09FFFFF 0x40000 TARGET Long 0xF8004000
; processor internal data flash
FLASH.Create 7. 0xAF000000--0xAF017FFF 0x18000 TARGET Long 0xF8002000
FLASH.Create 8. 0xAF080000--0xAF097FFF 0x18000 TARGET Long 0xF8002000
FLASH.TARGET 0xC0000000 0xD0000000 0x1000 ~~/demo/tricore/flash/long/tc1798.bin
FLASH.CreateALIAS 0x80000000--0x80ffffff 0xa0000000

; show flash declaration
WinPOS 0% 0%
FLASH.List

; --------------------------------------------------------------------------------
; example download to processor internal flash
;
; FLASH.AUTO or FLASH.ReProgram is required for flash programming of
; unsorted files. FLASH.PROGRAM may result in incorrect CRCs.

DIALOG.YESNO "Program internal flash memory?"
ENTRY &execflash
IF &execflash
(
  ; using FLASH.ReProgram is more gentle than FLASH.AUTO
  FLASH.ReProgram 0xA0000000--0xA01FFFFF /Erase
  FLASH.ReProgram 0xA0800000--0xA09FFFFF /Erase
  FLASH.ReProgram 0xAF000000--0xAFE07FFF /Erase
  FLASH.ReProgram 0xAF080000--0xAF097FFF /Erase
  Data.LOAD.auto *
  FLASH.ReProgram off
)

; --------------------------------------------------------------------------------
; select trace method
IF !Analyzer()
  Trace.METHOD Onchip

; --------------------------------------------------------------------------------
; set up MCDS trace
Trace.OF

; --------------------------------------------------------------------------------
; open some window
WinPOS 0% 50%
List.auto

ENDDO
