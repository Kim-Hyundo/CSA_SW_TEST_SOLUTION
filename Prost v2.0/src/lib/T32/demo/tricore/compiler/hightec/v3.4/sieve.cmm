; --------------------------------------------------------------------------------
; @Title: Demo script for loading HighTec object file (v3.4) in ELF format
; @Description:
;   Compiler: GNU C 3.4.5 built for Win32 on 2008-05-29 Tool Version v2.8
;   CPU: TC1767
;
;   Application is linked to internal flash memory.
;   Use the simulator to avoid conflicts with undecleared flash memory.
;
; @Keywords: compiler, hightec, Infineon, sieve, TriCore, v3.4
; @Author: MOB
; @Chip: TC1767
; @Copyright: (C) 1989-2014 Lauterbach GmbH, licensed for use with TRACE32(R) only
; --------------------------------------------------------------------------------
; $Id: sieve.cmm 7822 2014-10-29 13:57:15Z kjmal $


WinCLEAR

SYStem.RESet
SYStem.CPU TC1767
SYStem.Up

Data.LOAD.Elf "~~~~/sieve.elf"

WinPOS 0% 0% 100% 50%
List.auto
WinPOS 0% 50% 50% 50%
Frame /Locals /Caller
WinPOS 50% 50% 50% 50%
Var.Watch
Var.AddWatch ast flags

ENDDO
