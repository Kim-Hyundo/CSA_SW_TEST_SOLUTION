B::

repeat 0x1
(
  print "test"
)

ENDDO