B::
v precond.is_3s_after_ign_on=1
v vol_grp[VOL_IGN_FLAG]=0
v vol_grp[VOL_BAT]=12000
v ign_off_tick=1
ENDDO