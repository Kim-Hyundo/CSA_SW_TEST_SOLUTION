//MS 변수 입력 (10ms-> 1cycle)
B::
ENTRY &para1 &para2
 
v &para1=&para2/10.
ENDDO