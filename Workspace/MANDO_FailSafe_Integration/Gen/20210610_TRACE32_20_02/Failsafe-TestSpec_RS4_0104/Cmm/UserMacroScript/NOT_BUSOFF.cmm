B::
v ecan_busoff.fault=0
v acan_busoff.fault=0
ENDDO