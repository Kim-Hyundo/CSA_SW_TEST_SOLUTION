//E2E Error 고장조건 확인(MS)
B::
//&para4 : 10ms -> 1cycle
ENTRY &para1 &para2 &para3 &para4

//ALL messages clear fault
d.set Var.RANGE(can_timeout_tick) 0x0
d.set Var.RANGE(can_timeout_fault) 0x0
d.set Var.RANGE(e2e_err_flags) 0x0


v e2e_err_flags[&para1]=e2e_err_flags[&para1]|(1<<&para2)

if string.scan("&para2","ESC",0)!=-1||string.scan("&para2","WHL",0)!=-1
(
    v esc[&para3].fault=0
    v esc[&para3].detect_cnt=&para4/10.
)
else if string.scan("&para2","CLU",0)!=-1
(
    v clu[&para3].fault=0
    v clu[&para3].detect_cnt=&para4/10.
)
else
(
 PRINT %ERROR "ERROR0"
)
ENDDO