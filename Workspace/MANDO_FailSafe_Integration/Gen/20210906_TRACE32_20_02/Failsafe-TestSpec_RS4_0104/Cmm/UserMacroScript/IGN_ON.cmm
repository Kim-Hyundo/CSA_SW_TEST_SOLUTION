B::
v vol_grp[VOL_IGN_FLAG]=1
v ign_on_tick=301
ENDDO