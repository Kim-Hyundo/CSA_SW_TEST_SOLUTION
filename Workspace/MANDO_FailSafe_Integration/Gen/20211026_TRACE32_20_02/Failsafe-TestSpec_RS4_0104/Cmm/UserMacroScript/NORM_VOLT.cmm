B::
v vol_grp[VOL_BAT]=12000
v bat_info.high.fault=0
v bat_info.low.fault=0
ENDDO