B::
v precond.is_not_ecan_busoff=1
v precond.is_not_acan1_busoff=1
v precond.is_not_acan2_busoff=1
ENDDO