//변수 입력
B::
ENTRY &para1 &para2

v &para1=&para2
ENDDO