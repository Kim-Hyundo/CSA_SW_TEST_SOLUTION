//ref_sig 변수 입력
B::
ENTRY &para1 &para2

v ref_sig.&para1=&para2
ENDDO