B::
v precond.is_3s_after_ign_on=1

ENDDO