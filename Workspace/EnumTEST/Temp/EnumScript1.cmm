B::

y.new.macro Speed_test_ 0
y.new.macro ELIF_Speed_test_ 1
y.new.macro USM_AdasFCASetReq_ 2
y.new.macro USM_AdasFCAJnctnSetReq_ 3
y.new.macro USM_AdasWrngTimingSetReq_ 4
y.new.macro test_ 5
ENDDO

