B::

y.new.macro USM_AdasWrngTimingSetReq_ 0
y.new.macro USM_AdasFCASetReq_ 1
y.new.macro USM_AdasFCAJnctnSetReq_ 2
y.new.macro test_ 3
ENDDO

